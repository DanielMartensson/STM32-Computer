# 0 "core/arch/arm/dts/stm32mp151a-stm32-computer-firmware-mx.dts"
# 0 "<built-in>"
# 0 "<command-line>"
# 1 "core/arch/arm/dts/stm32mp151a-stm32-computer-firmware-mx.dts"
# 11 "core/arch/arm/dts/stm32mp151a-stm32-computer-firmware-mx.dts"
/dts-v1/;

# 1 "core/include/dt-bindings/pinctrl/stm32-pinfunc.h" 1
# 14 "core/arch/arm/dts/stm32mp151a-stm32-computer-firmware-mx.dts" 2
# 1 "core/include/dt-bindings/clock/stm32mp1-clksrc.h" 1
# 15 "core/arch/arm/dts/stm32mp151a-stm32-computer-firmware-mx.dts" 2
# 1 "core/include/dt-bindings/soc/stm32mp15-etzpc.h" 1
# 16 "core/arch/arm/dts/stm32mp151a-stm32-computer-firmware-mx.dts" 2
# 1 "core/arch/arm/dts/stm32mp151.dtsi" 1





# 1 "core/include/dt-bindings/interrupt-controller/arm-gic.h" 1
# 9 "core/include/dt-bindings/interrupt-controller/arm-gic.h"
# 1 "core/include/dt-bindings/interrupt-controller/irq.h" 1
# 10 "core/include/dt-bindings/interrupt-controller/arm-gic.h" 2
# 7 "core/arch/arm/dts/stm32mp151.dtsi" 2
# 1 "core/include/dt-bindings/clock/stm32mp1-clks.h" 1
# 8 "core/arch/arm/dts/stm32mp151.dtsi" 2
# 1 "core/include/dt-bindings/gpio/stm32mp_gpio.h" 1
# 10 "core/include/dt-bindings/gpio/stm32mp_gpio.h"
# 1 "core/include/dt-bindings/gpio/gpio.h" 1
# 11 "core/include/dt-bindings/gpio/stm32mp_gpio.h" 2
# 9 "core/arch/arm/dts/stm32mp151.dtsi" 2
# 1 "core/include/dt-bindings/reset/stm32mp1-resets.h" 1
# 10 "core/arch/arm/dts/stm32mp151.dtsi" 2

/ {
 #address-cells = <1>;
 #size-cells = <1>;

 cpus {
  #address-cells = <1>;
  #size-cells = <0>;

  cpu0: cpu@0 {
   compatible = "arm,cortex-a7";
   clock-frequency = <650000000>;
   device_type = "cpu";
   reg = <0>;
   clocks = <&rcc 194>;
   clock-names = "cpu";
   operating-points-v2 = <&cpu0_opp_table>;
   nvmem-cells = <&part_number_otp>;
   nvmem-cell-names = "part_number";
  };
 };

 arm-pmu {
  compatible = "arm,cortex-a7-pmu";
  interrupts = <0 200 4>;
  interrupt-affinity = <&cpu0>;
  interrupt-parent = <&intc>;
 };

 cpu0_opp_table: cpu0-opp-table {
  compatible = "operating-points-v2";
  opp-shared;

  opp-400000000 {
   opp-hz = /bits/ 64 <400000000>;
   opp-microvolt = <1200000>;
   opp-supported-hw = <0x2>;
   opp-suspend;
  };

  opp-650000000 {
   opp-hz = /bits/ 64 <650000000>;
   opp-microvolt = <1200000>;
   opp-supported-hw = <0x1>;
   st,opp-default;
  };

  opp-800000000 {
   opp-hz = /bits/ 64 <800000000>;
   opp-microvolt = <1350000>;
   opp-supported-hw = <0x2>;
   st,opp-default;
  };
 };

 psci {
  compatible = "arm,psci-1.0";
  method = "smc";
 };

 intc: interrupt-controller@a0021000 {
  compatible = "arm,cortex-a7-gic";
  #interrupt-cells = <3>;
  interrupt-controller;
  reg = <0xa0021000 0x1000>,
        <0xa0022000 0x2000>;
 };

 timer {
  compatible = "arm,armv7-timer";
  interrupts = <1 13 ((((1 << (1)) - 1) << 8) | 8)>,
        <1 14 ((((1 << (1)) - 1) << 8) | 8)>,
        <1 11 ((((1 << (1)) - 1) << 8) | 8)>,
        <1 10 ((((1 << (1)) - 1) << 8) | 8)>;
  interrupt-parent = <&intc>;
 };

 clocks {
  clk_hse: clk-hse {
   #clock-cells = <0>;
   compatible = "fixed-clock";
   clock-frequency = <24000000>;
  };

  clk_hsi: clk-hsi {
   #clock-cells = <0>;
   compatible = "fixed-clock";
   clock-frequency = <64000000>;
  };

  clk_lse: clk-lse {
   #clock-cells = <0>;
   compatible = "fixed-clock";
   clock-frequency = <32768>;
  };

  clk_lsi: clk-lsi {
   #clock-cells = <0>;
   compatible = "fixed-clock";
   clock-frequency = <32000>;
  };

  clk_csi: clk-csi {
   #clock-cells = <0>;
   compatible = "fixed-clock";
   clock-frequency = <4000000>;
  };
 };

 thermal-zones {
  cpu_thermal: cpu-thermal {
   polling-delay-passive = <0>;
   polling-delay = <0>;
   thermal-sensors = <&dts>;

   trips {
    cpu_alert1: cpu-alert1 {
     temperature = <85000>;
     hysteresis = <0>;
     type = "passive";
    };

    cpu-crit {
     temperature = <120000>;
     hysteresis = <0>;
     type = "critical";
    };
   };

   cooling-maps {
   };
  };
 };

 booster: regulator-booster {
  compatible = "st,stm32mp1-booster";
  st,syscfg = <&syscfg>;
  status = "disabled";
 };

 osc_calibration: osc-calibration {
  compatible = "st,osc-calibration";

  csi_calibration: csi-calibration {
   compatible = "st,csi-cal";
   counter = <&timers15 0 8>;
   status = "disabled";
  };

  hsi_calibration: hsi-calibration {
   compatible = "st,hsi-cal";
   counter = <&timers15 0 7>;
   status = "disabled";
  };
 };

 soc {
  compatible = "simple-bus";
  #address-cells = <1>;
  #size-cells = <1>;
  interrupt-parent = <&intc>;
  ranges;

  timers2: timer@40000000 {
   #address-cells = <1>;
   #size-cells = <0>;
   compatible = "st,stm32-timers";
   reg = <0x40000000 0x400>;
   clocks = <&rcc 197>;
   clock-names = "int";
   dmas = <&dmamux1 18 0x400 0x1>,
          <&dmamux1 19 0x400 0x1>,
          <&dmamux1 20 0x400 0x1>,
          <&dmamux1 21 0x400 0x1>,
          <&dmamux1 22 0x400 0x1>;
   dma-names = "ch1", "ch2", "ch3", "ch4", "up";
   status = "disabled";

   pwm {
    compatible = "st,stm32-pwm";
    #pwm-cells = <3>;
    status = "disabled";
   };

   timer@1 {
    compatible = "st,stm32h7-timer-trigger";
    reg = <1>;
    status = "disabled";
   };

   counter {
    compatible = "st,stm32-timer-counter";
    status = "disabled";
   };
  };

  timers3: timer@40001000 {
   #address-cells = <1>;
   #size-cells = <0>;
   compatible = "st,stm32-timers";
   reg = <0x40001000 0x400>;
   clocks = <&rcc 198>;
   clock-names = "int";
   dmas = <&dmamux1 23 0x400 0x1>,
          <&dmamux1 24 0x400 0x1>,
          <&dmamux1 25 0x400 0x1>,
          <&dmamux1 26 0x400 0x1>,
          <&dmamux1 27 0x400 0x1>,
          <&dmamux1 28 0x400 0x1>;
   dma-names = "ch1", "ch2", "ch3", "ch4", "up", "trig";
   status = "disabled";

   pwm {
    compatible = "st,stm32-pwm";
    #pwm-cells = <3>;
    status = "disabled";
   };

   timer@2 {
    compatible = "st,stm32h7-timer-trigger";
    reg = <2>;
    status = "disabled";
   };

   counter {
    compatible = "st,stm32-timer-counter";
    status = "disabled";
   };
  };

  timers4: timer@40002000 {
   #address-cells = <1>;
   #size-cells = <0>;
   compatible = "st,stm32-timers";
   reg = <0x40002000 0x400>;
   clocks = <&rcc 199>;
   clock-names = "int";
   dmas = <&dmamux1 29 0x400 0x1>,
          <&dmamux1 30 0x400 0x1>,
          <&dmamux1 31 0x400 0x1>,
          <&dmamux1 32 0x400 0x1>;
   dma-names = "ch1", "ch2", "ch3", "ch4";
   status = "disabled";

   pwm {
    compatible = "st,stm32-pwm";
    #pwm-cells = <3>;
    status = "disabled";
   };

   timer@3 {
    compatible = "st,stm32h7-timer-trigger";
    reg = <3>;
    status = "disabled";
   };

   counter {
    compatible = "st,stm32-timer-counter";
    status = "disabled";
   };
  };

  timers5: timer@40003000 {
   #address-cells = <1>;
   #size-cells = <0>;
   compatible = "st,stm32-timers";
   reg = <0x40003000 0x400>;
   clocks = <&rcc 200>;
   clock-names = "int";
   dmas = <&dmamux1 55 0x400 0x1>,
          <&dmamux1 56 0x400 0x1>,
          <&dmamux1 57 0x400 0x1>,
          <&dmamux1 58 0x400 0x1>,
          <&dmamux1 59 0x400 0x1>,
          <&dmamux1 60 0x400 0x1>;
   dma-names = "ch1", "ch2", "ch3", "ch4", "up", "trig";
   status = "disabled";

   pwm {
    compatible = "st,stm32-pwm";
    #pwm-cells = <3>;
    status = "disabled";
   };

   timer@4 {
    compatible = "st,stm32h7-timer-trigger";
    reg = <4>;
    status = "disabled";
   };

   counter {
    compatible = "st,stm32-timer-counter";
    status = "disabled";
   };
  };

  timers6: timer@40004000 {
   #address-cells = <1>;
   #size-cells = <0>;
   compatible = "st,stm32-timers";
   reg = <0x40004000 0x400>;
   clocks = <&rcc 201>;
   clock-names = "int";
   dmas = <&dmamux1 69 0x400 0x1>;
   dma-names = "up";
   status = "disabled";

   timer@5 {
    compatible = "st,stm32h7-timer-trigger";
    reg = <5>;
    status = "disabled";
   };
  };

  timers7: timer@40005000 {
   #address-cells = <1>;
   #size-cells = <0>;
   compatible = "st,stm32-timers";
   reg = <0x40005000 0x400>;
   clocks = <&rcc 202>;
   clock-names = "int";
   dmas = <&dmamux1 70 0x400 0x1>;
   dma-names = "up";
   status = "disabled";

   timer@6 {
    compatible = "st,stm32h7-timer-trigger";
    reg = <6>;
    status = "disabled";
   };
  };

  timers12: timer@40006000 {
   #address-cells = <1>;
   #size-cells = <0>;
   compatible = "st,stm32-timers";
   reg = <0x40006000 0x400>;
   clocks = <&rcc 203>;
   clock-names = "int";
   status = "disabled";

   pwm {
    compatible = "st,stm32-pwm";
    #pwm-cells = <3>;
    status = "disabled";
   };

   timer@11 {
    compatible = "st,stm32h7-timer-trigger";
    reg = <11>;
    status = "disabled";
   };
  };

  timers13: timer@40007000 {
   #address-cells = <1>;
   #size-cells = <0>;
   compatible = "st,stm32-timers";
   reg = <0x40007000 0x400>;
   clocks = <&rcc 204>;
   clock-names = "int";
   status = "disabled";

   pwm {
    compatible = "st,stm32-pwm";
    #pwm-cells = <3>;
    status = "disabled";
   };

   timer@12 {
    compatible = "st,stm32h7-timer-trigger";
    reg = <12>;
    status = "disabled";
   };
  };

  timers14: timer@40008000 {
   #address-cells = <1>;
   #size-cells = <0>;
   compatible = "st,stm32-timers";
   reg = <0x40008000 0x400>;
   clocks = <&rcc 205>;
   clock-names = "int";
   status = "disabled";

   pwm {
    compatible = "st,stm32-pwm";
    #pwm-cells = <3>;
    status = "disabled";
   };

   timer@13 {
    compatible = "st,stm32h7-timer-trigger";
    reg = <13>;
    status = "disabled";
   };
  };

  lptimer1: timer@40009000 {
   #address-cells = <1>;
   #size-cells = <0>;
   compatible = "st,stm32-lptimer";
   reg = <0x40009000 0x400>;
   interrupts-extended = <&exti 47 4>;
   clocks = <&rcc 143>;
   clock-names = "mux";
   wakeup-source;
   status = "disabled";

   pwm {
    compatible = "st,stm32-pwm-lp";
    #pwm-cells = <3>;
    status = "disabled";
   };

   trigger@0 {
    compatible = "st,stm32-lptimer-trigger";
    reg = <0>;
    status = "disabled";
   };

   counter {
    compatible = "st,stm32-lptimer-counter";
    status = "disabled";
   };
  };

  spi2: spi@4000b000 {
   #address-cells = <1>;
   #size-cells = <0>;
   compatible = "st,stm32h7-spi";
   reg = <0x4000b000 0x400>;
   interrupts = <0 36 4>;
   clocks = <&rcc 131>;
   resets = <&rcc 19467>;
   dmas = <&dmamux1 39 0x400 0x05>,
          <&dmamux1 40 0x400 0x05>;
   dma-names = "rx", "tx";
   status = "disabled";
  };

  i2s2: audio-controller@4000b000 {
   compatible = "st,stm32h7-i2s";
   #sound-dai-cells = <0>;
   reg = <0x4000b000 0x400>;
   interrupts = <0 36 4>;
   dmas = <&dmamux1 39 0x400 0x01>,
          <&dmamux1 40 0x400 0x01>;
   dma-names = "rx", "tx";
   status = "disabled";
  };

  spi3: spi@4000c000 {
   #address-cells = <1>;
   #size-cells = <0>;
   compatible = "st,stm32h7-spi";
   reg = <0x4000c000 0x400>;
   interrupts = <0 51 4>;
   clocks = <&rcc 132>;
   resets = <&rcc 19468>;
   dmas = <&dmamux1 61 0x400 0x05>,
          <&dmamux1 62 0x400 0x05>;
   dma-names = "rx", "tx";
   status = "disabled";
  };

  i2s3: audio-controller@4000c000 {
   compatible = "st,stm32h7-i2s";
   #sound-dai-cells = <0>;
   reg = <0x4000c000 0x400>;
   interrupts = <0 51 4>;
   dmas = <&dmamux1 61 0x400 0x01>,
          <&dmamux1 62 0x400 0x01>;
   dma-names = "rx", "tx";
   status = "disabled";
  };

  spdifrx: audio-controller@4000d000 {
   compatible = "st,stm32h7-spdifrx";
   #sound-dai-cells = <0>;
   reg = <0x4000d000 0x400>;
   clocks = <&rcc 129>;
   clock-names = "kclk";
   interrupts = <0 97 4>;
   dmas = <&dmamux1 93 0x400 0x01>,
          <&dmamux1 94 0x400 0x01>;
   dma-names = "rx", "rx-ctrl";
   status = "disabled";
  };

  usart2: serial@4000e000 {
   compatible = "st,stm32h7-uart";
   reg = <0x4000e000 0x400>;
   interrupts-extended = <&exti 27 4>;
   clocks = <&rcc 149>;
   wakeup-source;
   dmas = <&dmamux1 43 0x400 0x15>,
          <&dmamux1 44 0x400 0x11>;
   dma-names = "rx", "tx";
   resets = <&rcc 19470>;
   status = "disabled";
  };

  usart3: serial@4000f000 {
   compatible = "st,stm32h7-uart";
   reg = <0x4000f000 0x400>;
   interrupts-extended = <&exti 28 4>;
   clocks = <&rcc 150>;
   wakeup-source;
   dmas = <&dmamux1 45 0x400 0x15>,
          <&dmamux1 46 0x400 0x11>;
   dma-names = "rx", "tx";
   resets = <&rcc 19471>;
   status = "disabled";
  };

  uart4: serial@40010000 {
   compatible = "st,stm32h7-uart";
   reg = <0x40010000 0x400>;
   interrupts-extended = <&exti 30 4>;
   clocks = <&rcc 151>;
   wakeup-source;
   dmas = <&dmamux1 63 0x400 0x15>,
          <&dmamux1 64 0x400 0x11>;
   dma-names = "rx", "tx";
   resets = <&rcc 19472>;
   status = "disabled";
  };

  uart5: serial@40011000 {
   compatible = "st,stm32h7-uart";
   reg = <0x40011000 0x400>;
   interrupts-extended = <&exti 31 4>;
   clocks = <&rcc 152>;
   wakeup-source;
   dmas = <&dmamux1 65 0x400 0x15>,
          <&dmamux1 66 0x400 0x11>;
   dma-names = "rx", "tx";
   resets = <&rcc 19473>;
   status = "disabled";
  };

  i2c1: i2c@40012000 {
   compatible = "st,stm32mp15-i2c";
   reg = <0x40012000 0x400>;
   interrupt-names = "event", "error";
   interrupts = <0 31 4>,
         <0 32 4>;
   clocks = <&rcc 137>;
   resets = <&rcc 19477>;
   #address-cells = <1>;
   #size-cells = <0>;
   st,syscfg-fmp = <&syscfg 0x4 0x1>;
   wakeup-source;
   i2c-analog-filter;
   status = "disabled";
  };

  i2c2: i2c@40013000 {
   compatible = "st,stm32mp15-i2c";
   reg = <0x40013000 0x400>;
   interrupt-names = "event", "error";
   interrupts = <0 33 4>,
         <0 34 4>;
   clocks = <&rcc 138>;
   resets = <&rcc 19478>;
   #address-cells = <1>;
   #size-cells = <0>;
   st,syscfg-fmp = <&syscfg 0x4 0x2>;
   wakeup-source;
   i2c-analog-filter;
   status = "disabled";
  };

  i2c3: i2c@40014000 {
   compatible = "st,stm32mp15-i2c";
   reg = <0x40014000 0x400>;
   interrupt-names = "event", "error";
   interrupts = <0 72 4>,
         <0 73 4>;
   clocks = <&rcc 139>;
   resets = <&rcc 19479>;
   #address-cells = <1>;
   #size-cells = <0>;
   st,syscfg-fmp = <&syscfg 0x4 0x4>;
   wakeup-source;
   i2c-analog-filter;
   status = "disabled";
  };

  i2c5: i2c@40015000 {
   compatible = "st,stm32mp15-i2c";
   reg = <0x40015000 0x400>;
   interrupt-names = "event", "error";
   interrupts = <0 107 4>,
         <0 108 4>;
   clocks = <&rcc 141>;
   resets = <&rcc 19480>;
   #address-cells = <1>;
   #size-cells = <0>;
   st,syscfg-fmp = <&syscfg 0x4 0x10>;
   wakeup-source;
   i2c-analog-filter;
   status = "disabled";
  };

  cec: cec@40016000 {
   compatible = "st,stm32-cec";
   reg = <0x40016000 0x400>;
   interrupts = <0 94 4>;
   clocks = <&rcc 136>, <&rcc 29>;
   clock-names = "cec", "hdmi-cec";
   status = "disabled";
  };

  dac: dac@40017000 {
   compatible = "st,stm32h7-dac-core";
   reg = <0x40017000 0x400>;
   clocks = <&rcc 30>;
   clock-names = "pclk";
   #address-cells = <1>;
   #size-cells = <0>;
   status = "disabled";

   dac1: dac@1 {
    compatible = "st,stm32-dac";
    #io-channel-cells = <1>;
    reg = <1>;
    status = "disabled";
   };

   dac2: dac@2 {
    compatible = "st,stm32-dac";
    #io-channel-cells = <1>;
    reg = <2>;
    status = "disabled";
   };
  };

  uart7: serial@40018000 {
   compatible = "st,stm32h7-uart";
   reg = <0x40018000 0x400>;
   interrupts-extended = <&exti 32 4>;
   clocks = <&rcc 154>;
   wakeup-source;
   dmas = <&dmamux1 79 0x400 0x15>,
          <&dmamux1 80 0x400 0x11>;
   dma-names = "rx", "tx";
   resets = <&rcc 19474>;
   status = "disabled";
  };

  uart8: serial@40019000 {
   compatible = "st,stm32h7-uart";
   reg = <0x40019000 0x400>;
   interrupts-extended = <&exti 33 4>;
   clocks = <&rcc 155>;
   wakeup-source;
   dmas = <&dmamux1 81 0x400 0x15>,
          <&dmamux1 82 0x400 0x11>;
   dma-names = "rx", "tx";
   resets = <&rcc 19475>;
   status = "disabled";
  };

  timers1: timer@44000000 {
   #address-cells = <1>;
   #size-cells = <0>;
   compatible = "st,stm32-timers";
   reg = <0x44000000 0x400>;
   clocks = <&rcc 206>;
   clock-names = "int";
   dmas = <&dmamux1 11 0x400 0x1>,
          <&dmamux1 12 0x400 0x1>,
          <&dmamux1 13 0x400 0x1>,
          <&dmamux1 14 0x400 0x1>,
          <&dmamux1 15 0x400 0x1>,
          <&dmamux1 16 0x400 0x1>,
          <&dmamux1 17 0x400 0x1>;
   dma-names = "ch1", "ch2", "ch3", "ch4",
        "up", "trig", "com";
   status = "disabled";

   pwm {
    compatible = "st,stm32-pwm";
    #pwm-cells = <3>;
    status = "disabled";
   };

   timer@0 {
    compatible = "st,stm32h7-timer-trigger";
    reg = <0>;
    status = "disabled";
   };

   counter {
    compatible = "st,stm32-timer-counter";
    status = "disabled";
   };
  };

  timers8: timer@44001000 {
   #address-cells = <1>;
   #size-cells = <0>;
   compatible = "st,stm32-timers";
   reg = <0x44001000 0x400>;
   clocks = <&rcc 207>;
   clock-names = "int";
   dmas = <&dmamux1 47 0x400 0x1>,
          <&dmamux1 48 0x400 0x1>,
          <&dmamux1 49 0x400 0x1>,
          <&dmamux1 50 0x400 0x1>,
          <&dmamux1 51 0x400 0x1>,
          <&dmamux1 52 0x400 0x1>,
          <&dmamux1 53 0x400 0x1>;
   dma-names = "ch1", "ch2", "ch3", "ch4",
        "up", "trig", "com";
   status = "disabled";

   pwm {
    compatible = "st,stm32-pwm";
    #pwm-cells = <3>;
    status = "disabled";
   };

   timer@7 {
    compatible = "st,stm32h7-timer-trigger";
    reg = <7>;
    status = "disabled";
   };

   counter {
    compatible = "st,stm32-timer-counter";
    status = "disabled";
   };
  };

  usart6: serial@44003000 {
   compatible = "st,stm32h7-uart";
   reg = <0x44003000 0x400>;
   interrupts-extended = <&exti 29 4>;
   clocks = <&rcc 153>;
   wakeup-source;
   dmas = <&dmamux1 71 0x400 0x15>,
          <&dmamux1 72 0x400 0x11>;
   dma-names = "rx", "tx";
   resets = <&rcc 19533>;
   status = "disabled";
  };

  spi1: spi@44004000 {
   #address-cells = <1>;
   #size-cells = <0>;
   compatible = "st,stm32h7-spi";
   reg = <0x44004000 0x400>;
   interrupts = <0 35 4>;
   clocks = <&rcc 130>;
   resets = <&rcc 19528>;
   dmas = <&dmamux1 37 0x400 0x05>,
          <&dmamux1 38 0x400 0x05>;
   dma-names = "rx", "tx";
   status = "disabled";
  };

  i2s1: audio-controller@44004000 {
   compatible = "st,stm32h7-i2s";
   #sound-dai-cells = <0>;
   reg = <0x44004000 0x400>;
   interrupts = <0 35 4>;
   dmas = <&dmamux1 37 0x400 0x01>,
          <&dmamux1 38 0x400 0x01>;
   dma-names = "rx", "tx";
   status = "disabled";
  };

  spi4: spi@44005000 {
   #address-cells = <1>;
   #size-cells = <0>;
   compatible = "st,stm32h7-spi";
   reg = <0x44005000 0x400>;
   interrupts = <0 84 4>;
   clocks = <&rcc 133>;
   resets = <&rcc 19529>;
   dmas = <&dmamux1 83 0x400 0x05>,
          <&dmamux1 84 0x400 0x05>;
   dma-names = "rx", "tx";
   status = "disabled";
  };

  timers15: timer@44006000 {
   #address-cells = <1>;
   #size-cells = <0>;
   compatible = "st,stm32-timers";
   reg = <0x44006000 0x400>;
   clocks = <&rcc 208>;
   clock-names = "int";
   dmas = <&dmamux1 105 0x400 0x1>,
          <&dmamux1 106 0x400 0x1>,
          <&dmamux1 107 0x400 0x1>,
          <&dmamux1 108 0x400 0x1>;
   dma-names = "ch1", "up", "trig", "com";
   status = "disabled";

   counter {
    compatible = "st,stm32-timer-counter";
    status = "disabled";
   };

   pwm {
    compatible = "st,stm32-pwm";
    #pwm-cells = <3>;
    status = "disabled";
   };

   timer@14 {
    compatible = "st,stm32h7-timer-trigger";
    reg = <14>;
    status = "disabled";
   };
  };

  timers16: timer@44007000 {
   #address-cells = <1>;
   #size-cells = <0>;
   compatible = "st,stm32-timers";
   reg = <0x44007000 0x400>;
   clocks = <&rcc 209>;
   clock-names = "int";
   dmas = <&dmamux1 109 0x400 0x1>,
          <&dmamux1 110 0x400 0x1>;
   dma-names = "ch1", "up";
   status = "disabled";

   pwm {
    compatible = "st,stm32-pwm";
    #pwm-cells = <3>;
    status = "disabled";
   };
   timer@15 {
    compatible = "st,stm32h7-timer-trigger";
    reg = <15>;
    status = "disabled";
   };
  };

  timers17: timer@44008000 {
   #address-cells = <1>;
   #size-cells = <0>;
   compatible = "st,stm32-timers";
   reg = <0x44008000 0x400>;
   clocks = <&rcc 210>;
   clock-names = "int";
   dmas = <&dmamux1 111 0x400 0x1>,
          <&dmamux1 112 0x400 0x1>;
   dma-names = "ch1", "up";
   status = "disabled";

   pwm {
    compatible = "st,stm32-pwm";
    #pwm-cells = <3>;
    status = "disabled";
   };

   timer@16 {
    compatible = "st,stm32h7-timer-trigger";
    reg = <16>;
    status = "disabled";
   };
  };

  spi5: spi@44009000 {
   #address-cells = <1>;
   #size-cells = <0>;
   compatible = "st,stm32h7-spi";
   reg = <0x44009000 0x400>;
   interrupts = <0 85 4>;
   clocks = <&rcc 134>;
   resets = <&rcc 19530>;
   dmas = <&dmamux1 85 0x400 0x05>,
          <&dmamux1 86 0x400 0x05>;
   dma-names = "rx", "tx";
   status = "disabled";
  };

  sai1: sai@4400a000 {
   compatible = "st,stm32h7-sai";
   #address-cells = <1>;
   #size-cells = <1>;
   ranges = <0 0x4400a000 0x400>;
   reg = <0x4400a000 0x4>, <0x4400a3f0 0x10>;
   interrupts = <0 87 4>;
   resets = <&rcc 19536>;
   status = "disabled";

   sai1a: audio-controller@4400a004 {
    #sound-dai-cells = <0>;

    compatible = "st,stm32-sai-sub-a";
    reg = <0x4 0x20>;
    clocks = <&rcc 158>;
    clock-names = "sai_ck";
    dmas = <&dmamux1 87 0x400 0x01>;
    status = "disabled";
   };

   sai1b: audio-controller@4400a024 {
    #sound-dai-cells = <0>;
    compatible = "st,stm32-sai-sub-b";
    reg = <0x24 0x20>;
    clocks = <&rcc 158>;
    clock-names = "sai_ck";
    dmas = <&dmamux1 88 0x400 0x01>;
    status = "disabled";
   };
  };

  sai2: sai@4400b000 {
   compatible = "st,stm32h7-sai";
   #address-cells = <1>;
   #size-cells = <1>;
   ranges = <0 0x4400b000 0x400>;
   reg = <0x4400b000 0x4>, <0x4400b3f0 0x10>;
   interrupts = <0 91 4>;
   resets = <&rcc 19537>;
   status = "disabled";

   sai2a: audio-controller@4400b004 {
    #sound-dai-cells = <0>;
    compatible = "st,stm32-sai-sub-a";
    reg = <0x4 0x20>;
    clocks = <&rcc 159>;
    clock-names = "sai_ck";
    dmas = <&dmamux1 89 0x400 0x01>;
    status = "disabled";
   };

   sai2b: audio-controller@4400b024 {
    #sound-dai-cells = <0>;
    compatible = "st,stm32-sai-sub-b";
    reg = <0x24 0x20>;
    clocks = <&rcc 159>;
    clock-names = "sai_ck";
    dmas = <&dmamux1 90 0x400 0x01>;
    status = "disabled";
   };
  };

  sai3: sai@4400c000 {
   compatible = "st,stm32h7-sai";
   #address-cells = <1>;
   #size-cells = <1>;
   ranges = <0 0x4400c000 0x400>;
   reg = <0x4400c000 0x4>, <0x4400c3f0 0x10>;
   interrupts = <0 114 4>;
   resets = <&rcc 19538>;
   status = "disabled";

   sai3a: audio-controller@4400c004 {
    #sound-dai-cells = <0>;
    compatible = "st,stm32-sai-sub-a";
    reg = <0x04 0x20>;
    clocks = <&rcc 160>;
    clock-names = "sai_ck";
    dmas = <&dmamux1 113 0x400 0x01>;
    status = "disabled";
   };

   sai3b: audio-controller@4400c024 {
    #sound-dai-cells = <0>;
    compatible = "st,stm32-sai-sub-b";
    reg = <0x24 0x20>;
    clocks = <&rcc 160>;
    clock-names = "sai_ck";
    dmas = <&dmamux1 114 0x400 0x01>;
    status = "disabled";
   };
  };

  dfsdm: dfsdm@4400d000 {
   compatible = "st,stm32mp1-dfsdm";
   reg = <0x4400d000 0x800>;
   clocks = <&rcc 156>;
   clock-names = "dfsdm";
   #address-cells = <1>;
   #size-cells = <0>;
   status = "disabled";

   dfsdm0: filter@0 {
    compatible = "st,stm32-dfsdm-adc";
    #io-channel-cells = <1>;
    reg = <0>;
    interrupts = <0 110 4>;
    dmas = <&dmamux1 101 0x400 0x01>;
    dma-names = "rx";
    status = "disabled";
   };

   dfsdm1: filter@1 {
    compatible = "st,stm32-dfsdm-adc";
    #io-channel-cells = <1>;
    reg = <1>;
    interrupts = <0 111 4>;
    dmas = <&dmamux1 102 0x400 0x01>;
    dma-names = "rx";
    status = "disabled";
   };

   dfsdm2: filter@2 {
    compatible = "st,stm32-dfsdm-adc";
    #io-channel-cells = <1>;
    reg = <2>;
    interrupts = <0 112 4>;
    dmas = <&dmamux1 103 0x400 0x01>;
    dma-names = "rx";
    status = "disabled";
   };

   dfsdm3: filter@3 {
    compatible = "st,stm32-dfsdm-adc";
    #io-channel-cells = <1>;
    reg = <3>;
    interrupts = <0 113 4>;
    dmas = <&dmamux1 104 0x400 0x01>;
    dma-names = "rx";
    status = "disabled";
   };

   dfsdm4: filter@4 {
    compatible = "st,stm32-dfsdm-adc";
    #io-channel-cells = <1>;
    reg = <4>;
    interrupts = <0 115 4>;
    dmas = <&dmamux1 91 0x400 0x01>;
    dma-names = "rx";
    status = "disabled";
   };

   dfsdm5: filter@5 {
    compatible = "st,stm32-dfsdm-adc";
    #io-channel-cells = <1>;
    reg = <5>;
    interrupts = <0 126 4>;
    dmas = <&dmamux1 92 0x400 0x01>;
    dma-names = "rx";
    status = "disabled";
   };
  };

  dma1: dma-controller@48000000 {
   compatible = "st,stm32-dma";
   reg = <0x48000000 0x400>;
   interrupts = <0 11 4>,
         <0 12 4>,
         <0 13 4>,
         <0 14 4>,
         <0 15 4>,
         <0 16 4>,
         <0 17 4>,
         <0 47 4>;
   clocks = <&rcc 71>;
   resets = <&rcc 19648>;
   #dma-cells = <4>;
   st,mem2mem;
   dma-requests = <8>;
  };

  dma2: dma-controller@48001000 {
   compatible = "st,stm32-dma";
   reg = <0x48001000 0x400>;
   interrupts = <0 56 4>,
         <0 57 4>,
         <0 58 4>,
         <0 59 4>,
         <0 60 4>,
         <0 68 4>,
         <0 69 4>,
         <0 70 4>;
   clocks = <&rcc 72>;
   resets = <&rcc 19649>;
   #dma-cells = <4>;
   st,mem2mem;
   dma-requests = <8>;
  };

  dmamux1: dma-router@48002000 {
   compatible = "st,stm32h7-dmamux";
   reg = <0x48002000 0x40>;
   #dma-cells = <3>;
   dma-requests = <128>;
   dma-masters = <&dma1 &dma2>;
   dma-channels = <16>;
   clocks = <&rcc 73>;
   resets = <&rcc 19650>;
  };

  adc: adc@48003000 {
   compatible = "st,stm32mp1-adc-core";
   reg = <0x48003000 0x400>;
   interrupts = <0 18 4>,
         <0 90 4>;
   clocks = <&rcc 74>, <&rcc 162>;
   clock-names = "bus", "adc";
   interrupt-controller;
   st,syscfg = <&syscfg>;
   #interrupt-cells = <1>;
   #address-cells = <1>;
   #size-cells = <0>;
   status = "disabled";

   adc1: adc@0 {
    compatible = "st,stm32mp1-adc";
    #io-channel-cells = <1>;
    reg = <0x0>;
    interrupt-parent = <&adc>;
    interrupts = <0>;
    dmas = <&dmamux1 9 0x400 0x01>;
    dma-names = "rx";
    status = "disabled";
   };

   adc2: adc@100 {
    compatible = "st,stm32mp1-adc";
    #io-channel-cells = <1>;
    reg = <0x100>;
    interrupt-parent = <&adc>;
    interrupts = <1>;
    dmas = <&dmamux1 10 0x400 0x01>;
    dma-names = "rx";
    status = "disabled";
   };
  };

  sdmmc3: mmc@48004000 {
   compatible = "st,stm32-sdmmc2", "arm,pl18x", "arm,primecell";
   arm,primecell-periphid = <0x00253180>;
   reg = <0x48004000 0x400>;
   interrupts = <0 137 4>;
   interrupt-names = "cmd_irq";
   clocks = <&rcc 120>;
   clock-names = "apb_pclk";
   resets = <&rcc 19664>;
   cap-sd-highspeed;
   cap-mmc-highspeed;
   max-frequency = <120000000>;
   status = "disabled";
  };

  usbotg_hs: usb-otg@49000000 {
   compatible = "st,stm32mp15-hsotg", "snps,dwc2";
   reg = <0x49000000 0x10000>;
   clocks = <&rcc 166>;
   clock-names = "otg";
   resets = <&rcc 19656>;
   reset-names = "dwc2";
   interrupts = <0 98 4>;
   g-rx-fifo-size = <512>;
   g-np-tx-fifo-size = <32>;
   g-tx-fifo-size = <256 16 16 16 16 16 16 16>;
   dr_mode = "otg";
   otg-rev = <0x200>;
   usb33d-supply = <&usb33>;
   status = "disabled";
  };

  ipcc: mailbox@4c001000 {
   compatible = "st,stm32mp1-ipcc";
   #mbox-cells = <1>;
   reg = <0x4c001000 0x400>;
   st,proc-id = <0>;
   interrupts-extended =
    <&intc 0 100 4>,
    <&intc 0 101 4>,
    <&exti 61 1>;
   interrupt-names = "rx", "tx", "wakeup";
   clocks = <&rcc 83>;
   wakeup-source;
   status = "disabled";
  };

  dcmi: dcmi@4c006000 {
   compatible = "st,stm32-dcmi";
   reg = <0x4c006000 0x400>;
   interrupts = <0 78 4>;
   resets = <&rcc 19712>;
   clocks = <&rcc 77>;
   clock-names = "mclk";
   dmas = <&dmamux1 75 0x400 0x01>;
   dma-names = "tx";
   status = "disabled";
  };

  rcc: rcc@50000000 {
   compatible = "st,stm32mp1-rcc-secure", "st,stm32mp1-rcc", "syscon";
   reg = <0x50000000 0x1000>;
   #address-cells = <1>;
   #size-cells = <0>;
   #clock-cells = <1>;
   #reset-cells = <1>;
   interrupts = <0 5 4>;
   secure-interrupts = <0 145 4>;
   secure-interrupt-names = "wakeup";
  };

  pwr_regulators: pwr@50001000 {
   compatible = "st,stm32mp1,pwr-reg";
   reg = <0x50001000 0x10>;

   reg11: reg11 {
    regulator-name = "reg11";
    regulator-min-microvolt = <1100000>;
    regulator-max-microvolt = <1100000>;
   };

   reg18: reg18 {
    regulator-name = "reg18";
    regulator-min-microvolt = <1800000>;
    regulator-max-microvolt = <1800000>;
   };

   usb33: usb33 {
    regulator-name = "usb33";
    regulator-min-microvolt = <3300000>;
    regulator-max-microvolt = <3300000>;
   };
  };

  pwr_mcu: pwr_mcu@50001014 {
   compatible = "st,stm32mp151-pwr-mcu", "syscon";
   reg = <0x50001014 0x4>;
  };

  exti: interrupt-controller@5000d000 {
   compatible = "st,stm32mp1-exti", "syscon";
   interrupt-controller;
   #interrupt-cells = <2>;
   reg = <0x5000d000 0x400>;
  };

  syscfg: syscon@50020000 {
   compatible = "st,stm32mp157-syscfg", "syscon";
   reg = <0x50020000 0x400>;
   clocks = <&rcc 51>;
  };

  lptimer2: timer@50021000 {
   #address-cells = <1>;
   #size-cells = <0>;
   compatible = "st,stm32-lptimer";
   reg = <0x50021000 0x400>;
   interrupts-extended = <&exti 48 4>;
   clocks = <&rcc 144>;
   clock-names = "mux";
   wakeup-source;
   status = "disabled";

   pwm {
    compatible = "st,stm32-pwm-lp";
    #pwm-cells = <3>;
    status = "disabled";
   };

   trigger@1 {
    compatible = "st,stm32-lptimer-trigger";
    reg = <1>;
    status = "disabled";
   };

   counter {
    compatible = "st,stm32-lptimer-counter";
    status = "disabled";
   };
  };

  lptimer3: timer@50022000 {
   #address-cells = <1>;
   #size-cells = <0>;
   compatible = "st,stm32-lptimer";
   reg = <0x50022000 0x400>;
   interrupts-extended = <&exti 50 4>;
   clocks = <&rcc 145>;
   clock-names = "mux";
   wakeup-source;
   status = "disabled";

   pwm {
    compatible = "st,stm32-pwm-lp";
    #pwm-cells = <3>;
    status = "disabled";
   };

   trigger@2 {
    compatible = "st,stm32-lptimer-trigger";
    reg = <2>;
    status = "disabled";
   };
  };

  lptimer4: timer@50023000 {
   compatible = "st,stm32-lptimer";
   reg = <0x50023000 0x400>;
   interrupts-extended = <&exti 52 4>;
   clocks = <&rcc 146>;
   clock-names = "mux";
   wakeup-source;
   status = "disabled";

   pwm {
    compatible = "st,stm32-pwm-lp";
    #pwm-cells = <3>;
    status = "disabled";
   };
  };

  lptimer5: timer@50024000 {
   compatible = "st,stm32-lptimer";
   reg = <0x50024000 0x400>;
   interrupts-extended = <&exti 53 4>;
   clocks = <&rcc 147>;
   clock-names = "mux";
   wakeup-source;
   status = "disabled";

   pwm {
    compatible = "st,stm32-pwm-lp";
    #pwm-cells = <3>;
    status = "disabled";
   };
  };

  vrefbuf: vrefbuf@50025000 {
   compatible = "st,stm32-vrefbuf";
   reg = <0x50025000 0x8>;
   regulator-min-microvolt = <1500000>;
   regulator-max-microvolt = <2500000>;
   clocks = <&rcc 52>;
   status = "disabled";
  };

  sai4: sai@50027000 {
   compatible = "st,stm32h7-sai";
   #address-cells = <1>;
   #size-cells = <1>;
   ranges = <0 0x50027000 0x400>;
   reg = <0x50027000 0x4>, <0x500273f0 0x10>;
   interrupts = <0 146 4>;
   resets = <&rcc 19592>;
   status = "disabled";

   sai4a: audio-controller@50027004 {
    #sound-dai-cells = <0>;
    compatible = "st,stm32-sai-sub-a";
    reg = <0x04 0x20>;
    clocks = <&rcc 161>;
    clock-names = "sai_ck";
    dmas = <&dmamux1 99 0x400 0x01>;
    status = "disabled";
   };

   sai4b: audio-controller@50027024 {
    #sound-dai-cells = <0>;
    compatible = "st,stm32-sai-sub-b";
    reg = <0x24 0x20>;
    clocks = <&rcc 161>;
    clock-names = "sai_ck";
    dmas = <&dmamux1 100 0x400 0x01>;
    status = "disabled";
   };
  };

  dts: thermal@50028000 {
   compatible = "st,stm32-thermal";
   reg = <0x50028000 0x100>;
   interrupts = <0 147 4>;
   clocks = <&rcc 53>;
   clock-names = "pclk";
   #thermal-sensor-cells = <0>;
   status = "disabled";
  };

  mdma1: dma-controller@58000000 {
   compatible = "st,stm32h7-mdma";
   reg = <0x58000000 0x1000>;
   interrupts = <0 122 4>;
   clocks = <&rcc 100>;
   resets = <&rcc 3328>;
   #dma-cells = <5>;
   dma-channels = <32>;
   dma-requests = <48>;
  };

  fmc: memory-controller@58002000 {
   #address-cells = <2>;
   #size-cells = <1>;
   compatible = "st,stm32mp1-fmc2-ebi";
   reg = <0x58002000 0x1000>;
   clocks = <&rcc 121>;
   resets = <&rcc 3276>;
   status = "disabled";

   ranges = <0 0 0x60000000 0x04000000>,
     <1 0 0x64000000 0x04000000>,
     <2 0 0x68000000 0x04000000>,
     <3 0 0x6c000000 0x04000000>,
     <4 0 0x80000000 0x10000000>;

   nand-controller@4,0 {
    #address-cells = <1>;
    #size-cells = <0>;
    compatible = "st,stm32mp1-fmc2-nfc";
    reg = <4 0x00000000 0x1000>,
          <4 0x08010000 0x1000>,
          <4 0x08020000 0x1000>,
          <4 0x01000000 0x1000>,
          <4 0x09010000 0x1000>,
          <4 0x09020000 0x1000>;
    interrupts = <0 48 4>;
    dmas = <&mdma1 20 0x2 0x12000a02 0x0 0x0>,
           <&mdma1 20 0x2 0x12000a08 0x0 0x0>,
           <&mdma1 21 0x2 0x12000a0a 0x0 0x0>;
    dma-names = "tx", "rx", "ecc";
    status = "disabled";
   };
  };

  qspi: spi@58003000 {
   compatible = "st,stm32f469-qspi";
   reg = <0x58003000 0x1000>, <0x70000000 0x10000000>;
   reg-names = "qspi", "qspi_mm";
   interrupts = <0 92 4>;
   dmas = <&mdma1 22 0x2 0x10100002 0x0 0x0>,
          <&mdma1 22 0x2 0x10100008 0x0 0x0>;
   dma-names = "tx", "rx";
   clocks = <&rcc 122>;
   resets = <&rcc 3278>;
   #address-cells = <1>;
   #size-cells = <0>;
   status = "disabled";
  };

  sdmmc1: mmc@58005000 {
   compatible = "st,stm32-sdmmc2", "arm,pl18x", "arm,primecell";
   arm,primecell-periphid = <0x00253180>;
   reg = <0x58005000 0x1000>;
   interrupts = <0 49 4>;
   interrupt-names = "cmd_irq";
   clocks = <&rcc 118>;
   clock-names = "apb_pclk";
   resets = <&rcc 3280>;
   cap-sd-highspeed;
   cap-mmc-highspeed;
   max-frequency = <120000000>;
   status = "disabled";
  };

  sdmmc2: mmc@58007000 {
   compatible = "st,stm32-sdmmc2", "arm,pl18x", "arm,primecell";
   arm,primecell-periphid = <0x00253180>;
   reg = <0x58007000 0x1000>;
   interrupts = <0 124 4>;
   interrupt-names = "cmd_irq";
   clocks = <&rcc 119>;
   clock-names = "apb_pclk";
   resets = <&rcc 3281>;
   cap-sd-highspeed;
   cap-mmc-highspeed;
   max-frequency = <120000000>;
   status = "disabled";
  };

  crc1: crc@58009000 {
   compatible = "st,stm32f7-crc";
   reg = <0x58009000 0x400>;
   clocks = <&rcc 110>;
   status = "disabled";
  };

  ethernet0: ethernet@5800a000 {
   compatible = "st,stm32mp1-dwmac", "snps,dwmac-4.20a";
   reg = <0x5800a000 0x2000>;
   reg-names = "stmmaceth";
   interrupts-extended = <&intc 0 61 4>;
   interrupt-names = "macirq";
   clock-names = "stmmaceth",
          "mac-clk-tx",
          "mac-clk-rx",
          "eth-ck",
          "ptp_ref",
          "ethstp";
   clocks = <&rcc 105>,
     <&rcc 103>,
     <&rcc 104>,
     <&rcc 123>,
     <&rcc 169>,
     <&rcc 112>;
   st,syscon = <&syscfg 0x4>;
   snps,mixed-burst;
   snps,pbl = <2>;
   snps,en-tx-lpi-clockgating;
   snps,axi-config = <&stmmac_axi_config_0>;
   snps,tso;
   status = "disabled";

   stmmac_axi_config_0: stmmac-axi-config {
    snps,wr_osr_lmt = <0x7>;
    snps,rd_osr_lmt = <0x7>;
    snps,blen = <0 0 0 0 16 8 4>;
   };
  };

  usbh_ohci: usb@5800c000 {
   compatible = "generic-ohci";
   reg = <0x5800c000 0x1000>;
   clocks = <&usbphyc>, <&rcc 111>;
   resets = <&rcc 3288>;
   interrupts = <0 74 4>;
   status = "disabled";
  };

  usbh_ehci: usb@5800d000 {
   compatible = "generic-ehci";
   reg = <0x5800d000 0x1000>;
   clocks = <&usbphyc>, <&rcc 111>;
   resets = <&rcc 3288>;
   interrupts = <0 75 4>;
   companion = <&usbh_ohci>;
   status = "disabled";
  };

  ltdc: display-controller@5a001000 {
   compatible = "st,stm32-ltdc";
   reg = <0x5a001000 0x400>;
   interrupts = <0 88 4>,
         <0 89 4>;
   clocks = <&rcc 167>;
   clock-names = "lcd";
   resets = <&rcc 3072>;
   status = "disabled";

   port {
    #address-cells = <1>;
    #size-cells = <0>;
   };
  };

  iwdg2: watchdog@5a002000 {
   compatible = "st,stm32mp1-iwdg";
   reg = <0x5a002000 0x400>;
   interrupts = <0 151 4>;
   clocks = <&rcc 58>, <&rcc 2>;
   clock-names = "pclk", "lsi";
   status = "disabled";
  };

  usbphyc: usbphyc@5a006000 {
   #address-cells = <1>;
   #size-cells = <0>;
   #clock-cells = <0>;
   compatible = "st,stm32mp1-usbphyc";
   reg = <0x5a006000 0x1000>;
   clocks = <&rcc 127>;
   resets = <&rcc 3088>;
   vdda1v1-supply = <&reg11>;
   vdda1v8-supply = <&reg18>;
   status = "disabled";

   usbphyc_port0: usb-phy@0 {
    #phy-cells = <0>;
    reg = <0>;
   };

   usbphyc_port1: usb-phy@1 {
    #phy-cells = <1>;
    reg = <1>;
   };
  };
  rtc: rtc@5c004000 {
   compatible = "st,stm32mp1-rtc";
   reg = <0x5c004000 0x400>;
   clocks = <&rcc 65>, <&rcc 192>;
   clock-names = "pclk", "rtc_ck";
   status = "disabled";
  };

  bsec: efuse@5c005000 {
   compatible = "st,stm32mp15-bsec";
   reg = <0x5c005000 0x400>;
   clocks = <&rcc 69>;
   #address-cells = <1>;
   #size-cells = <1>;

   cfg0_otp: cfg0_otp@0 {
    reg = <0x0 0x1>;
   };
   part_number_otp: part_number_otp@4 {
    reg = <0x4 0x1>;
   };
   monotonic_otp: monotonic_otp@10 {
    reg = <0x10 0x4>;
   };
   nand_otp: nand_otp@24 {
    reg = <0x24 0x4>;
   };
   uid_otp: uid_otp@34 {
    reg = <0x34 0xc>;
   };
   package_otp: package_otp@40 {
    reg = <0x40 0x4>;
   };
   hw2_otp: hw2_otp@48 {
    reg = <0x48 0x4>;
   };
   ts_cal1: calib@5c {
    reg = <0x5c 0x2>;
   };
   ts_cal2: calib@5e {
    reg = <0x5e 0x2>;
   };
   pkh_otp: pkh_otp@60 {
    reg = <0x60 0x20>;
   };
   ethernet_mac_address: mac@e4 {
    reg = <0xe4 0x8>;
    st,non-secure-otp;
   };
  };

  tzc400: tzc@5c006000 {
   compatible = "st,stm32mp1-tzc";
   reg = <0x5c006000 0x1000>;
   interrupts = <0 4 4>;
   clocks = <&rcc 66>, <&rcc 113>;
   st,mem-map = <0xc0000000 0x40000000>;
  };

  tamp: tamp@5c00a000 {
   compatible = "st,stm32-tamp", "syscon", "simple-mfd";
   #address-cells = <1>;
   #size-cells = <1>;
   reg = <0x5c00a000 0x400>;
   interrupts = <0 197 4>;
   clocks = <&rcc 65>;
   ranges;
   st,backup-zones = <10 5 17>;

   nvram: nvram@5c00a100 {
    compatible = "st,stm32mp15-tamp-nvram";
    #address-cells = <1>;
    #size-cells = <1>;
    reg = <0x5c00a100 0x80>;

    wakeup_sec: tamp-bkp@0 {
     reg = <0x0 0x4>;
    };

    m4_security_perimeter_exti1: tamp-bkp@4 {

     reg = <0x4 0x4>;
    };

    m4_security_perimeter_exti2: tamp-bkp@8 {

     reg = <0x8 0x4>;
    };

    m4_security_perimeter_exti3: tamp-bkp@c {

     reg = <0xc 0x4>;
    };

    magic_number: tamp-bkp@10 {

     reg = <0x10 0x4>;
    };

    branch_address: tamp-bkp@14 {

     reg = <0x14 0x4>;
    };

    fwu_info: tamp-bkp@28 {

     reg = <0x28 0x4>;
    };

    copro_rsc_tbl_address: tamp-bkp@44 {

     reg = <0x44 0x4>;
    };

    cortex_m_state: tamp-bkp@48 {

     reg = <0x48 0x4>;
    };

    boot_mode: tamp-bkp@50 {

     reg = <0x50 0x4>;
    };

    boot_counter: tamp-bkp@54 {

     reg = <0x54 0x4>;
    };

    m4_wakeup_area_start: tamp-bkp@58 {

     reg = <0x58 0x4>;
    };

    m4_wakeup_area_length: tamp-bkp@5c {

     reg = <0x5c 0x4>;
    };

    m4_wakeup_area_hash: tamp-bkp@60 {

     reg = <0x60 0x20>;
    };
   };

   reboot_mode: reboot-mode {
    compatible = "nvmem-reboot-mode";
    nvmem-cells = <&boot_mode>;
    nvmem-cell-names = "reboot-mode";
    mode-normal = <0x00>;
    mode-fastboot = <0x01>;
    mode-recovery = <0x02>;
    mode-stm32cubeprogrammer = <0x03>;
    mode-ums_mmc0 = <0x10>;
    mode-ums_mmc1 = <0x11>;
    mode-ums_mmc2 = <0x12>;
    mode-romcode_serial = <0xff>;
   };
  };





  pinctrl: pin-controller@50002000 {
   #address-cells = <1>;
   #size-cells = <1>;
   compatible = "st,stm32mp157-pinctrl";
   ranges = <0 0x50002000 0xa400>;
   interrupt-parent = <&exti>;
   st,syscfg = <&exti 0x60 0xff>;
   pins-are-numbered;

   gpioa: gpio@50002000 {
    gpio-controller;
    #gpio-cells = <2>;
    interrupt-controller;
    #interrupt-cells = <2>;
    reg = <0x0 0x400>;
    clocks = <&rcc 84>;
    st,bank-name = "GPIOA";
    status = "disabled";
   };

   gpiob: gpio@50003000 {
    gpio-controller;
    #gpio-cells = <2>;
    interrupt-controller;
    #interrupt-cells = <2>;
    reg = <0x1000 0x400>;
    clocks = <&rcc 85>;
    st,bank-name = "GPIOB";
    status = "disabled";
   };

   gpioc: gpio@50004000 {
    gpio-controller;
    #gpio-cells = <2>;
    interrupt-controller;
    #interrupt-cells = <2>;
    reg = <0x2000 0x400>;
    clocks = <&rcc 86>;
    st,bank-name = "GPIOC";
    status = "disabled";
   };

   gpiod: gpio@50005000 {
    gpio-controller;
    #gpio-cells = <2>;
    interrupt-controller;
    #interrupt-cells = <2>;
    reg = <0x3000 0x400>;
    clocks = <&rcc 87>;
    st,bank-name = "GPIOD";
    status = "disabled";
   };

   gpioe: gpio@50006000 {
    gpio-controller;
    #gpio-cells = <2>;
    interrupt-controller;
    #interrupt-cells = <2>;
    reg = <0x4000 0x400>;
    clocks = <&rcc 88>;
    st,bank-name = "GPIOE";
    status = "disabled";
   };

   gpiof: gpio@50007000 {
    gpio-controller;
    #gpio-cells = <2>;
    interrupt-controller;
    #interrupt-cells = <2>;
    reg = <0x5000 0x400>;
    clocks = <&rcc 89>;
    st,bank-name = "GPIOF";
    status = "disabled";
   };

   gpiog: gpio@50008000 {
    gpio-controller;
    #gpio-cells = <2>;
    interrupt-controller;
    #interrupt-cells = <2>;
    reg = <0x6000 0x400>;
    clocks = <&rcc 90>;
    st,bank-name = "GPIOG";
    status = "disabled";
   };

   gpioh: gpio@50009000 {
    gpio-controller;
    #gpio-cells = <2>;
    interrupt-controller;
    #interrupt-cells = <2>;
    reg = <0x7000 0x400>;
    clocks = <&rcc 91>;
    st,bank-name = "GPIOH";
    status = "disabled";
   };

   gpioi: gpio@5000a000 {
    gpio-controller;
    #gpio-cells = <2>;
    interrupt-controller;
    #interrupt-cells = <2>;
    reg = <0x8000 0x400>;
    clocks = <&rcc 92>;
    st,bank-name = "GPIOI";
    status = "disabled";
   };

   gpioj: gpio@5000b000 {
    gpio-controller;
    #gpio-cells = <2>;
    interrupt-controller;
    #interrupt-cells = <2>;
    reg = <0x9000 0x400>;
    clocks = <&rcc 93>;
    st,bank-name = "GPIOJ";
    status = "disabled";
   };

   gpiok: gpio@5000c000 {
    gpio-controller;
    #gpio-cells = <2>;
    interrupt-controller;
    #interrupt-cells = <2>;
    reg = <0xa000 0x400>;
    clocks = <&rcc 94>;
    st,bank-name = "GPIOK";
    status = "disabled";
   };
  };

  pinctrl_z: pin-controller-z@54004000 {
   #address-cells = <1>;
   #size-cells = <1>;
   compatible = "st,stm32mp157-z-pinctrl";
   ranges = <0 0x54004000 0x400>;
   pins-are-numbered;
   interrupt-parent = <&exti>;
   st,syscfg = <&exti 0x60 0xff>;

   gpioz: gpio@54004000 {
    gpio-controller;
    #gpio-cells = <2>;
    interrupt-controller;
    #interrupt-cells = <2>;
    reg = <0 0x400>;
    clocks = <&rcc 95>;
    st,bank-name = "GPIOZ";
    st,bank-ioport = <11>;
    status = "disabled";
   };
  };

  etzpc: etzpc@5c007000 {
   compatible = "st,stm32-etzpc", "firewall-bus";
   reg = <0x5C007000 0x400>;
   clocks = <&rcc 67>;
   #address-cells = <1>;
   #size-cells = <1>;

   hash1: hash@54002000 {
    compatible = "st,stm32f756-hash";
    reg = <0x54002000 0x400>;
    interrupts = <0 80 4>;
    clocks = <&rcc 97>;
    resets = <&rcc 3205>;
    dmas = <&mdma1 31 0x2 0x1000A02 0x0 0x0>;
    dma-names = "in";
    dma-maxburst = <2>;
    status = "disabled";
   };

   rng1: rng@54003000 {
    compatible = "st,stm32-rng";
    reg = <0x54003000 0x400>;
    clocks = <&rcc 124>;
    resets = <&rcc 3206>;
    status = "disabled";
   };

   usart1: serial@5c000000 {
    compatible = "st,stm32h7-uart";
    reg = <0x5c000000 0x400>;
    interrupts-extended = <&exti 26 4>;
    clocks = <&rcc 148>;
    wakeup-source;
    status = "disabled";
   };

   spi6: spi@5c001000 {
    #address-cells = <1>;
    #size-cells = <0>;
    compatible = "st,stm32h7-spi";
    reg = <0x5c001000 0x400>;
    interrupts = <0 86 4>;
    clocks = <&rcc 135>;
    resets = <&rcc 3136>;
    dmas = <&mdma1 34 0x0 0x40008 0x0 0x0>,
    <&mdma1 35 0x0 0x40002 0x0 0x0>;
    dma-names = "rx", "tx";
    status = "disabled";
   };

   i2c4: i2c@5c002000 {
    compatible = "st,stm32mp15-i2c";
    reg = <0x5c002000 0x400>;
    interrupt-names = "event", "error";
    interrupts = <0 95 4>,
          <0 96 4>;
    clocks = <&rcc 140>;
    resets = <&rcc 3138>;
    #address-cells = <1>;
    #size-cells = <0>;
    st,syscfg-fmp = <&syscfg 0x4 0x8>;
    wakeup-source;
    i2c-analog-filter;
    status = "disabled";
   };

   iwdg1: watchdog@5c003000 {
    compatible = "st,stm32mp1-iwdg";
    reg = <0x5C003000 0x400>;
    interrupts = <0 150 4>;
    clocks = <&rcc 68>, <&rcc 2>;
    clock-names = "pclk", "lsi";
    status = "disabled";
   };

   i2c6: i2c@5c009000 {
    compatible = "st,stm32mp15-i2c";
    reg = <0x5c009000 0x400>;
    interrupt-names = "event", "error";
    interrupts = <0 135 4>,
          <0 136 4>;
    clocks = <&rcc 142>;
    resets = <&rcc 3139>;
    #address-cells = <1>;
    #size-cells = <0>;
    st,syscfg-fmp = <&syscfg 0x4 0x20>;
    wakeup-source;
    i2c-analog-filter;
    status = "disabled";
   };

   stgen: stgen@5c008000 {
    compatible = "st,stm32-stgen";
    reg = <0x5C008000 0x1000>;
   };
  };
 };

 mlahb: ahb {
  compatible = "st,mlahb", "simple-bus";
  #address-cells = <1>;
  #size-cells = <1>;
  ranges;
  dma-ranges = <0x00000000 0x38000000 0x10000>,
        <0x10000000 0x10000000 0x60000>,
        <0x30000000 0x10000000 0x60000>;

  m4_rproc: m4@10000000 {
   compatible = "st,stm32mp1-m4";
   reg = <0x10000000 0x40000>,
         <0x30000000 0x40000>,
         <0x38000000 0x10000>;
   resets = <&rcc 8225>, <&rcc 2144>;
   reset-names = "mcu_rst", "hold_boot";
   st,syscfg-tz = <&rcc 0x000 0x1>;
   st,syscfg-pdds = <&pwr_mcu 0x0 0x1>;
   st,syscfg-rsc-tbl = <&tamp 0x144 0xFFFFFFFF>;
   st,syscfg-m4-state = <&tamp 0x148 0xFFFFFFFF>;
   status = "disabled";
  };
 };
};
# 17 "core/arch/arm/dts/stm32mp151a-stm32-computer-firmware-mx.dts" 2
# 1 "core/arch/arm/dts/stm32mp15xa.dtsi" 1
# 18 "core/arch/arm/dts/stm32mp151a-stm32-computer-firmware-mx.dts" 2
# 1 "core/arch/arm/dts/stm32mp15xxac-pinctrl.dtsi" 1






&pinctrl {
 st,package = <0x4>;

 gpioa: gpio@50002000 {
  status = "okay";
  ngpios = <16>;
  gpio-ranges = <&pinctrl 0 0 16>;
 };

 gpiob: gpio@50003000 {
  status = "okay";
  ngpios = <16>;
  gpio-ranges = <&pinctrl 0 16 16>;
 };

 gpioc: gpio@50004000 {
  status = "okay";
  ngpios = <16>;
  gpio-ranges = <&pinctrl 0 32 16>;
 };

 gpiod: gpio@50005000 {
  status = "okay";
  ngpios = <16>;
  gpio-ranges = <&pinctrl 0 48 16>;
 };

 gpioe: gpio@50006000 {
  status = "okay";
  ngpios = <16>;
  gpio-ranges = <&pinctrl 0 64 16>;
 };

 gpiof: gpio@50007000 {
  status = "okay";
  ngpios = <16>;
  gpio-ranges = <&pinctrl 0 80 16>;
 };

 gpiog: gpio@50008000 {
  status = "okay";
  ngpios = <16>;
  gpio-ranges = <&pinctrl 0 96 16>;
 };

 gpioh: gpio@50009000 {
  status = "okay";
  ngpios = <16>;
  gpio-ranges = <&pinctrl 0 112 16>;
 };

 gpioi: gpio@5000a000 {
  status = "okay";
  ngpios = <12>;
  gpio-ranges = <&pinctrl 0 128 12>;
 };
};

&pinctrl_z {
 st,package = <0x4>;

 gpioz: gpio@54004000 {
  status = "okay";
  ngpios = <8>;
  gpio-ranges = <&pinctrl_z 0 400 8>;
 };
};
# 19 "core/arch/arm/dts/stm32mp151a-stm32-computer-firmware-mx.dts" 2




# 1 "core/arch/arm/dts/stm32mp15-pinctrl.dtsi" 1







&pinctrl {
 adc1_in6_pins_a: adc1-in6-0 {
  pins {
   pinmux = <(((((('F') - 'A') * 0x10 + (12))) << 8) | (0x11))>;
  };
 };

 adc12_ain_pins_a: adc12-ain-0 {
  pins {
   pinmux = <(((((('C') - 'A') * 0x10 + (3))) << 8) | (0x11))>,
     <(((((('F') - 'A') * 0x10 + (12))) << 8) | (0x11))>,
     <(((((('F') - 'A') * 0x10 + (13))) << 8) | (0x11))>,
     <(((((('F') - 'A') * 0x10 + (14))) << 8) | (0x11))>;
  };
 };

 adc12_ain_pins_b: adc12-ain-1 {
  pins {
   pinmux = <(((((('F') - 'A') * 0x10 + (12))) << 8) | (0x11))>,
     <(((((('F') - 'A') * 0x10 + (13))) << 8) | (0x11))>;
  };
 };

 adc12_usb_cc_pins_a: adc12-usb-cc-pins-0 {
  pins {
   pinmux = <(((((('A') - 'A') * 0x10 + (4))) << 8) | (0x11))>,
     <(((((('A') - 'A') * 0x10 + (5))) << 8) | (0x11))>;
  };
 };

 cec_pins_a: cec-0 {
  pins {
   pinmux = <(((((('A') - 'A') * 0x10 + (15))) << 8) | (0x5))>;
   bias-disable;
   drive-open-drain;
   slew-rate = <0>;
  };
 };

 cec_sleep_pins_a: cec-sleep-0 {
  pins {
   pinmux = <(((((('A') - 'A') * 0x10 + (15))) << 8) | (0x11))>;
  };
 };

 cec_pins_b: cec-1 {
  pins {
   pinmux = <(((((('B') - 'A') * 0x10 + (6))) << 8) | (0x6))>;
   bias-disable;
   drive-open-drain;
   slew-rate = <0>;
  };
 };

 cec_sleep_pins_b: cec-sleep-1 {
  pins {
   pinmux = <(((((('B') - 'A') * 0x10 + (6))) << 8) | (0x11))>;
  };
 };

 dac_ch1_pins_a: dac-ch1-0 {
  pins {
   pinmux = <(((((('A') - 'A') * 0x10 + (4))) << 8) | (0x11))>;
  };
 };

 dac_ch2_pins_a: dac-ch2-0 {
  pins {
   pinmux = <(((((('A') - 'A') * 0x10 + (5))) << 8) | (0x11))>;
  };
 };

 dcmi_pins_a: dcmi-0 {
  pins {
   pinmux = <(((((('H') - 'A') * 0x10 + (8))) << 8) | (0xe))>,
     <(((((('B') - 'A') * 0x10 + (7))) << 8) | (0xe))>,
     <(((((('A') - 'A') * 0x10 + (6))) << 8) | (0xe))>,
     <(((((('H') - 'A') * 0x10 + (9))) << 8) | (0xe))>,
     <(((((('H') - 'A') * 0x10 + (10))) << 8) | (0xe))>,
     <(((((('H') - 'A') * 0x10 + (11))) << 8) | (0xe))>,
     <(((((('H') - 'A') * 0x10 + (12))) << 8) | (0xe))>,
     <(((((('H') - 'A') * 0x10 + (14))) << 8) | (0xe))>,
     <(((((('I') - 'A') * 0x10 + (4))) << 8) | (0xe))>,
     <(((((('B') - 'A') * 0x10 + (8))) << 8) | (0xe))>,
     <(((((('E') - 'A') * 0x10 + (6))) << 8) | (0xe))>,
     <(((((('I') - 'A') * 0x10 + (1))) << 8) | (0xe))>,
     <(((((('H') - 'A') * 0x10 + (7))) << 8) | (0xe))>,
     <(((((('I') - 'A') * 0x10 + (3))) << 8) | (0xe))>,
     <(((((('H') - 'A') * 0x10 + (15))) << 8) | (0xe))>;
   bias-disable;
  };
 };

 dcmi_sleep_pins_a: dcmi-sleep-0 {
  pins {
   pinmux = <(((((('H') - 'A') * 0x10 + (8))) << 8) | (0x11))>,
     <(((((('B') - 'A') * 0x10 + (7))) << 8) | (0x11))>,
     <(((((('A') - 'A') * 0x10 + (6))) << 8) | (0x11))>,
     <(((((('H') - 'A') * 0x10 + (9))) << 8) | (0x11))>,
     <(((((('H') - 'A') * 0x10 + (10))) << 8) | (0x11))>,
     <(((((('H') - 'A') * 0x10 + (11))) << 8) | (0x11))>,
     <(((((('H') - 'A') * 0x10 + (12))) << 8) | (0x11))>,
     <(((((('H') - 'A') * 0x10 + (14))) << 8) | (0x11))>,
     <(((((('I') - 'A') * 0x10 + (4))) << 8) | (0x11))>,
     <(((((('B') - 'A') * 0x10 + (8))) << 8) | (0x11))>,
     <(((((('E') - 'A') * 0x10 + (6))) << 8) | (0x11))>,
     <(((((('I') - 'A') * 0x10 + (1))) << 8) | (0x11))>,
     <(((((('H') - 'A') * 0x10 + (7))) << 8) | (0x11))>,
     <(((((('I') - 'A') * 0x10 + (3))) << 8) | (0x11))>,
     <(((((('H') - 'A') * 0x10 + (15))) << 8) | (0x11))>;
  };
 };

 dcmi_pins_b: dcmi-1 {
  pins {
   pinmux = <(((((('A') - 'A') * 0x10 + (4))) << 8) | (0xe))>,
     <(((((('B') - 'A') * 0x10 + (7))) << 8) | (0xe))>,
     <(((((('A') - 'A') * 0x10 + (6))) << 8) | (0xe))>,
     <(((((('C') - 'A') * 0x10 + (6))) << 8) | (0xe))>,
     <(((((('H') - 'A') * 0x10 + (10))) << 8) | (0xe))>,
     <(((((('H') - 'A') * 0x10 + (11))) << 8) | (0xe))>,
     <(((((('E') - 'A') * 0x10 + (1))) << 8) | (0xe))>,
     <(((((('E') - 'A') * 0x10 + (11))) << 8) | (0xe))>,
     <(((((('D') - 'A') * 0x10 + (3))) << 8) | (0xe))>,
     <(((((('E') - 'A') * 0x10 + (13))) << 8) | (0xe))>,
     <(((((('B') - 'A') * 0x10 + (9))) << 8) | (0xe))>;
   bias-disable;
  };
 };

 dcmi_sleep_pins_b: dcmi-sleep-1 {
  pins {
   pinmux = <(((((('A') - 'A') * 0x10 + (4))) << 8) | (0x11))>,
     <(((((('B') - 'A') * 0x10 + (7))) << 8) | (0x11))>,
     <(((((('A') - 'A') * 0x10 + (6))) << 8) | (0x11))>,
     <(((((('C') - 'A') * 0x10 + (6))) << 8) | (0x11))>,
     <(((((('H') - 'A') * 0x10 + (10))) << 8) | (0x11))>,
     <(((((('H') - 'A') * 0x10 + (11))) << 8) | (0x11))>,
     <(((((('E') - 'A') * 0x10 + (1))) << 8) | (0x11))>,
     <(((((('E') - 'A') * 0x10 + (11))) << 8) | (0x11))>,
     <(((((('D') - 'A') * 0x10 + (3))) << 8) | (0x11))>,
     <(((((('E') - 'A') * 0x10 + (13))) << 8) | (0x11))>,
     <(((((('B') - 'A') * 0x10 + (9))) << 8) | (0x11))>;
  };
 };

 ethernet0_rgmii_pins_a: rgmii-0 {
  pins1 {
   pinmux = <(((((('G') - 'A') * 0x10 + (5))) << 8) | (0xc))>,
     <(((((('G') - 'A') * 0x10 + (4))) << 8) | (0xc))>,
     <(((((('G') - 'A') * 0x10 + (13))) << 8) | (0xc))>,
     <(((((('G') - 'A') * 0x10 + (14))) << 8) | (0xc))>,
     <(((((('C') - 'A') * 0x10 + (2))) << 8) | (0xc))>,
     <(((((('E') - 'A') * 0x10 + (2))) << 8) | (0xc))>,
     <(((((('B') - 'A') * 0x10 + (11))) << 8) | (0xc))>,
     <(((((('C') - 'A') * 0x10 + (1))) << 8) | (0xc))>;
   bias-disable;
   drive-push-pull;
   slew-rate = <2>;
  };
  pins2 {
   pinmux = <(((((('A') - 'A') * 0x10 + (2))) << 8) | (0xc))>;
   bias-disable;
   drive-push-pull;
   slew-rate = <0>;
  };
  pins3 {
   pinmux = <(((((('C') - 'A') * 0x10 + (4))) << 8) | (0xc))>,
     <(((((('C') - 'A') * 0x10 + (5))) << 8) | (0xc))>,
     <(((((('B') - 'A') * 0x10 + (0))) << 8) | (0xc))>,
     <(((((('B') - 'A') * 0x10 + (1))) << 8) | (0xc))>,
     <(((((('A') - 'A') * 0x10 + (1))) << 8) | (0xc))>,
     <(((((('A') - 'A') * 0x10 + (7))) << 8) | (0xc))>;
   bias-disable;
  };
 };

 ethernet0_rgmii_sleep_pins_a: rgmii-sleep-0 {
  pins1 {
   pinmux = <(((((('G') - 'A') * 0x10 + (5))) << 8) | (0x11))>,
     <(((((('G') - 'A') * 0x10 + (4))) << 8) | (0x11))>,
     <(((((('G') - 'A') * 0x10 + (13))) << 8) | (0x11))>,
     <(((((('G') - 'A') * 0x10 + (14))) << 8) | (0x11))>,
     <(((((('C') - 'A') * 0x10 + (2))) << 8) | (0x11))>,
     <(((((('E') - 'A') * 0x10 + (2))) << 8) | (0x11))>,
     <(((((('B') - 'A') * 0x10 + (11))) << 8) | (0x11))>,
     <(((((('A') - 'A') * 0x10 + (2))) << 8) | (0x11))>,
     <(((((('C') - 'A') * 0x10 + (1))) << 8) | (0x11))>,
     <(((((('C') - 'A') * 0x10 + (4))) << 8) | (0x11))>,
     <(((((('C') - 'A') * 0x10 + (5))) << 8) | (0x11))>,
     <(((((('B') - 'A') * 0x10 + (0))) << 8) | (0x11))>,
     <(((((('B') - 'A') * 0x10 + (1))) << 8) | (0x11))>,
     <(((((('A') - 'A') * 0x10 + (1))) << 8) | (0x11))>,
     <(((((('A') - 'A') * 0x10 + (7))) << 8) | (0x11))>;
  };
 };

 ethernet0_rgmii_pins_b: rgmii-1 {
  pins1 {
   pinmux = <(((((('G') - 'A') * 0x10 + (5))) << 8) | (0xc))>,
     <(((((('G') - 'A') * 0x10 + (4))) << 8) | (0xc))>,
     <(((((('G') - 'A') * 0x10 + (13))) << 8) | (0xc))>,
     <(((((('G') - 'A') * 0x10 + (14))) << 8) | (0xc))>,
     <(((((('C') - 'A') * 0x10 + (2))) << 8) | (0xc))>,
     <(((((('E') - 'A') * 0x10 + (2))) << 8) | (0xc))>,
     <(((((('B') - 'A') * 0x10 + (11))) << 8) | (0xc))>,
     <(((((('C') - 'A') * 0x10 + (1))) << 8) | (0xc))>;
   bias-disable;
   drive-push-pull;
   slew-rate = <2>;
  };
  pins2 {
   pinmux = <(((((('A') - 'A') * 0x10 + (2))) << 8) | (0xc))>;
   bias-disable;
   drive-push-pull;
   slew-rate = <0>;
  };
  pins3 {
   pinmux = <(((((('C') - 'A') * 0x10 + (4))) << 8) | (0xc))>,
     <(((((('C') - 'A') * 0x10 + (5))) << 8) | (0xc))>,
     <(((((('H') - 'A') * 0x10 + (6))) << 8) | (0xc))>,
     <(((((('H') - 'A') * 0x10 + (7))) << 8) | (0xc))>,
     <(((((('A') - 'A') * 0x10 + (1))) << 8) | (0xc))>,
     <(((((('A') - 'A') * 0x10 + (7))) << 8) | (0xc))>;
   bias-disable;
  };
 };

 ethernet0_rgmii_sleep_pins_b: rgmii-sleep-1 {
  pins1 {
   pinmux = <(((((('G') - 'A') * 0x10 + (5))) << 8) | (0x11))>,
     <(((((('G') - 'A') * 0x10 + (4))) << 8) | (0x11))>,
     <(((((('G') - 'A') * 0x10 + (13))) << 8) | (0x11))>,
     <(((((('G') - 'A') * 0x10 + (14))) << 8) | (0x11))>,
     <(((((('C') - 'A') * 0x10 + (2))) << 8) | (0x11))>,
     <(((((('E') - 'A') * 0x10 + (2))) << 8) | (0x11))>,
     <(((((('B') - 'A') * 0x10 + (11))) << 8) | (0x11))>,
     <(((((('C') - 'A') * 0x10 + (1))) << 8) | (0x11))>,
     <(((((('A') - 'A') * 0x10 + (2))) << 8) | (0x11))>,
     <(((((('C') - 'A') * 0x10 + (4))) << 8) | (0x11))>,
     <(((((('C') - 'A') * 0x10 + (5))) << 8) | (0x11))>,
     <(((((('H') - 'A') * 0x10 + (6))) << 8) | (0x11))>,
     <(((((('H') - 'A') * 0x10 + (7))) << 8) | (0x11))>,
     <(((((('A') - 'A') * 0x10 + (1))) << 8) | (0x11))>,
     <(((((('A') - 'A') * 0x10 + (7))) << 8) | (0x11))>;
   };
 };

 ethernet0_rgmii_pins_c: rgmii-2 {
  pins1 {
   pinmux = <(((((('G') - 'A') * 0x10 + (5))) << 8) | (0xc))>,
     <(((((('G') - 'A') * 0x10 + (4))) << 8) | (0xc))>,
     <(((((('B') - 'A') * 0x10 + (12))) << 8) | (0xc))>,
     <(((((('G') - 'A') * 0x10 + (14))) << 8) | (0xc))>,
     <(((((('C') - 'A') * 0x10 + (2))) << 8) | (0xc))>,
     <(((((('E') - 'A') * 0x10 + (2))) << 8) | (0xc))>,
     <(((((('G') - 'A') * 0x10 + (11))) << 8) | (0xc))>,
     <(((((('C') - 'A') * 0x10 + (1))) << 8) | (0xc))>;
   bias-disable;
   drive-push-pull;
   slew-rate = <2>;
  };
  pins2 {
   pinmux = <(((((('A') - 'A') * 0x10 + (2))) << 8) | (0xc))>;
   bias-disable;
   drive-push-pull;
   slew-rate = <0>;
  };
  pins3 {
   pinmux = <(((((('C') - 'A') * 0x10 + (4))) << 8) | (0xc))>,
     <(((((('C') - 'A') * 0x10 + (5))) << 8) | (0xc))>,
     <(((((('H') - 'A') * 0x10 + (6))) << 8) | (0xc))>,
     <(((((('B') - 'A') * 0x10 + (1))) << 8) | (0xc))>,
     <(((((('A') - 'A') * 0x10 + (1))) << 8) | (0xc))>,
     <(((((('A') - 'A') * 0x10 + (7))) << 8) | (0xc))>;
   bias-disable;
  };
 };

 ethernet0_rgmii_sleep_pins_c: rgmii-sleep-2 {
  pins1 {
   pinmux = <(((((('G') - 'A') * 0x10 + (5))) << 8) | (0x11))>,
     <(((((('G') - 'A') * 0x10 + (4))) << 8) | (0x11))>,
     <(((((('B') - 'A') * 0x10 + (12))) << 8) | (0x11))>,
     <(((((('G') - 'A') * 0x10 + (14))) << 8) | (0x11))>,
     <(((((('C') - 'A') * 0x10 + (2))) << 8) | (0x11))>,
     <(((((('E') - 'A') * 0x10 + (2))) << 8) | (0x11))>,
     <(((((('G') - 'A') * 0x10 + (11))) << 8) | (0x11))>,
     <(((((('A') - 'A') * 0x10 + (2))) << 8) | (0x11))>,
     <(((((('C') - 'A') * 0x10 + (1))) << 8) | (0x11))>,
     <(((((('C') - 'A') * 0x10 + (4))) << 8) | (0x11))>,
     <(((((('C') - 'A') * 0x10 + (5))) << 8) | (0x11))>,
     <(((((('H') - 'A') * 0x10 + (6))) << 8) | (0x11))>,
     <(((((('B') - 'A') * 0x10 + (1))) << 8) | (0x11))>,
     <(((((('A') - 'A') * 0x10 + (1))) << 8) | (0x11))>,
     <(((((('A') - 'A') * 0x10 + (7))) << 8) | (0x11))>;
  };
 };

 ethernet0_rmii_pins_a: rmii-0 {
  pins1 {
   pinmux = <(((((('G') - 'A') * 0x10 + (13))) << 8) | (0xc))>,
     <(((((('G') - 'A') * 0x10 + (14))) << 8) | (0xc))>,
     <(((((('B') - 'A') * 0x10 + (11))) << 8) | (0xc))>,
     <(((((('A') - 'A') * 0x10 + (1))) << 8) | (0x1))>,
     <(((((('A') - 'A') * 0x10 + (2))) << 8) | (0xc))>,
     <(((((('C') - 'A') * 0x10 + (1))) << 8) | (0xc))>;
   bias-disable;
   drive-push-pull;
   slew-rate = <2>;
  };
  pins2 {
   pinmux = <(((((('C') - 'A') * 0x10 + (4))) << 8) | (0xc))>,
     <(((((('C') - 'A') * 0x10 + (5))) << 8) | (0xc))>,
     <(((((('A') - 'A') * 0x10 + (7))) << 8) | (0xc))>;
   bias-disable;
  };
 };

 ethernet0_rmii_sleep_pins_a: rmii-sleep-0 {
  pins1 {
   pinmux = <(((((('G') - 'A') * 0x10 + (13))) << 8) | (0x11))>,
     <(((((('G') - 'A') * 0x10 + (14))) << 8) | (0x11))>,
     <(((((('B') - 'A') * 0x10 + (11))) << 8) | (0x11))>,
     <(((((('A') - 'A') * 0x10 + (2))) << 8) | (0x11))>,
     <(((((('C') - 'A') * 0x10 + (1))) << 8) | (0x11))>,
     <(((((('C') - 'A') * 0x10 + (4))) << 8) | (0x11))>,
     <(((((('C') - 'A') * 0x10 + (5))) << 8) | (0x11))>,
     <(((((('A') - 'A') * 0x10 + (1))) << 8) | (0x11))>,
     <(((((('A') - 'A') * 0x10 + (7))) << 8) | (0x11))>;
  };
 };

 ethernet0_rmii_pins_b: rmii-1 {
  pins1 {
   pinmux = <(((((('B') - 'A') * 0x10 + (5))) << 8) | (0x1))>,
    <(((((('C') - 'A') * 0x10 + (1))) << 8) | (0xc))>,
    <(((((('G') - 'A') * 0x10 + (13))) << 8) | (0xc))>,
    <(((((('G') - 'A') * 0x10 + (14))) << 8) | (0xc))>;
   bias-disable;
   drive-push-pull;
   slew-rate = <1>;
  };
  pins2 {
   pinmux = <(((((('A') - 'A') * 0x10 + (2))) << 8) | (0xc))>;
   bias-disable;
   drive-push-pull;
   slew-rate = <0>;
  };
  pins3 {
   pinmux = <(((((('A') - 'A') * 0x10 + (7))) << 8) | (0xc))>,
    <(((((('C') - 'A') * 0x10 + (4))) << 8) | (0xc))>,
    <(((((('C') - 'A') * 0x10 + (5))) << 8) | (0xc))>;
   bias-disable;
  };
  pins4 {
   pinmux = <(((((('B') - 'A') * 0x10 + (11))) << 8) | (0xc))>;
  };
 };

 ethernet0_rmii_sleep_pins_b: rmii-sleep-1 {
  pins1 {
   pinmux = <(((((('A') - 'A') * 0x10 + (2))) << 8) | (0x11))>,
    <(((((('A') - 'A') * 0x10 + (7))) << 8) | (0x11))>,
    <(((((('B') - 'A') * 0x10 + (5))) << 8) | (0x11))>,
    <(((((('B') - 'A') * 0x10 + (11))) << 8) | (0x11))>,
    <(((((('C') - 'A') * 0x10 + (1))) << 8) | (0x11))>,
    <(((((('C') - 'A') * 0x10 + (4))) << 8) | (0x11))>,
    <(((((('C') - 'A') * 0x10 + (5))) << 8) | (0x11))>,
    <(((((('G') - 'A') * 0x10 + (13))) << 8) | (0x11))>,
    <(((((('G') - 'A') * 0x10 + (14))) << 8) | (0x11))>;
  };
 };

 ethernet0_rmii_pins_c: rmii-2 {
  pins1 {
   pinmux = <(((((('G') - 'A') * 0x10 + (13))) << 8) | (0xc))>,
     <(((((('G') - 'A') * 0x10 + (14))) << 8) | (0xc))>,
     <(((((('B') - 'A') * 0x10 + (11))) << 8) | (0xc))>,
     <(((((('A') - 'A') * 0x10 + (1))) << 8) | (0xc))>,
     <(((((('A') - 'A') * 0x10 + (2))) << 8) | (0xc))>,
     <(((((('C') - 'A') * 0x10 + (1))) << 8) | (0xc))>;
   bias-disable;
   drive-push-pull;
   slew-rate = <2>;
  };
  pins2 {
   pinmux = <(((((('C') - 'A') * 0x10 + (4))) << 8) | (0xc))>,
     <(((((('C') - 'A') * 0x10 + (5))) << 8) | (0xc))>,
     <(((((('A') - 'A') * 0x10 + (7))) << 8) | (0xc))>;
   bias-disable;
  };
 };

 ethernet0_rmii_sleep_pins_c: rmii-sleep-2 {
  pins1 {
   pinmux = <(((((('G') - 'A') * 0x10 + (13))) << 8) | (0x11))>,
     <(((((('G') - 'A') * 0x10 + (14))) << 8) | (0x11))>,
     <(((((('B') - 'A') * 0x10 + (11))) << 8) | (0x11))>,
     <(((((('A') - 'A') * 0x10 + (2))) << 8) | (0x11))>,
     <(((((('C') - 'A') * 0x10 + (1))) << 8) | (0x11))>,
     <(((((('C') - 'A') * 0x10 + (4))) << 8) | (0x11))>,
     <(((((('C') - 'A') * 0x10 + (5))) << 8) | (0x11))>,
     <(((((('A') - 'A') * 0x10 + (1))) << 8) | (0x11))>,
     <(((((('A') - 'A') * 0x10 + (7))) << 8) | (0x11))>;
  };
 };

 fmc_pins_a: fmc-0 {
  pins1 {
   pinmux = <(((((('D') - 'A') * 0x10 + (4))) << 8) | (0xd))>,
     <(((((('D') - 'A') * 0x10 + (5))) << 8) | (0xd))>,
     <(((((('D') - 'A') * 0x10 + (11))) << 8) | (0xd))>,
     <(((((('D') - 'A') * 0x10 + (12))) << 8) | (0xd))>,
     <(((((('D') - 'A') * 0x10 + (14))) << 8) | (0xd))>,
     <(((((('D') - 'A') * 0x10 + (15))) << 8) | (0xd))>,
     <(((((('D') - 'A') * 0x10 + (0))) << 8) | (0xd))>,
     <(((((('D') - 'A') * 0x10 + (1))) << 8) | (0xd))>,
     <(((((('E') - 'A') * 0x10 + (7))) << 8) | (0xd))>,
     <(((((('E') - 'A') * 0x10 + (8))) << 8) | (0xd))>,
     <(((((('E') - 'A') * 0x10 + (9))) << 8) | (0xd))>,
     <(((((('E') - 'A') * 0x10 + (10))) << 8) | (0xd))>,
     <(((((('G') - 'A') * 0x10 + (9))) << 8) | (0xd))>;
   bias-disable;
   drive-push-pull;
   slew-rate = <1>;
  };
  pins2 {
   pinmux = <(((((('D') - 'A') * 0x10 + (6))) << 8) | (0xd))>;
   bias-pull-up;
  };
 };

 fmc_sleep_pins_a: fmc-sleep-0 {
  pins {
   pinmux = <(((((('D') - 'A') * 0x10 + (4))) << 8) | (0x11))>,
     <(((((('D') - 'A') * 0x10 + (5))) << 8) | (0x11))>,
     <(((((('D') - 'A') * 0x10 + (11))) << 8) | (0x11))>,
     <(((((('D') - 'A') * 0x10 + (12))) << 8) | (0x11))>,
     <(((((('D') - 'A') * 0x10 + (14))) << 8) | (0x11))>,
     <(((((('D') - 'A') * 0x10 + (15))) << 8) | (0x11))>,
     <(((((('D') - 'A') * 0x10 + (0))) << 8) | (0x11))>,
     <(((((('D') - 'A') * 0x10 + (1))) << 8) | (0x11))>,
     <(((((('E') - 'A') * 0x10 + (7))) << 8) | (0x11))>,
     <(((((('E') - 'A') * 0x10 + (8))) << 8) | (0x11))>,
     <(((((('E') - 'A') * 0x10 + (9))) << 8) | (0x11))>,
     <(((((('E') - 'A') * 0x10 + (10))) << 8) | (0x11))>,
     <(((((('D') - 'A') * 0x10 + (6))) << 8) | (0x11))>,
     <(((((('G') - 'A') * 0x10 + (9))) << 8) | (0x11))>;
  };
 };

 fmc_pins_b: fmc-1 {
  pins {
   pinmux = <(((((('D') - 'A') * 0x10 + (4))) << 8) | (0xd))>,
     <(((((('D') - 'A') * 0x10 + (5))) << 8) | (0xd))>,
     <(((((('B') - 'A') * 0x10 + (7))) << 8) | (0xd))>,
     <(((((('D') - 'A') * 0x10 + (14))) << 8) | (0xd))>,
     <(((((('D') - 'A') * 0x10 + (15))) << 8) | (0xd))>,
     <(((((('D') - 'A') * 0x10 + (0))) << 8) | (0xd))>,
     <(((((('D') - 'A') * 0x10 + (1))) << 8) | (0xd))>,
     <(((((('E') - 'A') * 0x10 + (7))) << 8) | (0xd))>,
     <(((((('E') - 'A') * 0x10 + (8))) << 8) | (0xd))>,
     <(((((('E') - 'A') * 0x10 + (9))) << 8) | (0xd))>,
     <(((((('E') - 'A') * 0x10 + (10))) << 8) | (0xd))>,
     <(((((('E') - 'A') * 0x10 + (11))) << 8) | (0xd))>,
     <(((((('E') - 'A') * 0x10 + (12))) << 8) | (0xd))>,
     <(((((('E') - 'A') * 0x10 + (13))) << 8) | (0xd))>,
     <(((((('E') - 'A') * 0x10 + (14))) << 8) | (0xd))>,
     <(((((('E') - 'A') * 0x10 + (15))) << 8) | (0xd))>,
     <(((((('D') - 'A') * 0x10 + (8))) << 8) | (0xd))>,
     <(((((('D') - 'A') * 0x10 + (9))) << 8) | (0xd))>,
     <(((((('D') - 'A') * 0x10 + (10))) << 8) | (0xd))>,
     <(((((('G') - 'A') * 0x10 + (9))) << 8) | (0xd))>,
     <(((((('G') - 'A') * 0x10 + (12))) << 8) | (0xd))>;
   bias-disable;
   drive-push-pull;
   slew-rate = <3>;
  };
 };

 fmc_sleep_pins_b: fmc-sleep-1 {
  pins {
   pinmux = <(((((('D') - 'A') * 0x10 + (4))) << 8) | (0x11))>,
     <(((((('D') - 'A') * 0x10 + (5))) << 8) | (0x11))>,
     <(((((('B') - 'A') * 0x10 + (7))) << 8) | (0x11))>,
     <(((((('D') - 'A') * 0x10 + (14))) << 8) | (0x11))>,
     <(((((('D') - 'A') * 0x10 + (15))) << 8) | (0x11))>,
     <(((((('D') - 'A') * 0x10 + (0))) << 8) | (0x11))>,
     <(((((('D') - 'A') * 0x10 + (1))) << 8) | (0x11))>,
     <(((((('E') - 'A') * 0x10 + (7))) << 8) | (0x11))>,
     <(((((('E') - 'A') * 0x10 + (8))) << 8) | (0x11))>,
     <(((((('E') - 'A') * 0x10 + (9))) << 8) | (0x11))>,
     <(((((('E') - 'A') * 0x10 + (10))) << 8) | (0x11))>,
     <(((((('E') - 'A') * 0x10 + (11))) << 8) | (0x11))>,
     <(((((('E') - 'A') * 0x10 + (12))) << 8) | (0x11))>,
     <(((((('E') - 'A') * 0x10 + (13))) << 8) | (0x11))>,
     <(((((('E') - 'A') * 0x10 + (14))) << 8) | (0x11))>,
     <(((((('E') - 'A') * 0x10 + (15))) << 8) | (0x11))>,
     <(((((('D') - 'A') * 0x10 + (8))) << 8) | (0x11))>,
     <(((((('D') - 'A') * 0x10 + (9))) << 8) | (0x11))>,
     <(((((('D') - 'A') * 0x10 + (10))) << 8) | (0x11))>,
     <(((((('G') - 'A') * 0x10 + (9))) << 8) | (0x11))>,
     <(((((('G') - 'A') * 0x10 + (12))) << 8) | (0x11))>;
  };
 };

 i2c1_pins_a: i2c1-0 {
  pins {
   pinmux = <(((((('D') - 'A') * 0x10 + (12))) << 8) | (0x6))>,
     <(((((('F') - 'A') * 0x10 + (15))) << 8) | (0x6))>;
   bias-disable;
   drive-open-drain;
   slew-rate = <0>;
  };
 };

 i2c1_sleep_pins_a: i2c1-sleep-0 {
  pins {
   pinmux = <(((((('D') - 'A') * 0x10 + (12))) << 8) | (0x11))>,
     <(((((('F') - 'A') * 0x10 + (15))) << 8) | (0x11))>;
  };
 };

 i2c1_pins_b: i2c1-1 {
  pins {
   pinmux = <(((((('F') - 'A') * 0x10 + (14))) << 8) | (0x6))>,
     <(((((('F') - 'A') * 0x10 + (15))) << 8) | (0x6))>;
   bias-disable;
   drive-open-drain;
   slew-rate = <0>;
  };
 };

 i2c1_sleep_pins_b: i2c1-sleep-1 {
  pins {
   pinmux = <(((((('F') - 'A') * 0x10 + (14))) << 8) | (0x11))>,
     <(((((('F') - 'A') * 0x10 + (15))) << 8) | (0x11))>;
  };
 };

 i2c2_pins_a: i2c2-0 {
  pins {
   pinmux = <(((((('H') - 'A') * 0x10 + (4))) << 8) | (0x5))>,
     <(((((('H') - 'A') * 0x10 + (5))) << 8) | (0x5))>;
   bias-disable;
   drive-open-drain;
   slew-rate = <0>;
  };
 };

 i2c2_sleep_pins_a: i2c2-sleep-0 {
  pins {
   pinmux = <(((((('H') - 'A') * 0x10 + (4))) << 8) | (0x11))>,
     <(((((('H') - 'A') * 0x10 + (5))) << 8) | (0x11))>;
  };
 };

 i2c2_pins_b1: i2c2-1 {
  pins {
   pinmux = <(((((('H') - 'A') * 0x10 + (5))) << 8) | (0x5))>;
   bias-disable;
   drive-open-drain;
   slew-rate = <0>;
  };
 };

 i2c2_sleep_pins_b1: i2c2-sleep-1 {
  pins {
   pinmux = <(((((('H') - 'A') * 0x10 + (5))) << 8) | (0x11))>;
  };
 };

 i2c2_pins_c: i2c2-2 {
  pins {
   pinmux = <(((((('F') - 'A') * 0x10 + (1))) << 8) | (0x5))>,
     <(((((('H') - 'A') * 0x10 + (5))) << 8) | (0x5))>;
   bias-disable;
   drive-open-drain;
   slew-rate = <0>;
  };
 };

 i2c2_pins_sleep_c: i2c2-sleep-2 {
  pins {
   pinmux = <(((((('F') - 'A') * 0x10 + (1))) << 8) | (0x11))>,
     <(((((('H') - 'A') * 0x10 + (5))) << 8) | (0x11))>;
  };
 };

 i2c5_pins_a: i2c5-0 {
  pins {
   pinmux = <(((((('A') - 'A') * 0x10 + (11))) << 8) | (0x5))>,
     <(((((('A') - 'A') * 0x10 + (12))) << 8) | (0x5))>;
   bias-disable;
   drive-open-drain;
   slew-rate = <0>;
  };
 };

 i2c5_sleep_pins_a: i2c5-sleep-0 {
  pins {
   pinmux = <(((((('A') - 'A') * 0x10 + (11))) << 8) | (0x11))>,
     <(((((('A') - 'A') * 0x10 + (12))) << 8) | (0x11))>;

  };
 };

 i2c5_pins_b: i2c5-1 {
  pins {
   pinmux = <(((((('D') - 'A') * 0x10 + (0))) << 8) | (0x5))>,
     <(((((('D') - 'A') * 0x10 + (1))) << 8) | (0x5))>;
   bias-disable;
   drive-open-drain;
   slew-rate = <0>;
  };
 };

 i2c5_sleep_pins_b: i2c5-sleep-1 {
  pins {
   pinmux = <(((((('D') - 'A') * 0x10 + (0))) << 8) | (0x11))>,
     <(((((('D') - 'A') * 0x10 + (1))) << 8) | (0x11))>;
  };
 };

 i2s2_pins_a: i2s2-0 {
  pins {
   pinmux = <(((((('I') - 'A') * 0x10 + (3))) << 8) | (0x6))>,
     <(((((('B') - 'A') * 0x10 + (9))) << 8) | (0x6))>,
     <(((((('A') - 'A') * 0x10 + (9))) << 8) | (0x6))>;
   slew-rate = <1>;
   drive-push-pull;
   bias-disable;
  };
 };

 i2s2_sleep_pins_a: i2s2-sleep-0 {
  pins {
   pinmux = <(((((('I') - 'A') * 0x10 + (3))) << 8) | (0x11))>,
     <(((((('B') - 'A') * 0x10 + (9))) << 8) | (0x11))>,
     <(((((('A') - 'A') * 0x10 + (9))) << 8) | (0x11))>;
  };
 };

 ltdc_pins_a: ltdc-0 {
  pins {
   pinmux = <(((((('G') - 'A') * 0x10 + (7))) << 8) | (0xf))>,
     <(((((('I') - 'A') * 0x10 + (10))) << 8) | (0xf))>,
     <(((((('I') - 'A') * 0x10 + (9))) << 8) | (0xf))>,
     <(((((('F') - 'A') * 0x10 + (10))) << 8) | (0xf))>,
     <(((((('H') - 'A') * 0x10 + (2))) << 8) | (0xf))>,
     <(((((('H') - 'A') * 0x10 + (3))) << 8) | (0xf))>,
     <(((((('H') - 'A') * 0x10 + (8))) << 8) | (0xf))>,
     <(((((('H') - 'A') * 0x10 + (9))) << 8) | (0xf))>,
     <(((((('H') - 'A') * 0x10 + (10))) << 8) | (0xf))>,
     <(((((('C') - 'A') * 0x10 + (0))) << 8) | (0xf))>,
     <(((((('H') - 'A') * 0x10 + (12))) << 8) | (0xf))>,
     <(((((('E') - 'A') * 0x10 + (15))) << 8) | (0xf))>,
     <(((((('E') - 'A') * 0x10 + (5))) << 8) | (0xf))>,
     <(((((('E') - 'A') * 0x10 + (6))) << 8) | (0xf))>,
     <(((((('H') - 'A') * 0x10 + (13))) << 8) | (0xf))>,
     <(((((('H') - 'A') * 0x10 + (14))) << 8) | (0xf))>,
     <(((((('H') - 'A') * 0x10 + (15))) << 8) | (0xf))>,
     <(((((('I') - 'A') * 0x10 + (0))) << 8) | (0xf))>,
     <(((((('I') - 'A') * 0x10 + (1))) << 8) | (0xf))>,
     <(((((('I') - 'A') * 0x10 + (2))) << 8) | (0xf))>,
     <(((((('D') - 'A') * 0x10 + (9))) << 8) | (0xf))>,
     <(((((('G') - 'A') * 0x10 + (12))) << 8) | (0xf))>,
     <(((((('G') - 'A') * 0x10 + (10))) << 8) | (0xf))>,
     <(((((('D') - 'A') * 0x10 + (10))) << 8) | (0xf))>,
     <(((((('I') - 'A') * 0x10 + (4))) << 8) | (0xf))>,
     <(((((('A') - 'A') * 0x10 + (3))) << 8) | (0xf))>,
     <(((((('B') - 'A') * 0x10 + (8))) << 8) | (0xf))>,
     <(((((('D') - 'A') * 0x10 + (8))) << 8) | (0xf))>;
   bias-disable;
   drive-push-pull;
   slew-rate = <1>;
  };
 };

 ltdc_sleep_pins_a: ltdc-sleep-0 {
  pins {
   pinmux = <(((((('G') - 'A') * 0x10 + (7))) << 8) | (0x11))>,
     <(((((('I') - 'A') * 0x10 + (10))) << 8) | (0x11))>,
     <(((((('I') - 'A') * 0x10 + (9))) << 8) | (0x11))>,
     <(((((('F') - 'A') * 0x10 + (10))) << 8) | (0x11))>,
     <(((((('H') - 'A') * 0x10 + (2))) << 8) | (0x11))>,
     <(((((('H') - 'A') * 0x10 + (3))) << 8) | (0x11))>,
     <(((((('H') - 'A') * 0x10 + (8))) << 8) | (0x11))>,
     <(((((('H') - 'A') * 0x10 + (9))) << 8) | (0x11))>,
     <(((((('H') - 'A') * 0x10 + (10))) << 8) | (0x11))>,
     <(((((('C') - 'A') * 0x10 + (0))) << 8) | (0x11))>,
     <(((((('H') - 'A') * 0x10 + (12))) << 8) | (0x11))>,
     <(((((('E') - 'A') * 0x10 + (15))) << 8) | (0x11))>,
     <(((((('E') - 'A') * 0x10 + (5))) << 8) | (0x11))>,
     <(((((('E') - 'A') * 0x10 + (6))) << 8) | (0x11))>,
     <(((((('H') - 'A') * 0x10 + (13))) << 8) | (0x11))>,
     <(((((('H') - 'A') * 0x10 + (14))) << 8) | (0x11))>,
     <(((((('H') - 'A') * 0x10 + (15))) << 8) | (0x11))>,
     <(((((('I') - 'A') * 0x10 + (0))) << 8) | (0x11))>,
     <(((((('I') - 'A') * 0x10 + (1))) << 8) | (0x11))>,
     <(((((('I') - 'A') * 0x10 + (2))) << 8) | (0x11))>,
     <(((((('D') - 'A') * 0x10 + (9))) << 8) | (0x11))>,
     <(((((('G') - 'A') * 0x10 + (12))) << 8) | (0x11))>,
     <(((((('G') - 'A') * 0x10 + (10))) << 8) | (0x11))>,
     <(((((('D') - 'A') * 0x10 + (10))) << 8) | (0x11))>,
     <(((((('I') - 'A') * 0x10 + (4))) << 8) | (0x11))>,
     <(((((('A') - 'A') * 0x10 + (3))) << 8) | (0x11))>,
     <(((((('B') - 'A') * 0x10 + (8))) << 8) | (0x11))>,
     <(((((('D') - 'A') * 0x10 + (8))) << 8) | (0x11))>;
  };
 };

 ltdc_pins_b: ltdc-1 {
  pins {
   pinmux = <(((((('I') - 'A') * 0x10 + (14))) << 8) | (0xf))>,
     <(((((('I') - 'A') * 0x10 + (12))) << 8) | (0xf))>,
     <(((((('I') - 'A') * 0x10 + (13))) << 8) | (0xf))>,
     <(((((('K') - 'A') * 0x10 + (7))) << 8) | (0xf))>,
     <(((((('I') - 'A') * 0x10 + (15))) << 8) | (0xf))>,
     <(((((('J') - 'A') * 0x10 + (0))) << 8) | (0xf))>,
     <(((((('J') - 'A') * 0x10 + (1))) << 8) | (0xf))>,
     <(((((('J') - 'A') * 0x10 + (2))) << 8) | (0xf))>,
     <(((((('J') - 'A') * 0x10 + (3))) << 8) | (0xf))>,
     <(((((('J') - 'A') * 0x10 + (4))) << 8) | (0xf))>,
     <(((((('J') - 'A') * 0x10 + (5))) << 8) | (0xf))>,
     <(((((('J') - 'A') * 0x10 + (6))) << 8) | (0xf))>,
     <(((((('J') - 'A') * 0x10 + (7))) << 8) | (0xf))>,
     <(((((('J') - 'A') * 0x10 + (8))) << 8) | (0xf))>,
     <(((((('J') - 'A') * 0x10 + (9))) << 8) | (0xf))>,
     <(((((('J') - 'A') * 0x10 + (10))) << 8) | (0xf))>,
     <(((((('J') - 'A') * 0x10 + (11))) << 8) | (0xf))>,
     <(((((('K') - 'A') * 0x10 + (0))) << 8) | (0xf))>,
     <(((((('K') - 'A') * 0x10 + (1))) << 8) | (0xf))>,
     <(((((('K') - 'A') * 0x10 + (2))) << 8) | (0xf))>,
     <(((((('J') - 'A') * 0x10 + (12))) << 8) | (0xf))>,
     <(((((('J') - 'A') * 0x10 + (13))) << 8) | (0xf))>,
     <(((((('J') - 'A') * 0x10 + (14))) << 8) | (0xf))>,
     <(((((('J') - 'A') * 0x10 + (15))) << 8) | (0xf))>,
     <(((((('K') - 'A') * 0x10 + (3))) << 8) | (0xf))>,
     <(((((('K') - 'A') * 0x10 + (4))) << 8) | (0xf))>,
     <(((((('K') - 'A') * 0x10 + (5))) << 8) | (0xf))>,
     <(((((('K') - 'A') * 0x10 + (6))) << 8) | (0xf))>;
   bias-disable;
   drive-push-pull;
   slew-rate = <1>;
  };
 };

 ltdc_sleep_pins_b: ltdc-sleep-1 {
  pins {
   pinmux = <(((((('I') - 'A') * 0x10 + (14))) << 8) | (0x11))>,
     <(((((('I') - 'A') * 0x10 + (12))) << 8) | (0x11))>,
     <(((((('I') - 'A') * 0x10 + (13))) << 8) | (0x11))>,
     <(((((('K') - 'A') * 0x10 + (7))) << 8) | (0x11))>,
     <(((((('I') - 'A') * 0x10 + (15))) << 8) | (0x11))>,
     <(((((('J') - 'A') * 0x10 + (0))) << 8) | (0x11))>,
     <(((((('J') - 'A') * 0x10 + (1))) << 8) | (0x11))>,
     <(((((('J') - 'A') * 0x10 + (2))) << 8) | (0x11))>,
     <(((((('J') - 'A') * 0x10 + (3))) << 8) | (0x11))>,
     <(((((('J') - 'A') * 0x10 + (4))) << 8) | (0x11))>,
     <(((((('J') - 'A') * 0x10 + (5))) << 8) | (0x11))>,
     <(((((('J') - 'A') * 0x10 + (6))) << 8) | (0x11))>,
     <(((((('J') - 'A') * 0x10 + (7))) << 8) | (0x11))>,
     <(((((('J') - 'A') * 0x10 + (8))) << 8) | (0x11))>,
     <(((((('J') - 'A') * 0x10 + (9))) << 8) | (0x11))>,
     <(((((('J') - 'A') * 0x10 + (10))) << 8) | (0x11))>,
     <(((((('J') - 'A') * 0x10 + (11))) << 8) | (0x11))>,
     <(((((('K') - 'A') * 0x10 + (0))) << 8) | (0x11))>,
     <(((((('K') - 'A') * 0x10 + (1))) << 8) | (0x11))>,
     <(((((('K') - 'A') * 0x10 + (2))) << 8) | (0x11))>,
     <(((((('J') - 'A') * 0x10 + (12))) << 8) | (0x11))>,
     <(((((('J') - 'A') * 0x10 + (13))) << 8) | (0x11))>,
     <(((((('J') - 'A') * 0x10 + (14))) << 8) | (0x11))>,
     <(((((('J') - 'A') * 0x10 + (15))) << 8) | (0x11))>,
     <(((((('K') - 'A') * 0x10 + (3))) << 8) | (0x11))>,
     <(((((('K') - 'A') * 0x10 + (4))) << 8) | (0x11))>,
     <(((((('K') - 'A') * 0x10 + (5))) << 8) | (0x11))>,
     <(((((('K') - 'A') * 0x10 + (6))) << 8) | (0x11))>;
  };
 };

 ltdc_pins_c: ltdc-2 {
  pins1 {
   pinmux = <(((((('B') - 'A') * 0x10 + (1))) << 8) | (0xa))>,
     <(((((('B') - 'A') * 0x10 + (9))) << 8) | (0xf))>,
     <(((((('C') - 'A') * 0x10 + (0))) << 8) | (0xf))>,
     <(((((('D') - 'A') * 0x10 + (3))) << 8) | (0xf))>,
     <(((((('D') - 'A') * 0x10 + (6))) << 8) | (0xf))>,
     <(((((('D') - 'A') * 0x10 + (10))) << 8) | (0xf))>,
     <(((((('E') - 'A') * 0x10 + (11))) << 8) | (0xf))>,
     <(((((('E') - 'A') * 0x10 + (12))) << 8) | (0xf))>,
     <(((((('E') - 'A') * 0x10 + (13))) << 8) | (0xf))>,
     <(((((('E') - 'A') * 0x10 + (15))) << 8) | (0xf))>,
     <(((((('H') - 'A') * 0x10 + (4))) << 8) | (0xa))>,
     <(((((('H') - 'A') * 0x10 + (8))) << 8) | (0xf))>,
     <(((((('H') - 'A') * 0x10 + (9))) << 8) | (0xf))>,
     <(((((('H') - 'A') * 0x10 + (10))) << 8) | (0xf))>,
     <(((((('H') - 'A') * 0x10 + (13))) << 8) | (0xf))>,
     <(((((('H') - 'A') * 0x10 + (15))) << 8) | (0xf))>,
     <(((((('I') - 'A') * 0x10 + (1))) << 8) | (0xf))>,
     <(((((('I') - 'A') * 0x10 + (5))) << 8) | (0xf))>,
     <(((((('I') - 'A') * 0x10 + (6))) << 8) | (0xf))>,
     <(((((('I') - 'A') * 0x10 + (9))) << 8) | (0xf))>,
     <(((((('I') - 'A') * 0x10 + (10))) << 8) | (0xf))>;
   bias-disable;
   drive-push-pull;
   slew-rate = <0>;
  };
  pins2 {
   pinmux = <(((((('E') - 'A') * 0x10 + (14))) << 8) | (0xf))>;
   bias-disable;
   drive-push-pull;
   slew-rate = <1>;
  };
 };

 ltdc_sleep_pins_c: ltdc-sleep-2 {
  pins1 {
   pinmux = <(((((('B') - 'A') * 0x10 + (1))) << 8) | (0x11))>,
     <(((((('B') - 'A') * 0x10 + (9))) << 8) | (0x11))>,
     <(((((('C') - 'A') * 0x10 + (0))) << 8) | (0x11))>,
     <(((((('D') - 'A') * 0x10 + (3))) << 8) | (0x11))>,
     <(((((('D') - 'A') * 0x10 + (6))) << 8) | (0x11))>,
     <(((((('D') - 'A') * 0x10 + (10))) << 8) | (0x11))>,
     <(((((('E') - 'A') * 0x10 + (11))) << 8) | (0x11))>,
     <(((((('E') - 'A') * 0x10 + (12))) << 8) | (0x11))>,
     <(((((('E') - 'A') * 0x10 + (13))) << 8) | (0x11))>,
     <(((((('E') - 'A') * 0x10 + (15))) << 8) | (0x11))>,
     <(((((('H') - 'A') * 0x10 + (4))) << 8) | (0x11))>,
     <(((((('H') - 'A') * 0x10 + (8))) << 8) | (0x11))>,
     <(((((('H') - 'A') * 0x10 + (9))) << 8) | (0x11))>,
     <(((((('H') - 'A') * 0x10 + (10))) << 8) | (0x11))>,
     <(((((('H') - 'A') * 0x10 + (13))) << 8) | (0x11))>,
     <(((((('H') - 'A') * 0x10 + (15))) << 8) | (0x11))>,
     <(((((('I') - 'A') * 0x10 + (1))) << 8) | (0x11))>,
     <(((((('I') - 'A') * 0x10 + (5))) << 8) | (0x11))>,
     <(((((('I') - 'A') * 0x10 + (6))) << 8) | (0x11))>,
     <(((((('I') - 'A') * 0x10 + (9))) << 8) | (0x11))>,
     <(((((('I') - 'A') * 0x10 + (10))) << 8) | (0x11))>,
     <(((((('E') - 'A') * 0x10 + (14))) << 8) | (0x11))>;
  };
 };

 ltdc_pins_d: ltdc-3 {
  pins1 {
   pinmux = <(((((('G') - 'A') * 0x10 + (7))) << 8) | (0xf))>;
   bias-disable;
   drive-push-pull;
   slew-rate = <3>;
  };
  pins2 {
   pinmux = <(((((('I') - 'A') * 0x10 + (10))) << 8) | (0xf))>,
     <(((((('I') - 'A') * 0x10 + (9))) << 8) | (0xf))>,
     <(((((('E') - 'A') * 0x10 + (13))) << 8) | (0xf))>,
     <(((((('G') - 'A') * 0x10 + (13))) << 8) | (0xf))>,
     <(((((('H') - 'A') * 0x10 + (3))) << 8) | (0xf))>,
     <(((((('H') - 'A') * 0x10 + (8))) << 8) | (0xf))>,
     <(((((('H') - 'A') * 0x10 + (9))) << 8) | (0xf))>,
     <(((((('A') - 'A') * 0x10 + (5))) << 8) | (0xf))>,
     <(((((('H') - 'A') * 0x10 + (11))) << 8) | (0xf))>,
     <(((((('H') - 'A') * 0x10 + (12))) << 8) | (0xf))>,
     <(((((('E') - 'A') * 0x10 + (15))) << 8) | (0xf))>,
     <(((((('E') - 'A') * 0x10 + (5))) << 8) | (0xf))>,
     <(((((('B') - 'A') * 0x10 + (0))) << 8) | (0xf))>,
     <(((((('H') - 'A') * 0x10 + (13))) << 8) | (0xf))>,
     <(((((('E') - 'A') * 0x10 + (11))) << 8) | (0xf))>,
     <(((((('H') - 'A') * 0x10 + (15))) << 8) | (0xf))>,
     <(((((('H') - 'A') * 0x10 + (4))) << 8) | (0xa))>,
     <(((((('I') - 'A') * 0x10 + (11))) << 8) | (0xa))>,
     <(((((('G') - 'A') * 0x10 + (8))) << 8) | (0xf))>,
     <(((((('D') - 'A') * 0x10 + (9))) << 8) | (0xf))>,
     <(((((('G') - 'A') * 0x10 + (12))) << 8) | (0xf))>,
     <(((((('G') - 'A') * 0x10 + (10))) << 8) | (0xf))>,
     <(((((('D') - 'A') * 0x10 + (10))) << 8) | (0xf))>,
     <(((((('E') - 'A') * 0x10 + (12))) << 8) | (0xf))>,
     <(((((('A') - 'A') * 0x10 + (3))) << 8) | (0xf))>,
     <(((((('B') - 'A') * 0x10 + (8))) << 8) | (0xf))>,
     <(((((('I') - 'A') * 0x10 + (7))) << 8) | (0xf))>;
   bias-disable;
   drive-push-pull;
   slew-rate = <2>;
  };
 };

 ltdc_sleep_pins_d: ltdc-sleep-3 {
  pins {
   pinmux = <(((((('G') - 'A') * 0x10 + (7))) << 8) | (0x11))>,
     <(((((('I') - 'A') * 0x10 + (10))) << 8) | (0x11))>,
     <(((((('I') - 'A') * 0x10 + (9))) << 8) | (0x11))>,
     <(((((('E') - 'A') * 0x10 + (13))) << 8) | (0x11))>,
     <(((((('G') - 'A') * 0x10 + (13))) << 8) | (0x11))>,
     <(((((('H') - 'A') * 0x10 + (3))) << 8) | (0x11))>,
     <(((((('H') - 'A') * 0x10 + (8))) << 8) | (0x11))>,
     <(((((('H') - 'A') * 0x10 + (9))) << 8) | (0x11))>,
     <(((((('A') - 'A') * 0x10 + (5))) << 8) | (0x11))>,
     <(((((('H') - 'A') * 0x10 + (11))) << 8) | (0x11))>,
     <(((((('H') - 'A') * 0x10 + (12))) << 8) | (0x11))>,
     <(((((('E') - 'A') * 0x10 + (15))) << 8) | (0x11))>,
     <(((((('E') - 'A') * 0x10 + (5))) << 8) | (0x11))>,
     <(((((('B') - 'A') * 0x10 + (0))) << 8) | (0x11))>,
     <(((((('H') - 'A') * 0x10 + (13))) << 8) | (0x11))>,
     <(((((('E') - 'A') * 0x10 + (11))) << 8) | (0x11))>,
     <(((((('H') - 'A') * 0x10 + (15))) << 8) | (0x11))>,
     <(((((('H') - 'A') * 0x10 + (4))) << 8) | (0x11))>,
     <(((((('I') - 'A') * 0x10 + (11))) << 8) | (0x11))>,
     <(((((('G') - 'A') * 0x10 + (8))) << 8) | (0x11))>,
     <(((((('D') - 'A') * 0x10 + (9))) << 8) | (0x11))>,
     <(((((('G') - 'A') * 0x10 + (12))) << 8) | (0x11))>,
     <(((((('G') - 'A') * 0x10 + (10))) << 8) | (0x11))>,
     <(((((('D') - 'A') * 0x10 + (10))) << 8) | (0x11))>,
     <(((((('E') - 'A') * 0x10 + (12))) << 8) | (0x11))>,
     <(((((('A') - 'A') * 0x10 + (3))) << 8) | (0x11))>,
     <(((((('B') - 'A') * 0x10 + (8))) << 8) | (0x11))>,
     <(((((('I') - 'A') * 0x10 + (7))) << 8) | (0x11))>;
  };
 };

 mco2_pins_a: mco2-0 {
  pins {
   pinmux = <(((((('G') - 'A') * 0x10 + (2))) << 8) | (0x2))>;
   bias-disable;
   drive-push-pull;
   slew-rate = <2>;
  };
 };

 mco2_sleep_pins_a: mco2-sleep-0 {
  pins {
   pinmux = <(((((('G') - 'A') * 0x10 + (2))) << 8) | (0x11))>;
  };
 };

 m_can1_pins_a: m-can1-0 {
  pins1 {
   pinmux = <(((((('H') - 'A') * 0x10 + (13))) << 8) | (0xa))>;
   slew-rate = <1>;
   drive-push-pull;
   bias-disable;
  };
  pins2 {
   pinmux = <(((((('I') - 'A') * 0x10 + (9))) << 8) | (0xa))>;
   bias-disable;
  };
 };

 m_can1_sleep_pins_a: m_can1-sleep-0 {
  pins {
   pinmux = <(((((('H') - 'A') * 0x10 + (13))) << 8) | (0x11))>,
     <(((((('I') - 'A') * 0x10 + (9))) << 8) | (0x11))>;
  };
 };

 m_can1_pins_b: m-can1-1 {
  pins1 {
   pinmux = <(((((('A') - 'A') * 0x10 + (12))) << 8) | (0xa))>;
   slew-rate = <1>;
   drive-push-pull;
   bias-disable;
  };
  pins2 {
   pinmux = <(((((('A') - 'A') * 0x10 + (11))) << 8) | (0xa))>;
   bias-disable;
  };
 };

 m_can1_sleep_pins_b: m_can1-sleep-1 {
  pins {
   pinmux = <(((((('A') - 'A') * 0x10 + (12))) << 8) | (0x11))>,
     <(((((('A') - 'A') * 0x10 + (11))) << 8) | (0x11))>;
  };
 };

 m_can2_pins_a: m-can2-0 {
  pins1 {
   pinmux = <(((((('B') - 'A') * 0x10 + (13))) << 8) | (0xa))>;
   slew-rate = <1>;
   drive-push-pull;
   bias-disable;
  };
  pins2 {
   pinmux = <(((((('B') - 'A') * 0x10 + (5))) << 8) | (0xa))>;
   bias-disable;
  };
 };

 m_can2_sleep_pins_a: m_can2-sleep-0 {
  pins {
   pinmux = <(((((('B') - 'A') * 0x10 + (13))) << 8) | (0x11))>,
     <(((((('B') - 'A') * 0x10 + (5))) << 8) | (0x11))>;
  };
 };

 pwm1_pins_a: pwm1-0 {
  pins {
   pinmux = <(((((('E') - 'A') * 0x10 + (9))) << 8) | (0x2))>,
     <(((((('E') - 'A') * 0x10 + (11))) << 8) | (0x2))>,
     <(((((('E') - 'A') * 0x10 + (14))) << 8) | (0x2))>;
   bias-pull-down;
   drive-push-pull;
   slew-rate = <0>;
  };
 };

 pwm1_sleep_pins_a: pwm1-sleep-0 {
  pins {
   pinmux = <(((((('E') - 'A') * 0x10 + (9))) << 8) | (0x11))>,
     <(((((('E') - 'A') * 0x10 + (11))) << 8) | (0x11))>,
     <(((((('E') - 'A') * 0x10 + (14))) << 8) | (0x11))>;
  };
 };

 pwm1_pins_b: pwm1-1 {
  pins {
   pinmux = <(((((('E') - 'A') * 0x10 + (9))) << 8) | (0x2))>;
   bias-pull-down;
   drive-push-pull;
   slew-rate = <0>;
  };
 };

 pwm1_sleep_pins_b: pwm1-sleep-1 {
  pins {
   pinmux = <(((((('E') - 'A') * 0x10 + (9))) << 8) | (0x11))>;
  };
 };

 pwm2_pins_a: pwm2-0 {
  pins {
   pinmux = <(((((('A') - 'A') * 0x10 + (3))) << 8) | (0x2))>;
   bias-pull-down;
   drive-push-pull;
   slew-rate = <0>;
  };
 };

 pwm2_sleep_pins_a: pwm2-sleep-0 {
  pins {
   pinmux = <(((((('A') - 'A') * 0x10 + (3))) << 8) | (0x11))>;
  };
 };

 pwm3_pins_a: pwm3-0 {
  pins {
   pinmux = <(((((('C') - 'A') * 0x10 + (7))) << 8) | (0x3))>;
   bias-pull-down;
   drive-push-pull;
   slew-rate = <0>;
  };
 };

 pwm3_sleep_pins_a: pwm3-sleep-0 {
  pins {
   pinmux = <(((((('C') - 'A') * 0x10 + (7))) << 8) | (0x11))>;
  };
 };

 pwm3_pins_b: pwm3-1 {
  pins {
   pinmux = <(((((('B') - 'A') * 0x10 + (5))) << 8) | (0x3))>;
   bias-disable;
   drive-push-pull;
   slew-rate = <0>;
  };
 };

 pwm3_sleep_pins_b: pwm3-sleep-1 {
  pins {
   pinmux = <(((((('B') - 'A') * 0x10 + (5))) << 8) | (0x11))>;
  };
 };

 pwm4_pins_a: pwm4-0 {
  pins {
   pinmux = <(((((('D') - 'A') * 0x10 + (14))) << 8) | (0x3))>,
     <(((((('D') - 'A') * 0x10 + (15))) << 8) | (0x3))>;
   bias-pull-down;
   drive-push-pull;
   slew-rate = <0>;
  };
 };

 pwm4_sleep_pins_a: pwm4-sleep-0 {
  pins {
   pinmux = <(((((('D') - 'A') * 0x10 + (14))) << 8) | (0x11))>,
     <(((((('D') - 'A') * 0x10 + (15))) << 8) | (0x11))>;
  };
 };

 pwm4_pins_b: pwm4-1 {
  pins {
   pinmux = <(((((('D') - 'A') * 0x10 + (13))) << 8) | (0x3))>;
   bias-pull-down;
   drive-push-pull;
   slew-rate = <0>;
  };
 };

 pwm4_sleep_pins_b: pwm4-sleep-1 {
  pins {
   pinmux = <(((((('D') - 'A') * 0x10 + (13))) << 8) | (0x11))>;
  };
 };

 pwm5_pins_a: pwm5-0 {
  pins {
   pinmux = <(((((('H') - 'A') * 0x10 + (11))) << 8) | (0x3))>;
   bias-pull-down;
   drive-push-pull;
   slew-rate = <0>;
  };
 };

 pwm5_sleep_pins_a: pwm5-sleep-0 {
  pins {
   pinmux = <(((((('H') - 'A') * 0x10 + (11))) << 8) | (0x11))>;
  };
 };

 pwm5_pins_b: pwm5-1 {
  pins {
   pinmux = <(((((('H') - 'A') * 0x10 + (11))) << 8) | (0x3))>,
     <(((((('H') - 'A') * 0x10 + (12))) << 8) | (0x3))>,
     <(((((('I') - 'A') * 0x10 + (0))) << 8) | (0x3))>;
   bias-disable;
   drive-push-pull;
   slew-rate = <0>;
  };
 };

 pwm5_sleep_pins_b: pwm5-sleep-1 {
  pins {
   pinmux = <(((((('H') - 'A') * 0x10 + (11))) << 8) | (0x11))>,
     <(((((('H') - 'A') * 0x10 + (12))) << 8) | (0x11))>,
     <(((((('I') - 'A') * 0x10 + (0))) << 8) | (0x11))>;
  };
 };

 pwm8_pins_a: pwm8-0 {
  pins {
   pinmux = <(((((('I') - 'A') * 0x10 + (2))) << 8) | (0x4))>;
   bias-pull-down;
   drive-push-pull;
   slew-rate = <0>;
  };
 };

 pwm8_sleep_pins_a: pwm8-sleep-0 {
  pins {
   pinmux = <(((((('I') - 'A') * 0x10 + (2))) << 8) | (0x11))>;
  };
 };

 pwm12_pins_a: pwm12-0 {
  pins {
   pinmux = <(((((('H') - 'A') * 0x10 + (6))) << 8) | (0x3))>;
   bias-pull-down;
   drive-push-pull;
   slew-rate = <0>;
  };
 };

 pwm12_sleep_pins_a: pwm12-sleep-0 {
  pins {
   pinmux = <(((((('H') - 'A') * 0x10 + (6))) << 8) | (0x11))>;
  };
 };

 qspi_clk_pins_a: qspi-clk-0 {
  pins {
   pinmux = <(((((('F') - 'A') * 0x10 + (10))) << 8) | (0xa))>;
   bias-disable;
   drive-push-pull;
   slew-rate = <3>;
  };
 };

 qspi_clk_sleep_pins_a: qspi-clk-sleep-0 {
  pins {
   pinmux = <(((((('F') - 'A') * 0x10 + (10))) << 8) | (0x11))>;
  };
 };

 qspi_bk1_pins_a: qspi-bk1-0 {
  pins1 {
   pinmux = <(((((('F') - 'A') * 0x10 + (8))) << 8) | (0xb))>,
     <(((((('F') - 'A') * 0x10 + (9))) << 8) | (0xb))>,
     <(((((('F') - 'A') * 0x10 + (7))) << 8) | (0xa))>,
     <(((((('F') - 'A') * 0x10 + (6))) << 8) | (0xa))>;
   bias-disable;
   drive-push-pull;
   slew-rate = <1>;
  };
  pins2 {
   pinmux = <(((((('B') - 'A') * 0x10 + (6))) << 8) | (0xb))>;
   bias-pull-up;
   drive-push-pull;
   slew-rate = <1>;
  };
 };

 qspi_bk1_sleep_pins_a: qspi-bk1-sleep-0 {
  pins {
   pinmux = <(((((('F') - 'A') * 0x10 + (8))) << 8) | (0x11))>,
     <(((((('F') - 'A') * 0x10 + (9))) << 8) | (0x11))>,
     <(((((('F') - 'A') * 0x10 + (7))) << 8) | (0x11))>,
     <(((((('F') - 'A') * 0x10 + (6))) << 8) | (0x11))>,
     <(((((('B') - 'A') * 0x10 + (6))) << 8) | (0x11))>;
  };
 };

 qspi_bk2_pins_a: qspi-bk2-0 {
  pins1 {
   pinmux = <(((((('H') - 'A') * 0x10 + (2))) << 8) | (0xa))>,
     <(((((('H') - 'A') * 0x10 + (3))) << 8) | (0xa))>,
     <(((((('G') - 'A') * 0x10 + (10))) << 8) | (0xc))>,
     <(((((('G') - 'A') * 0x10 + (7))) << 8) | (0xc))>;
   bias-disable;
   drive-push-pull;
   slew-rate = <1>;
  };
  pins2 {
   pinmux = <(((((('C') - 'A') * 0x10 + (0))) << 8) | (0xb))>;
   bias-pull-up;
   drive-push-pull;
   slew-rate = <1>;
  };
 };

 qspi_bk2_sleep_pins_a: qspi-bk2-sleep-0 {
  pins {
   pinmux = <(((((('H') - 'A') * 0x10 + (2))) << 8) | (0x11))>,
     <(((((('H') - 'A') * 0x10 + (3))) << 8) | (0x11))>,
     <(((((('G') - 'A') * 0x10 + (10))) << 8) | (0x11))>,
     <(((((('G') - 'A') * 0x10 + (7))) << 8) | (0x11))>,
     <(((((('C') - 'A') * 0x10 + (0))) << 8) | (0x11))>;
  };
 };

 sai2a_pins_a: sai2a-0 {
  pins {
   pinmux = <(((((('I') - 'A') * 0x10 + (5))) << 8) | (0xb))>,
     <(((((('I') - 'A') * 0x10 + (6))) << 8) | (0xb))>,
     <(((((('I') - 'A') * 0x10 + (7))) << 8) | (0xb))>,
     <(((((('E') - 'A') * 0x10 + (0))) << 8) | (0xb))>;
   slew-rate = <0>;
   drive-push-pull;
   bias-disable;
  };
 };

 sai2a_sleep_pins_a: sai2a-sleep-0 {
  pins {
   pinmux = <(((((('I') - 'A') * 0x10 + (5))) << 8) | (0x11))>,
     <(((((('I') - 'A') * 0x10 + (6))) << 8) | (0x11))>,
     <(((((('I') - 'A') * 0x10 + (7))) << 8) | (0x11))>,
     <(((((('E') - 'A') * 0x10 + (0))) << 8) | (0x11))>;
  };
 };

 sai2a_pins_b: sai2a-1 {
  pins1 {
   pinmux = <(((((('I') - 'A') * 0x10 + (6))) << 8) | (0xb))>,
     <(((((('I') - 'A') * 0x10 + (7))) << 8) | (0xb))>,
     <(((((('D') - 'A') * 0x10 + (13))) << 8) | (0xb))>;
   slew-rate = <0>;
   drive-push-pull;
   bias-disable;
  };
 };

 sai2a_sleep_pins_b: sai2a-sleep-1 {
  pins {
   pinmux = <(((((('I') - 'A') * 0x10 + (6))) << 8) | (0x11))>,
     <(((((('I') - 'A') * 0x10 + (7))) << 8) | (0x11))>,
     <(((((('D') - 'A') * 0x10 + (13))) << 8) | (0x11))>;
  };
 };

 sai2a_pins_c: sai2a-2 {
  pins {
   pinmux = <(((((('D') - 'A') * 0x10 + (13))) << 8) | (0xb))>,
     <(((((('D') - 'A') * 0x10 + (11))) << 8) | (0xb))>,
     <(((((('D') - 'A') * 0x10 + (12))) << 8) | (0xb))>;
   slew-rate = <0>;
   drive-push-pull;
   bias-disable;
  };
 };

 sai2a_sleep_pins_c: sai2a-sleep-2 {
  pins {
   pinmux = <(((((('D') - 'A') * 0x10 + (13))) << 8) | (0x11))>,
     <(((((('D') - 'A') * 0x10 + (11))) << 8) | (0x11))>,
     <(((((('D') - 'A') * 0x10 + (12))) << 8) | (0x11))>;
  };
 };

 sai2b_pins_a: sai2b-0 {
  pins1 {
   pinmux = <(((((('E') - 'A') * 0x10 + (12))) << 8) | (0xb))>,
     <(((((('E') - 'A') * 0x10 + (13))) << 8) | (0xb))>,
     <(((((('E') - 'A') * 0x10 + (14))) << 8) | (0xb))>;
   slew-rate = <0>;
   drive-push-pull;
   bias-disable;
  };
  pins2 {
   pinmux = <(((((('F') - 'A') * 0x10 + (11))) << 8) | (0xb))>;
   bias-disable;
  };
 };

 sai2b_sleep_pins_a: sai2b-sleep-0 {
  pins {
   pinmux = <(((((('F') - 'A') * 0x10 + (11))) << 8) | (0x11))>,
     <(((((('E') - 'A') * 0x10 + (12))) << 8) | (0x11))>,
     <(((((('E') - 'A') * 0x10 + (13))) << 8) | (0x11))>,
     <(((((('E') - 'A') * 0x10 + (14))) << 8) | (0x11))>;
  };
 };

 sai2b_pins_b: sai2b-1 {
  pins {
   pinmux = <(((((('F') - 'A') * 0x10 + (11))) << 8) | (0xb))>;
   bias-disable;
  };
 };

 sai2b_sleep_pins_b: sai2b-sleep-1 {
  pins {
   pinmux = <(((((('F') - 'A') * 0x10 + (11))) << 8) | (0x11))>;
  };
 };

 sai2b_pins_c: sai2b-2 {
  pins1 {
   pinmux = <(((((('F') - 'A') * 0x10 + (11))) << 8) | (0xb))>;
   bias-disable;
  };
 };

 sai2b_sleep_pins_c: sai2b-sleep-2 {
  pins {
   pinmux = <(((((('F') - 'A') * 0x10 + (11))) << 8) | (0x11))>;
  };
 };

 sai4a_pins_a: sai4a-0 {
  pins {
   pinmux = <(((((('B') - 'A') * 0x10 + (5))) << 8) | (0xb))>;
   slew-rate = <0>;
   drive-push-pull;
   bias-disable;
  };
 };

 sai4a_sleep_pins_a: sai4a-sleep-0 {
  pins {
   pinmux = <(((((('B') - 'A') * 0x10 + (5))) << 8) | (0x11))>;
  };
 };

 sdmmc1_b4_pins_a: sdmmc1-b4-0 {
  pins1 {
   pinmux = <(((((('C') - 'A') * 0x10 + (8))) << 8) | (0xd))>,
     <(((((('C') - 'A') * 0x10 + (9))) << 8) | (0xd))>,
     <(((((('C') - 'A') * 0x10 + (10))) << 8) | (0xd))>,
     <(((((('C') - 'A') * 0x10 + (11))) << 8) | (0xd))>,
     <(((((('D') - 'A') * 0x10 + (2))) << 8) | (0xd))>;
   slew-rate = <1>;
   drive-push-pull;
   bias-disable;
  };
  pins2 {
   pinmux = <(((((('C') - 'A') * 0x10 + (12))) << 8) | (0xd))>;
   slew-rate = <2>;
   drive-push-pull;
   bias-disable;
  };
 };

 sdmmc1_b4_od_pins_a: sdmmc1-b4-od-0 {
  pins1 {
   pinmux = <(((((('C') - 'A') * 0x10 + (8))) << 8) | (0xd))>,
     <(((((('C') - 'A') * 0x10 + (9))) << 8) | (0xd))>,
     <(((((('C') - 'A') * 0x10 + (10))) << 8) | (0xd))>,
     <(((((('C') - 'A') * 0x10 + (11))) << 8) | (0xd))>;
   slew-rate = <1>;
   drive-push-pull;
   bias-disable;
  };
  pins2 {
   pinmux = <(((((('C') - 'A') * 0x10 + (12))) << 8) | (0xd))>;
   slew-rate = <2>;
   drive-push-pull;
   bias-disable;
  };
  pins3 {
   pinmux = <(((((('D') - 'A') * 0x10 + (2))) << 8) | (0xd))>;
   slew-rate = <1>;
   drive-open-drain;
   bias-disable;
  };
 };

 sdmmc1_b4_init_pins_a: sdmmc1-b4-init-0 {
  pins1 {
   pinmux = <(((((('C') - 'A') * 0x10 + (8))) << 8) | (0xd))>,
     <(((((('C') - 'A') * 0x10 + (9))) << 8) | (0xd))>,
     <(((((('C') - 'A') * 0x10 + (10))) << 8) | (0xd))>,
     <(((((('C') - 'A') * 0x10 + (11))) << 8) | (0xd))>;
   slew-rate = <1>;
   drive-push-pull;
   bias-disable;
  };
 };

 sdmmc1_b4_sleep_pins_a: sdmmc1-b4-sleep-0 {
  pins {
   pinmux = <(((((('C') - 'A') * 0x10 + (8))) << 8) | (0x11))>,
     <(((((('C') - 'A') * 0x10 + (9))) << 8) | (0x11))>,
     <(((((('C') - 'A') * 0x10 + (10))) << 8) | (0x11))>,
     <(((((('C') - 'A') * 0x10 + (11))) << 8) | (0x11))>,
     <(((((('C') - 'A') * 0x10 + (12))) << 8) | (0x11))>,
     <(((((('D') - 'A') * 0x10 + (2))) << 8) | (0x11))>;
  };
 };

 sdmmc1_dir_pins_a: sdmmc1-dir-0 {
  pins1 {
   pinmux = <(((((('F') - 'A') * 0x10 + (2))) << 8) | (0xc))>,
     <(((((('C') - 'A') * 0x10 + (7))) << 8) | (0x9))>,
     <(((((('B') - 'A') * 0x10 + (9))) << 8) | (0xc))>;
   slew-rate = <1>;
   drive-push-pull;
   bias-pull-up;
  };
  pins2{
   pinmux = <(((((('E') - 'A') * 0x10 + (4))) << 8) | (0x9))>;
   bias-pull-up;
  };
 };

 sdmmc1_dir_init_pins_a: sdmmc1-dir-init-0 {
  pins1 {
   pinmux = <(((((('F') - 'A') * 0x10 + (2))) << 8) | (0xc))>,
     <(((((('C') - 'A') * 0x10 + (7))) << 8) | (0x9))>,
     <(((((('B') - 'A') * 0x10 + (9))) << 8) | (0xc))>;
   slew-rate = <1>;
   drive-push-pull;
   bias-pull-up;
  };
 };

 sdmmc1_dir_sleep_pins_a: sdmmc1-dir-sleep-0 {
  pins {
   pinmux = <(((((('F') - 'A') * 0x10 + (2))) << 8) | (0x11))>,
     <(((((('C') - 'A') * 0x10 + (7))) << 8) | (0x11))>,
     <(((((('B') - 'A') * 0x10 + (9))) << 8) | (0x11))>,
     <(((((('E') - 'A') * 0x10 + (4))) << 8) | (0x11))>;
  };
 };

 sdmmc1_dir_pins_b: sdmmc1-dir-1 {
  pins1 {
   pinmux = <(((((('F') - 'A') * 0x10 + (2))) << 8) | (0xc))>,
     <(((((('E') - 'A') * 0x10 + (14))) << 8) | (0xc))>,
     <(((((('B') - 'A') * 0x10 + (9))) << 8) | (0xc))>;
   slew-rate = <1>;
   drive-push-pull;
   bias-pull-up;
  };
  pins2{
   pinmux = <(((((('E') - 'A') * 0x10 + (4))) << 8) | (0x9))>;
   bias-pull-up;
  };
 };

 sdmmc1_dir_sleep_pins_b: sdmmc1-dir-sleep-1 {
  pins {
   pinmux = <(((((('F') - 'A') * 0x10 + (2))) << 8) | (0x11))>,
     <(((((('E') - 'A') * 0x10 + (14))) << 8) | (0x11))>,
     <(((((('B') - 'A') * 0x10 + (9))) << 8) | (0x11))>,
     <(((((('E') - 'A') * 0x10 + (4))) << 8) | (0x11))>;
  };
 };

 sdmmc2_b4_pins_a: sdmmc2-b4-0 {
  pins1 {
   pinmux = <(((((('B') - 'A') * 0x10 + (14))) << 8) | (0xa))>,
     <(((((('B') - 'A') * 0x10 + (15))) << 8) | (0xa))>,
     <(((((('B') - 'A') * 0x10 + (3))) << 8) | (0xa))>,
     <(((((('B') - 'A') * 0x10 + (4))) << 8) | (0xa))>,
     <(((((('G') - 'A') * 0x10 + (6))) << 8) | (0xb))>;
   slew-rate = <1>;
   drive-push-pull;
   bias-pull-up;
  };
  pins2 {
   pinmux = <(((((('E') - 'A') * 0x10 + (3))) << 8) | (0xa))>;
   slew-rate = <2>;
   drive-push-pull;
   bias-pull-up;
  };
 };

 sdmmc2_b4_od_pins_a: sdmmc2-b4-od-0 {
  pins1 {
   pinmux = <(((((('B') - 'A') * 0x10 + (14))) << 8) | (0xa))>,
     <(((((('B') - 'A') * 0x10 + (15))) << 8) | (0xa))>,
     <(((((('B') - 'A') * 0x10 + (3))) << 8) | (0xa))>,
     <(((((('B') - 'A') * 0x10 + (4))) << 8) | (0xa))>;
   slew-rate = <1>;
   drive-push-pull;
   bias-pull-up;
  };
  pins2 {
   pinmux = <(((((('E') - 'A') * 0x10 + (3))) << 8) | (0xa))>;
   slew-rate = <2>;
   drive-push-pull;
   bias-pull-up;
  };
  pins3 {
   pinmux = <(((((('G') - 'A') * 0x10 + (6))) << 8) | (0xb))>;
   slew-rate = <1>;
   drive-open-drain;
   bias-pull-up;
  };
 };

 sdmmc2_b4_sleep_pins_a: sdmmc2-b4-sleep-0 {
  pins {
   pinmux = <(((((('B') - 'A') * 0x10 + (14))) << 8) | (0x11))>,
     <(((((('B') - 'A') * 0x10 + (15))) << 8) | (0x11))>,
     <(((((('B') - 'A') * 0x10 + (3))) << 8) | (0x11))>,
     <(((((('B') - 'A') * 0x10 + (4))) << 8) | (0x11))>,
     <(((((('E') - 'A') * 0x10 + (3))) << 8) | (0x11))>,
     <(((((('G') - 'A') * 0x10 + (6))) << 8) | (0x11))>;
  };
 };

 sdmmc2_b4_pins_b: sdmmc2-b4-1 {
  pins1 {
   pinmux = <(((((('B') - 'A') * 0x10 + (14))) << 8) | (0xa))>,
     <(((((('B') - 'A') * 0x10 + (15))) << 8) | (0xa))>,
     <(((((('B') - 'A') * 0x10 + (3))) << 8) | (0xa))>,
     <(((((('B') - 'A') * 0x10 + (4))) << 8) | (0xa))>,
     <(((((('G') - 'A') * 0x10 + (6))) << 8) | (0xb))>;
   slew-rate = <1>;
   drive-push-pull;
   bias-disable;
  };
  pins2 {
   pinmux = <(((((('E') - 'A') * 0x10 + (3))) << 8) | (0xa))>;
   slew-rate = <2>;
   drive-push-pull;
   bias-disable;
  };
 };

 sdmmc2_b4_od_pins_b: sdmmc2-b4-od-1 {
  pins1 {
   pinmux = <(((((('B') - 'A') * 0x10 + (14))) << 8) | (0xa))>,
     <(((((('B') - 'A') * 0x10 + (15))) << 8) | (0xa))>,
     <(((((('B') - 'A') * 0x10 + (3))) << 8) | (0xa))>,
     <(((((('B') - 'A') * 0x10 + (4))) << 8) | (0xa))>;
   slew-rate = <1>;
   drive-push-pull;
   bias-disable;
  };
  pins2 {
   pinmux = <(((((('E') - 'A') * 0x10 + (3))) << 8) | (0xa))>;
   slew-rate = <2>;
   drive-push-pull;
   bias-disable;
  };
  pins3 {
   pinmux = <(((((('G') - 'A') * 0x10 + (6))) << 8) | (0xb))>;
   slew-rate = <1>;
   drive-open-drain;
   bias-disable;
  };
 };

 sdmmc2_d47_pins_a: sdmmc2-d47-0 {
  pins {
   pinmux = <(((((('A') - 'A') * 0x10 + (8))) << 8) | (0xa))>,
     <(((((('A') - 'A') * 0x10 + (9))) << 8) | (0xb))>,
     <(((((('E') - 'A') * 0x10 + (5))) << 8) | (0xa))>,
     <(((((('D') - 'A') * 0x10 + (3))) << 8) | (0xa))>;
   slew-rate = <1>;
   drive-push-pull;
   bias-pull-up;
  };
 };

 sdmmc2_d47_sleep_pins_a: sdmmc2-d47-sleep-0 {
  pins {
   pinmux = <(((((('A') - 'A') * 0x10 + (8))) << 8) | (0x11))>,
     <(((((('A') - 'A') * 0x10 + (9))) << 8) | (0x11))>,
     <(((((('E') - 'A') * 0x10 + (5))) << 8) | (0x11))>,
     <(((((('D') - 'A') * 0x10 + (3))) << 8) | (0x11))>;
  };
 };

 sdmmc2_d47_pins_b: sdmmc2-d47-1 {
  pins {
   pinmux = <(((((('A') - 'A') * 0x10 + (8))) << 8) | (0xa))>,
     <(((((('A') - 'A') * 0x10 + (9))) << 8) | (0xb))>,
     <(((((('C') - 'A') * 0x10 + (6))) << 8) | (0xb))>,
     <(((((('C') - 'A') * 0x10 + (7))) << 8) | (0xb))>;
   slew-rate = <1>;
   drive-push-pull;
   bias-disable;
  };
 };

 sdmmc2_d47_sleep_pins_b: sdmmc2-d47-sleep-1 {
  pins {
   pinmux = <(((((('A') - 'A') * 0x10 + (8))) << 8) | (0x11))>,
     <(((((('A') - 'A') * 0x10 + (9))) << 8) | (0x11))>,
     <(((((('C') - 'A') * 0x10 + (6))) << 8) | (0x11))>,
     <(((((('C') - 'A') * 0x10 + (7))) << 8) | (0x11))>;
  };
 };

 sdmmc2_d47_pins_c: sdmmc2-d47-2 {
  pins {
   pinmux = <(((((('A') - 'A') * 0x10 + (8))) << 8) | (0xa))>,
     <(((((('A') - 'A') * 0x10 + (15))) << 8) | (0xa))>,
     <(((((('C') - 'A') * 0x10 + (6))) << 8) | (0xb))>,
     <(((((('C') - 'A') * 0x10 + (7))) << 8) | (0xb))>;
   slew-rate = <1>;
   drive-push-pull;
   bias-pull-up;
  };
 };

 sdmmc2_d47_sleep_pins_c: sdmmc2-d47-sleep-2 {
  pins {
   pinmux = <(((((('A') - 'A') * 0x10 + (8))) << 8) | (0x11))>,
     <(((((('A') - 'A') * 0x10 + (15))) << 8) | (0x11))>,
     <(((((('C') - 'A') * 0x10 + (6))) << 8) | (0x11))>,
     <(((((('C') - 'A') * 0x10 + (7))) << 8) | (0x11))>;
  };
 };

 sdmmc2_d47_pins_d: sdmmc2-d47-3 {
  pins {
   pinmux = <(((((('A') - 'A') * 0x10 + (8))) << 8) | (0xa))>,
     <(((((('A') - 'A') * 0x10 + (9))) << 8) | (0xb))>,
     <(((((('E') - 'A') * 0x10 + (5))) << 8) | (0xa))>,
     <(((((('C') - 'A') * 0x10 + (7))) << 8) | (0xb))>;
  };
 };

 sdmmc2_d47_sleep_pins_d: sdmmc2-d47-sleep-3 {
  pins {
   pinmux = <(((((('A') - 'A') * 0x10 + (8))) << 8) | (0x11))>,
     <(((((('A') - 'A') * 0x10 + (9))) << 8) | (0x11))>,
     <(((((('E') - 'A') * 0x10 + (5))) << 8) | (0x11))>,
     <(((((('C') - 'A') * 0x10 + (7))) << 8) | (0x11))>;
  };
 };

 sdmmc3_b4_pins_a: sdmmc3-b4-0 {
  pins1 {
   pinmux = <(((((('F') - 'A') * 0x10 + (0))) << 8) | (0xa))>,
     <(((((('F') - 'A') * 0x10 + (4))) << 8) | (0xa))>,
     <(((((('F') - 'A') * 0x10 + (5))) << 8) | (0xa))>,
     <(((((('D') - 'A') * 0x10 + (7))) << 8) | (0xb))>,
     <(((((('F') - 'A') * 0x10 + (1))) << 8) | (0xa))>;
   slew-rate = <1>;
   drive-push-pull;
   bias-pull-up;
  };
  pins2 {
   pinmux = <(((((('G') - 'A') * 0x10 + (15))) << 8) | (0xb))>;
   slew-rate = <2>;
   drive-push-pull;
   bias-pull-up;
  };
 };

 sdmmc3_b4_od_pins_a: sdmmc3-b4-od-0 {
  pins1 {
   pinmux = <(((((('F') - 'A') * 0x10 + (0))) << 8) | (0xa))>,
     <(((((('F') - 'A') * 0x10 + (4))) << 8) | (0xa))>,
     <(((((('F') - 'A') * 0x10 + (5))) << 8) | (0xa))>,
     <(((((('D') - 'A') * 0x10 + (7))) << 8) | (0xb))>;
   slew-rate = <1>;
   drive-push-pull;
   bias-pull-up;
  };
  pins2 {
   pinmux = <(((((('G') - 'A') * 0x10 + (15))) << 8) | (0xb))>;
   slew-rate = <2>;
   drive-push-pull;
   bias-pull-up;
  };
  pins3 {
   pinmux = <(((((('F') - 'A') * 0x10 + (1))) << 8) | (0xa))>;
   slew-rate = <1>;
   drive-open-drain;
   bias-pull-up;
  };
 };

 sdmmc3_b4_sleep_pins_a: sdmmc3-b4-sleep-0 {
  pins {
   pinmux = <(((((('F') - 'A') * 0x10 + (0))) << 8) | (0x11))>,
     <(((((('F') - 'A') * 0x10 + (4))) << 8) | (0x11))>,
     <(((((('F') - 'A') * 0x10 + (5))) << 8) | (0x11))>,
     <(((((('D') - 'A') * 0x10 + (7))) << 8) | (0x11))>,
     <(((((('G') - 'A') * 0x10 + (15))) << 8) | (0x11))>,
     <(((((('F') - 'A') * 0x10 + (1))) << 8) | (0x11))>;
  };
 };

 sdmmc3_b4_pins_b: sdmmc3-b4-1 {
  pins1 {
   pinmux = <(((((('F') - 'A') * 0x10 + (0))) << 8) | (0xa))>,
     <(((((('F') - 'A') * 0x10 + (4))) << 8) | (0xa))>,
     <(((((('D') - 'A') * 0x10 + (5))) << 8) | (0xb))>,
     <(((((('D') - 'A') * 0x10 + (7))) << 8) | (0xb))>,
     <(((((('D') - 'A') * 0x10 + (0))) << 8) | (0xb))>;
   slew-rate = <1>;
   drive-push-pull;
   bias-pull-up;
  };
  pins2 {
   pinmux = <(((((('G') - 'A') * 0x10 + (15))) << 8) | (0xb))>;
   slew-rate = <2>;
   drive-push-pull;
   bias-pull-up;
  };
 };

 sdmmc3_b4_od_pins_b: sdmmc3-b4-od-1 {
  pins1 {
   pinmux = <(((((('F') - 'A') * 0x10 + (0))) << 8) | (0xa))>,
     <(((((('F') - 'A') * 0x10 + (4))) << 8) | (0xa))>,
     <(((((('D') - 'A') * 0x10 + (5))) << 8) | (0xb))>,
     <(((((('D') - 'A') * 0x10 + (7))) << 8) | (0xb))>;
   slew-rate = <1>;
   drive-push-pull;
   bias-pull-up;
  };
  pins2 {
   pinmux = <(((((('G') - 'A') * 0x10 + (15))) << 8) | (0xb))>;
   slew-rate = <2>;
   drive-push-pull;
   bias-pull-up;
  };
  pins3 {
   pinmux = <(((((('D') - 'A') * 0x10 + (0))) << 8) | (0xb))>;
   slew-rate = <1>;
   drive-open-drain;
   bias-pull-up;
  };
 };

 sdmmc3_b4_sleep_pins_b: sdmmc3-b4-sleep-1 {
  pins {
   pinmux = <(((((('F') - 'A') * 0x10 + (0))) << 8) | (0x11))>,
     <(((((('F') - 'A') * 0x10 + (4))) << 8) | (0x11))>,
     <(((((('D') - 'A') * 0x10 + (5))) << 8) | (0x11))>,
     <(((((('D') - 'A') * 0x10 + (7))) << 8) | (0x11))>,
     <(((((('G') - 'A') * 0x10 + (15))) << 8) | (0x11))>,
     <(((((('D') - 'A') * 0x10 + (0))) << 8) | (0x11))>;
  };
 };

 spdifrx_pins_a: spdifrx-0 {
  pins {
   pinmux = <(((((('G') - 'A') * 0x10 + (12))) << 8) | (0x9))>;
   bias-disable;
  };
 };

 spdifrx_sleep_pins_a: spdifrx-sleep-0 {
  pins {
   pinmux = <(((((('G') - 'A') * 0x10 + (12))) << 8) | (0x11))>;
  };
 };

 spi2_pins_a: spi2-0 {
  pins1 {
   pinmux = <(((((('B') - 'A') * 0x10 + (10))) << 8) | (0x6))>,
     <(((((('I') - 'A') * 0x10 + (3))) << 8) | (0x6))>;
   bias-disable;
   drive-push-pull;
   slew-rate = <1>;
  };

  pins2 {
   pinmux = <(((((('I') - 'A') * 0x10 + (2))) << 8) | (0x6))>;
   bias-disable;
  };
 };

 spi4_pins_a: spi4-0 {
  pins {
   pinmux = <(((((('E') - 'A') * 0x10 + (12))) << 8) | (0x6))>,
     <(((((('E') - 'A') * 0x10 + (6))) << 8) | (0x6))>;
   bias-disable;
   drive-push-pull;
   slew-rate = <1>;
  };
  pins2 {
   pinmux = <(((((('E') - 'A') * 0x10 + (13))) << 8) | (0x6))>;
   bias-disable;
  };
 };

 stusb1600_pins_a: stusb1600-0 {
  pins {
   pinmux = <(((((('I') - 'A') * 0x10 + (11))) << 8) | (0x0))>;
   bias-pull-up;
  };
 };

 tamp0_in1_pin_a: tamp0-in1-pin-0 {
  pins {
   pinmux = <(((((('C') - 'A') * 0x10 + (13))) << 8) | (0x12))>;
   st,tamp-id = <1>;
  };
 };
 tamp0_in2_pin_a: tamp0-in2-pin-0 {
  pins {
   pinmux = <(((((('I') - 'A') * 0x10 + (8))) << 8) | (0x12))>;
   st,tamp-id = <2>;
  };
 };
 tamp0_in3_pin_a: tamp0-in3-pin-0 {
  pins {
   pinmux = <(((((('C') - 'A') * 0x10 + (1))) << 8) | (0x12))>;
   st,tamp-id = <3>;
  };
 };
 tamp0_out2_pin_a: tamp0-out2-pin-0 {
  pins {
   pinmux = <(((((('C') - 'A') * 0x10 + (13))) << 8) | (0x12))>;
   st,tamp-id = <2>;
  };
 };
 tamp0_out3_pin_a: tamp0-out3-pin-0 {
  pins {
   pinmux = <(((((('I') - 'A') * 0x10 + (8))) << 8) | (0x12))>;
   st,tamp-id = <3>;
  };
 };
 tamp0_out3_pin_b: tamp0-out3-pin-1 {
  pins {
   pinmux = <(((((('C') - 'A') * 0x10 + (13))) << 8) | (0x12))>;
   st,tamp-id = <3>;
  };
 };

 uart4_pins_a: uart4-0 {
  pins1 {
   pinmux = <(((((('G') - 'A') * 0x10 + (11))) << 8) | (0x7))>;
   bias-disable;
   drive-push-pull;
   slew-rate = <0>;
  };
  pins2 {
   pinmux = <(((((('B') - 'A') * 0x10 + (2))) << 8) | (0x9))>;
   bias-disable;
  };
 };

 uart4_idle_pins_a: uart4-idle-0 {
  pins1 {
   pinmux = <(((((('G') - 'A') * 0x10 + (11))) << 8) | (0x11))>;
  };
  pins2 {
   pinmux = <(((((('B') - 'A') * 0x10 + (2))) << 8) | (0x9))>;
   bias-disable;
  };
 };

 uart4_sleep_pins_a: uart4-sleep-0 {
  pins {
   pinmux = <(((((('G') - 'A') * 0x10 + (11))) << 8) | (0x11))>,
     <(((((('B') - 'A') * 0x10 + (2))) << 8) | (0x11))>;
  };
 };

 uart4_pins_b: uart4-1 {
  pins1 {
   pinmux = <(((((('D') - 'A') * 0x10 + (1))) << 8) | (0x9))>;
   bias-disable;
   drive-push-pull;
   slew-rate = <0>;
  };
  pins2 {
   pinmux = <(((((('B') - 'A') * 0x10 + (2))) << 8) | (0x9))>;
   bias-disable;
  };
 };

 uart4_pins_c: uart4-2 {
  pins1 {
   pinmux = <(((((('G') - 'A') * 0x10 + (11))) << 8) | (0x7))>;
   bias-disable;
   drive-push-pull;
   slew-rate = <0>;
  };
  pins2 {
   pinmux = <(((((('B') - 'A') * 0x10 + (2))) << 8) | (0x9))>;
   bias-disable;
  };
 };

 uart7_pins_a: uart7-0 {
  pins1 {
   pinmux = <(((((('E') - 'A') * 0x10 + (8))) << 8) | (0x8))>;
   bias-disable;
   drive-push-pull;
   slew-rate = <0>;
  };
  pins2 {
   pinmux = <(((((('E') - 'A') * 0x10 + (7))) << 8) | (0x8))>,
     <(((((('E') - 'A') * 0x10 + (10))) << 8) | (0x8))>,
     <(((((('E') - 'A') * 0x10 + (9))) << 8) | (0x8))>;
   bias-disable;
  };
 };

 uart7_pins_b: uart7-1 {
  pins1 {
   pinmux = <(((((('F') - 'A') * 0x10 + (7))) << 8) | (0x8))>;
   bias-disable;
   drive-push-pull;
   slew-rate = <0>;
  };
  pins2 {
   pinmux = <(((((('F') - 'A') * 0x10 + (6))) << 8) | (0x8))>;
   bias-disable;
  };
 };

 uart7_pins_c: uart7-2 {
  pins1 {
   pinmux = <(((((('E') - 'A') * 0x10 + (8))) << 8) | (0x8))>;
   bias-disable;
   drive-push-pull;
   slew-rate = <0>;
  };
  pins2 {
   pinmux = <(((((('E') - 'A') * 0x10 + (7))) << 8) | (0x8))>;
   bias-pull-up;
  };
 };

 uart7_idle_pins_c: uart7-idle-2 {
  pins1 {
   pinmux = <(((((('E') - 'A') * 0x10 + (8))) << 8) | (0x11))>;
  };
  pins2 {
   pinmux = <(((((('E') - 'A') * 0x10 + (7))) << 8) | (0x8))>;
   bias-pull-up;
  };
 };

 uart7_sleep_pins_c: uart7-sleep-2 {
  pins {
   pinmux = <(((((('E') - 'A') * 0x10 + (8))) << 8) | (0x11))>,
     <(((((('E') - 'A') * 0x10 + (7))) << 8) | (0x11))>;
  };
 };

 uart8_pins_a: uart8-0 {
  pins1 {
   pinmux = <(((((('E') - 'A') * 0x10 + (1))) << 8) | (0x9))>;
   bias-disable;
   drive-push-pull;
   slew-rate = <0>;
  };
  pins2 {
   pinmux = <(((((('E') - 'A') * 0x10 + (0))) << 8) | (0x9))>;
   bias-disable;
  };
 };

 uart8_rtscts_pins_a: uart8rtscts-0 {
  pins {
   pinmux = <(((((('G') - 'A') * 0x10 + (7))) << 8) | (0x9))>,
     <(((((('G') - 'A') * 0x10 + (10))) << 8) | (0x9))>;
   bias-disable;
  };
 };

 usart2_pins_a: usart2-0 {
  pins1 {
   pinmux = <(((((('F') - 'A') * 0x10 + (5))) << 8) | (0x8))>,
     <(((((('D') - 'A') * 0x10 + (4))) << 8) | (0x8))>;
   bias-disable;
   drive-push-pull;
   slew-rate = <0>;
  };
  pins2 {
   pinmux = <(((((('D') - 'A') * 0x10 + (6))) << 8) | (0x8))>,
     <(((((('D') - 'A') * 0x10 + (3))) << 8) | (0x8))>;
   bias-disable;
  };
 };

 usart2_sleep_pins_a: usart2-sleep-0 {
  pins {
   pinmux = <(((((('F') - 'A') * 0x10 + (5))) << 8) | (0x11))>,
     <(((((('D') - 'A') * 0x10 + (4))) << 8) | (0x11))>,
     <(((((('D') - 'A') * 0x10 + (6))) << 8) | (0x11))>,
     <(((((('D') - 'A') * 0x10 + (3))) << 8) | (0x11))>;
  };
 };

 usart2_pins_b: usart2-1 {
  pins1 {
   pinmux = <(((((('F') - 'A') * 0x10 + (5))) << 8) | (0x8))>,
     <(((((('A') - 'A') * 0x10 + (1))) << 8) | (0x8))>;
   bias-disable;
   drive-push-pull;
   slew-rate = <0>;
  };
  pins2 {
   pinmux = <(((((('F') - 'A') * 0x10 + (4))) << 8) | (0x8))>,
     <(((((('E') - 'A') * 0x10 + (15))) << 8) | (0x8))>;
   bias-disable;
  };
 };

 usart2_sleep_pins_b: usart2-sleep-1 {
  pins {
   pinmux = <(((((('F') - 'A') * 0x10 + (5))) << 8) | (0x11))>,
     <(((((('A') - 'A') * 0x10 + (1))) << 8) | (0x11))>,
     <(((((('F') - 'A') * 0x10 + (4))) << 8) | (0x11))>,
     <(((((('E') - 'A') * 0x10 + (15))) << 8) | (0x11))>;
  };
 };

 usart2_pins_c: usart2-2 {
  pins1 {
   pinmux = <(((((('D') - 'A') * 0x10 + (5))) << 8) | (0x8))>,
     <(((((('D') - 'A') * 0x10 + (4))) << 8) | (0x8))>;
   bias-disable;
   drive-push-pull;
   slew-rate = <0>;
  };
  pins2 {
   pinmux = <(((((('D') - 'A') * 0x10 + (6))) << 8) | (0x8))>,
     <(((((('D') - 'A') * 0x10 + (3))) << 8) | (0x8))>;
   bias-disable;
  };
 };

 usart2_idle_pins_c: usart2-idle-2 {
  pins1 {
   pinmux = <(((((('D') - 'A') * 0x10 + (5))) << 8) | (0x11))>,
     <(((((('D') - 'A') * 0x10 + (3))) << 8) | (0x11))>;
  };
  pins2 {
   pinmux = <(((((('D') - 'A') * 0x10 + (4))) << 8) | (0x8))>;
   bias-disable;
   drive-push-pull;
   slew-rate = <0>;
  };
  pins3 {
   pinmux = <(((((('D') - 'A') * 0x10 + (6))) << 8) | (0x8))>;
   bias-disable;
  };
 };

 usart2_sleep_pins_c: usart2-sleep-2 {
  pins {
   pinmux = <(((((('D') - 'A') * 0x10 + (5))) << 8) | (0x11))>,
     <(((((('D') - 'A') * 0x10 + (4))) << 8) | (0x11))>,
     <(((((('D') - 'A') * 0x10 + (6))) << 8) | (0x11))>,
     <(((((('D') - 'A') * 0x10 + (3))) << 8) | (0x11))>;
  };
 };

 usart3_pins_a: usart3-0 {
  pins1 {
   pinmux = <(((((('B') - 'A') * 0x10 + (10))) << 8) | (0x8))>;
   bias-disable;
   drive-push-pull;
   slew-rate = <0>;
  };
  pins2 {
   pinmux = <(((((('B') - 'A') * 0x10 + (12))) << 8) | (0x9))>;
   bias-disable;
  };
 };

 usart3_pins_b: usart3-1 {
  pins1 {
   pinmux = <(((((('B') - 'A') * 0x10 + (10))) << 8) | (0x8))>,
     <(((((('G') - 'A') * 0x10 + (8))) << 8) | (0x9))>;
   bias-disable;
   drive-push-pull;
   slew-rate = <0>;
  };
  pins2 {
   pinmux = <(((((('B') - 'A') * 0x10 + (12))) << 8) | (0x9))>,
     <(((((('I') - 'A') * 0x10 + (10))) << 8) | (0x9))>;
   bias-pull-up;
  };
 };

 usart3_idle_pins_b: usart3-idle-1 {
  pins1 {
   pinmux = <(((((('B') - 'A') * 0x10 + (10))) << 8) | (0x11))>,
     <(((((('I') - 'A') * 0x10 + (10))) << 8) | (0x11))>;
  };
  pins2 {
   pinmux = <(((((('G') - 'A') * 0x10 + (8))) << 8) | (0x9))>;
   bias-disable;
   drive-push-pull;
   slew-rate = <0>;
  };
  pins3 {
   pinmux = <(((((('B') - 'A') * 0x10 + (12))) << 8) | (0x9))>;
   bias-pull-up;
  };
 };

 usart3_sleep_pins_b: usart3-sleep-1 {
  pins {
   pinmux = <(((((('B') - 'A') * 0x10 + (10))) << 8) | (0x11))>,
     <(((((('G') - 'A') * 0x10 + (8))) << 8) | (0x11))>,
     <(((((('I') - 'A') * 0x10 + (10))) << 8) | (0x11))>,
     <(((((('B') - 'A') * 0x10 + (12))) << 8) | (0x11))>;
  };
 };

 usart3_pins_c: usart3-2 {
  pins1 {
   pinmux = <(((((('B') - 'A') * 0x10 + (10))) << 8) | (0x8))>,
     <(((((('G') - 'A') * 0x10 + (8))) << 8) | (0x9))>;
   bias-disable;
   drive-push-pull;
   slew-rate = <0>;
  };
  pins2 {
   pinmux = <(((((('B') - 'A') * 0x10 + (12))) << 8) | (0x9))>,
     <(((((('B') - 'A') * 0x10 + (13))) << 8) | (0x8))>;
   bias-pull-up;
  };
 };

 usart3_idle_pins_c: usart3-idle-2 {
  pins1 {
   pinmux = <(((((('B') - 'A') * 0x10 + (10))) << 8) | (0x11))>,
     <(((((('B') - 'A') * 0x10 + (13))) << 8) | (0x11))>;
  };
  pins2 {
   pinmux = <(((((('G') - 'A') * 0x10 + (8))) << 8) | (0x9))>;
   bias-disable;
   drive-push-pull;
   slew-rate = <0>;
  };
  pins3 {
   pinmux = <(((((('B') - 'A') * 0x10 + (12))) << 8) | (0x9))>;
   bias-pull-up;
  };
 };

 usart3_sleep_pins_c: usart3-sleep-2 {
  pins {
   pinmux = <(((((('B') - 'A') * 0x10 + (10))) << 8) | (0x11))>,
     <(((((('G') - 'A') * 0x10 + (8))) << 8) | (0x11))>,
     <(((((('B') - 'A') * 0x10 + (13))) << 8) | (0x11))>,
     <(((((('B') - 'A') * 0x10 + (12))) << 8) | (0x11))>;
  };
 };

 usart3_pins_d: usart3-3 {
  pins1 {
   pinmux = <(((((('B') - 'A') * 0x10 + (10))) << 8) | (0x8))>,
     <(((((('G') - 'A') * 0x10 + (8))) << 8) | (0x9))>;
   bias-disable;
   drive-push-pull;
   slew-rate = <0>;
  };
  pins2 {
   pinmux = <(((((('D') - 'A') * 0x10 + (9))) << 8) | (0x8))>,
     <(((((('D') - 'A') * 0x10 + (11))) << 8) | (0x8))>;
   bias-disable;
  };
 };

 usart3_idle_pins_d: usart3-idle-3 {
  pins1 {
   pinmux = <(((((('B') - 'A') * 0x10 + (10))) << 8) | (0x11))>,
     <(((((('G') - 'A') * 0x10 + (8))) << 8) | (0x11))>,
     <(((((('D') - 'A') * 0x10 + (11))) << 8) | (0x11))>;
  };
  pins2 {
   pinmux = <(((((('D') - 'A') * 0x10 + (9))) << 8) | (0x8))>;
   bias-disable;
  };
 };

 usart3_sleep_pins_d: usart3-sleep-3 {
  pins {
   pinmux = <(((((('B') - 'A') * 0x10 + (10))) << 8) | (0x11))>,
     <(((((('G') - 'A') * 0x10 + (8))) << 8) | (0x11))>,
     <(((((('D') - 'A') * 0x10 + (11))) << 8) | (0x11))>,
     <(((((('D') - 'A') * 0x10 + (9))) << 8) | (0x11))>;
  };
 };

 usbotg_hs_pins_a: usbotg-hs-0 {
  pins {
   pinmux = <(((((('A') - 'A') * 0x10 + (10))) << 8) | (0x11))>;
  };
 };

 usbotg_fs_dp_dm_pins_a: usbotg-fs-dp-dm-0 {
  pins {
   pinmux = <(((((('A') - 'A') * 0x10 + (11))) << 8) | (0x11))>,
     <(((((('A') - 'A') * 0x10 + (12))) << 8) | (0x11))>;
  };
 };
};

&pinctrl_z {
 i2c2_pins_b2: i2c2-0 {
  pins {
   pinmux = <(((((('Z') - 'A') * 0x10 + (0))) << 8) | (0x4))>;
   bias-disable;
   drive-open-drain;
   slew-rate = <0>;
  };
 };

 i2c2_sleep_pins_b2: i2c2-sleep-0 {
  pins {
   pinmux = <(((((('Z') - 'A') * 0x10 + (0))) << 8) | (0x11))>;
  };
 };

 i2c4_pins_a: i2c4-0 {
  pins {
   pinmux = <(((((('Z') - 'A') * 0x10 + (4))) << 8) | (0x7))>,
     <(((((('Z') - 'A') * 0x10 + (5))) << 8) | (0x7))>;
   bias-disable;
   drive-open-drain;
   slew-rate = <0>;
  };
 };

 i2c4_sleep_pins_a: i2c4-sleep-0 {
  pins {
   pinmux = <(((((('Z') - 'A') * 0x10 + (4))) << 8) | (0x11))>,
     <(((((('Z') - 'A') * 0x10 + (5))) << 8) | (0x11))>;
  };
 };

 i2c6_pins_a: i2c6-0 {
  pins {
   pinmux = <(((((('Z') - 'A') * 0x10 + (6))) << 8) | (0x3))>,
     <(((((('Z') - 'A') * 0x10 + (7))) << 8) | (0x3))>;
   bias-disable;
   drive-open-drain;
   slew-rate = <0>;
  };
 };

 i2c6_sleep_pins_a: i2c6-sleep-0 {
  pins {
   pinmux = <(((((('Z') - 'A') * 0x10 + (6))) << 8) | (0x11))>,
     <(((((('Z') - 'A') * 0x10 + (7))) << 8) | (0x11))>;
  };
 };

 spi1_pins_a: spi1-0 {
  pins1 {
   pinmux = <(((((('Z') - 'A') * 0x10 + (0))) << 8) | (0x6))>,
     <(((((('Z') - 'A') * 0x10 + (2))) << 8) | (0x6))>;
   bias-disable;
   drive-push-pull;
   slew-rate = <1>;
  };

  pins2 {
   pinmux = <(((((('Z') - 'A') * 0x10 + (1))) << 8) | (0x6))>;
   bias-disable;
  };
 };

 spi1_pins_b: spi1-1 {
  pins1 {
   pinmux = <(((((('A') - 'A') * 0x10 + (5))) << 8) | (0x6))>,
     <(((((('B') - 'A') * 0x10 + (5))) << 8) | (0x6))>;
   bias-disable;
   drive-push-pull;
   slew-rate = <1>;
  };

  pins2 {
   pinmux = <(((((('A') - 'A') * 0x10 + (6))) << 8) | (0x6))>;
   bias-disable;
  };
 };
};
# 24 "core/arch/arm/dts/stm32mp151a-stm32-computer-firmware-mx.dts" 2

# 1 "core/include/dt-bindings/power/stm32mp1-power.h" 1
# 26 "core/arch/arm/dts/stm32mp151a-stm32-computer-firmware-mx.dts" 2
# 1 "core/include/dt-bindings/mfd/st,stpmic1.h" 1
# 27 "core/arch/arm/dts/stm32mp151a-stm32-computer-firmware-mx.dts" 2
# 1 "core/include/dt-bindings/soc/stm32mp-provisioning.h" 1
# 28 "core/arch/arm/dts/stm32mp151a-stm32-computer-firmware-mx.dts" 2
# 1 "core/include/dt-bindings/tamper/st,stm32-tamp.h" 1
# 29 "core/arch/arm/dts/stm32mp151a-stm32-computer-firmware-mx.dts" 2


/ {
 model = "STMicroelectronics custom STM32CubeMX board - openstlinux-6.1-yocto-mickledore-mpu-v24.06.26";
 compatible = "st,stm32mp151a-stm32-computer-firmware-mx", "st,stm32mp151";

 memory@c0000000 {
  device_type = "memory";
  reg = <0xc0000000 0x20000000>;



 };

 reserved-memory {
  #address-cells = <1>;
  #size-cells = <1>;
  ranges;


  mcusram1:mcuram@10000000{
   compatible = "shared-dma-pool";
   reg = <0x10000000 0x20000>;
   no-map;
  };

  mcusram2:mcuram@10020000{
   compatible = "shared-dma-pool";
   reg = <0x10020000 0x20000>;
   no-map;
  };

  mcusram3:mcuram@10040000{
   compatible = "shared-dma-pool";
   reg = <0x10040000 0x10000>;
   no-map;
  };

  retram:retram@38000000{
   compatible = "shared-dma-pool";
   reg = <0x38000000 0x10000>;
   no-map;
  };

 };


 aliases {
  serial0 = &uart4;
 };

 chosen {
  stdout-path = "serial0:115200n8";
 };

 vin: vin {
  compatible = "regulator-fixed";
  regulator-name = "vin";
  regulator-min-microvolt = <5000000>;
  regulator-max-microvolt = <5000000>;
  regulator-always-on;
 };

 led {
  compatible = "gpio-leds";
  led-blue {
   label = "heartbeat";
   gpios = <&gpioa 14 1>;
   1,default-trigger = "heartbeat";
   default-state = "off";
  };
 };

 shadow-prov{
  compatible = "st,provisioning";

  hw2_prov{
   nvmem-cells = <&hw2_otp>;
   st,shadow-value = <0x000001E0>;
   st,shadow-lock = <2>;
  };
 };


 clocks {



  clk_hsi: clk-hsi {
   clock-frequency = <64000000>;



  };
  clk_lse: clk-lse {
   clock-frequency = <32768>;
   st,drive = < 2 >;



  };
  clk_hse: clk-hse {
   clock-frequency = <24000000>;
   st,digbypass;



  };
 };

};


&pinctrl {
 i2c4_pins_mx: i2c4_mx-0 {
  pins {
   pinmux = <(((((('F') - 'A') * 0x10 + (14))) << 8) | (0x5))>,
      <(((((('F') - 'A') * 0x10 + (15))) << 8) | (0x5))>;
   bias-disable;
   drive-open-drain;
   slew-rate = <0>;
  };
 };

 rcc_pins_mx: rcc_mx-0 {
  pins {
   pinmux = <(((((('C') - 'A') * 0x10 + (14))) << 8) | (0x11))>,
      <(((((('C') - 'A') * 0x10 + (15))) << 8) | (0x11))>,
      <(((((('H') - 'A') * 0x10 + (0))) << 8) | (0x11))>,
      <(((((('H') - 'A') * 0x10 + (1))) << 8) | (0x11))>;
  };
 };


 uart4_pins_mx: uart4_mx-0 {
  pins1 {
   pinmux = <(((((('B') - 'A') * 0x10 + (2))) << 8) | (0x9))>;
   bias-disable;
  };
  pins2 {
   pinmux = <(((((('G') - 'A') * 0x10 + (11))) << 8) | (0x7))>;
   bias-disable;
   drive-push-pull;
   slew-rate = <0>;
  };
 };

};

&pinctrl_z {


};

&bsec{
 status = "okay";


 huk_otp: huk-otp@f0 {
  reg = <0xf0 0x10>;
 };

 board_id:board_id@ec{
  reg = <0xec 0x4>;
  st,non-secure-otp;
 };

};

&etzpc{
 status = "okay";
 st,decprot = <

 (((10) << 16) | ((0x1) << 8) | (0x1))
 (((11) << 16) | ((0x1) << 8) | (0x1))

 (((88) << 16) | ((0x3) << 8) | (0x0))
 (((90) << 16) | ((0x3) << 8) | (0x0))
 (((94) << 16) | ((0x3) << 8) | (0x0))
 (((38) << 16) | ((0x3) << 8) | (0x0))
 (((34) << 16) | ((0x3) << 8) | (0x0))
 (((5) << 16) | ((0x3) << 8) | (0x0))
 (((27) << 16) | ((0x3) << 8) | (0x0))
 (((7) << 16) | ((0x3) << 8) | (0x0))
 (((32) << 16) | ((0x3) << 8) | (0x0))
 (((85) << 16) | ((0x3) << 8) | (0x0))

 (((0) << 16) | ((0x0) << 8) | (0x0))

 (((89) << 16) | ((0x2) << 8) | (0x0))
# 228 "core/arch/arm/dts/stm32mp151a-stm32-computer-firmware-mx.dts"
 >;



};

&i2c4{
 pinctrl-names = "default";
 pinctrl-0 = <&i2c4_pins_mx>;
 status = "okay";


 compatible = "st,stm32mp15-i2c-non-secure";
 i2c-scl-rising-time-ns = <185>;
 i2c-scl-falling-time-ns = <20>;
 clock-frequency = <400000>;
 /delete-property/dmas;
 /delete-property/dma-names;

 pmic: stpmic@33 {
  compatible = "st,stpmic1";
  reg = <0x33>;
  interrupts-extended = <&gpioa 0 2>;
  interrupt-controller;
  #interrupt-cells = <2>;
  status = "okay";

  regulators {
   compatible = "st,stpmic1-regulators";
   buck1-supply = <&vin>;
   buck2-supply = <&vin>;
   buck3-supply = <&vin>;
   buck4-supply = <&vin>;

   ldo2-supply = <&vin>;
   ldo3-supply = <&vdd_ddr>;
   ldo4-supply = <&vin>;
   ldo5-supply = <&vin>;
   ldo6-supply = <&v3v3>;
   vref_ddr-supply = <&vin>;
   boost-supply = <&vin>;




   vddcore: buck1 {
    regulator-name = "vddcore";
    regulator-min-microvolt = <1200000>;
    regulator-max-microvolt = <1350000>;
    regulator-always-on;
    regulator-initial-mode = <0>;
    regulator-over-current-protection;

    lp-stop{
     regulator-on-in-suspend;
     regulator-suspend-microvolt = <1200000>;
    };

    standby-ddr-sr{
     regulator-off-in-suspend;
    };

    standby-ddr-off{
     regulator-off-in-suspend;
    };
   };

   vdd_ddr: buck2 {
    regulator-name = "vdd_ddr";
    regulator-min-microvolt = <1350000>;
    regulator-max-microvolt = <1350000>;
    regulator-always-on;
    regulator-initial-mode = <0>;
    regulator-over-current-protection;

    lp-stop{
     regulator-suspend-microvolt = <1350000>;
     regulator-on-in-suspend;
    };

    standby-ddr-sr{
     regulator-suspend-microvolt = <1350000>;
     regulator-on-in-suspend;
    };

    standby-ddr-off{
     regulator-off-in-suspend;
    };
   };

   vdd: buck3 {
    regulator-name = "vdd";
    regulator-min-microvolt = <3300000>;
    regulator-max-microvolt = <3300000>;
    regulator-always-on;
    st,mask-reset;
    regulator-initial-mode = <0>;
    regulator-over-current-protection;

    lp-stop{
     regulator-suspend-microvolt = <3300000>;
     regulator-on-in-suspend;
    };

    standby-ddr-sr{
     regulator-suspend-microvolt = <3300000>;
     regulator-on-in-suspend;
    };

    standby-ddr-off{
     regulator-suspend-microvolt = <3300000>;
     regulator-on-in-suspend;
    };
   };

   v3v3: buck4 {
    regulator-name = "v3v3";
    regulator-min-microvolt = <3300000>;
    regulator-max-microvolt = <3300000>;
    regulator-always-on;
    regulator-over-current-protection;
    regulator-initial-mode = <0>;

    lp-stop{
     regulator-suspend-microvolt = <3300000>;
     regulator-on-in-suspend;
    };

    standby-ddr-sr{
     regulator-off-in-suspend;
    };

    standby-ddr-off{
     regulator-off-in-suspend;
    };
   };
# 382 "core/arch/arm/dts/stm32mp151a-stm32-computer-firmware-mx.dts"
   v3v3_hdmi: ldo2 {
    regulator-name = "v3v3_hdmi";
    regulator-min-microvolt = <3300000>;
    regulator-max-microvolt = <3300000>;
    regulator-always-on;
    interrupts = <17 0>;

    standby-ddr-sr{
     regulator-off-in-suspend;
    };

    standby-ddr-off{
     regulator-off-in-suspend;
    };
   };

   vtt_ddr: ldo3 {
    regulator-name = "vtt_ddr";
    regulator-always-on;
    regulator-over-current-protection;
    st,regulator-sink-source;

    lp-stop{
     regulator-off-in-suspend;
    };

    standby-ddr-sr{
     regulator-off-in-suspend;
    };

    standby-ddr-off{
     regulator-off-in-suspend;
    };
   };

   vdd_usb: ldo4 {
    regulator-name = "vdd_usb";
    regulator-always-on;
    interrupts = <19 0>;

    standby-ddr-sr{
     regulator-off-in-suspend;
    };

    standby-ddr-off{
     regulator-off-in-suspend;
    };
   };

   vdda: ldo5 {
    regulator-name = "vdda";
    regulator-always-on;
    regulator-min-microvolt = <2900000>;
    regulator-max-microvolt = <2900000>;
    interrupts = <20 0>;
    regulator-boot-on;

    standby-ddr-sr{
     regulator-off-in-suspend;
    };

    standby-ddr-off{
     regulator-off-in-suspend;
    };
   };

   v1v2_hdmi: ldo6 {
    regulator-name = "v1v2_hdmi";
    regulator-min-microvolt = <1200000>;
    regulator-max-microvolt = <1200000>;
    regulator-always-on;
    interrupts = <21 0>;

    standby-ddr-sr{
     regulator-off-in-suspend;
    };

    standby-ddr-off{
     regulator-off-in-suspend;
    };
   };

   vref_ddr: vref_ddr {
    regulator-name = "vref_ddr";
    regulator-always-on;

    lp-stop{
     regulator-on-in-suspend;
    };

    standby-ddr-sr{
     regulator-on-in-suspend;
    };

    standby-ddr-off{
     regulator-off-in-suspend;
    };
   };
# 499 "core/arch/arm/dts/stm32mp151a-stm32-computer-firmware-mx.dts"
  };

  onkey {
   compatible = "st,stpmic1-onkey";
   interrupts = <0 0>, <1 0>;
   interrupt-names = "onkey-falling", "onkey-rising";
   power-off-time-sec = <10>;
   status = "okey";
  };

  watchdog {
   compatible = "st,stpmic1-wdt";
   status = "disabled";
  };
 };


};

&pwr_regulators{
 status = "okay";


 system_suspend_supported_soc_modes = <
  0
  2
  5
 >;
 system_off_soc_mode = <6>;
 vdd-supply = <&vdd>;
 vdd_3v3_usbfs-supply = <&vdd_usb>;

};

&rcc{
 pinctrl-names = "default";
 pinctrl-0 = <&rcc_pins_mx>;
 status = "okay";





 st,clksrc = <
  ((1 << 26) | ((6) << 4) | (3))
  ((1 << 26) | ((41) << 4) | (0))
  ((1 << 26) | ((8) << 4) | (2))
  ((1 << 26) | ((16) << 4) | (1))
  ((1 << 26) | ((19) << 4) | (1))
  ((1 << 26) | ((25) << 4) | (2))
  ((1 << 26) | ((15) << 4) | (1))
  ((1 << 26) | ((22) << 4) | (0))
  ((1 << 26) | ((23) << 4) | (2))
  ((1 << 26) | ((30) << 4) | (2))
  ((1 << 26) | ((12) << 4) | (0))
  ((1 << 26) | ((0) << 4) | (2))
  ((1 << 26) | ((1) << 4) | (2))
  ((1 << 26) | ((2) << 4) | (3))
  ((2 << 26) | ((192) << 11) | (1) | 0x00000400)
  ((1 << 31) | ((0x800) << 16) | (0 << 12))
  ((1 << 31) | ((0x804) << 16) | (0 << 12))
 >;
 st,clkdiv = <
  ((0 << 26) | ((10) << 8) | (1))
  ((0 << 26) | ((11) << 8) | (0))
  ((0 << 26) | ((12) << 8) | (0))
  ((0 << 26) | ((13) << 8) | (1))
  ((0 << 26) | ((14) << 8) | (1))
  ((0 << 26) | ((15) << 8) | (1))
  ((0 << 26) | ((16) << 8) | (1))
  ((0 << 26) | ((17) << 8) | (2))
  ((0 << 26) | ((19) << 8) | (0))
  ((0 << 26) | ((20) << 8) | (0))
  ((0 << 26) | ((21) << 8) | (0))
 >;
 st,pll_vco {
  pll1_vco_1300Mhz: pll1-vco-1300Mhz {
   src = < ((1 << 26) | ((3) << 4) | (1)) >;
   divmn = < 2 80 >;
   frac = < 0x800 >;
  };
  pll2_vco_1066Mhz: pll2-vco-1066Mhz {
   src = < ((1 << 26) | ((3) << 4) | (1)) >;
   divmn = < 2 65 >;
   frac = < 0x1400 >;
  };
  pll3_vco_417Mhz: pll3-vco-417Mhz {
   src = < ((1 << 26) | ((4) << 4) | (1)) >;
   divmn = < 1 33 >;
   frac = < 0x1a04 >;
  };
  pll4_vco_594Mhz: pll4-vco-594Mhz {
   src = < ((1 << 26) | ((5) << 4) | (1)) >;
   divmn = < 3 98 >;
  };


 };

 pll1:st,pll@0 {
  compatible = "st,stm32mp1-pll";
  reg = <0>;

  st,pll = < &pll1_cfg1 >;

  pll1_cfg1: pll1_cfg1 {
   st,pll_vco = < &pll1_vco_1300Mhz >;
   st,pll_div_pqr = < 0 1 1 >;
  };


 };

 pll2:st,pll@1 {
  compatible = "st,stm32mp1-pll";
  reg = <1>;

  st,pll = < &pll2_cfg1 >;

  pll2_cfg1: pll2_cfg1 {
   st,pll_vco = < &pll2_vco_1066Mhz >;
   st,pll_div_pqr = < 1 1 0 >;
  };


 };

 pll3:st,pll@2 {
  compatible = "st,stm32mp1-pll";
  reg = <2>;

  st,pll = < &pll3_cfg1 >;

  pll3_cfg1: pll3_cfg1 {
   st,pll_vco = < &pll3_vco_417Mhz >;
   st,pll_div_pqr = < 1 16 36 >;
  };


 };

 pll4:st,pll@3 {
  compatible = "st,stm32mp1-pll";
  reg = <3>;

  st,pll = < &pll4_cfg1 >;

  pll4_cfg1: pll4_cfg1 {
   st,pll_vco = < &pll4_vco_594Mhz >;
   st,pll_div_pqr = < 59 7 7 >;
  };


 };




};

&rng1{
 status = "okay";



};

&rtc{
 status = "okay";



};

&tamp{
 status = "okay";


 st,tamp-passive-nb-sample = <4>;
 st,tamp-passive-sample-clk-div = <16384>;

};


&clk_hse {
 st,digbypass;
};

&cpu0 {
 cpu-frequency = <650000000>;
 cpu-supply = <&vddcore>;
};

&uart4 {
 pinctrl-names = "default";
 pinctrl-0 = <&uart4_pins_mx>;
 /delete-property/dmas;
 /delete-property/dma-names;
 reg = <0x40010000 0x400>;
 status = "okay";
};
# 713 "core/arch/arm/dts/stm32mp151a-stm32-computer-firmware-mx.dts"
&usbphyc_port0{
 phy-supply = <&vdd_usb>;
 st,tune-hs-dc-level = <2>;
 st,enable-fs-rftime-tuning;
 st,enable-hs-rftime-reduction;
 st,trim-hs-current = <15>;
 st,trim-hs-impedance = <1>;
 st,tune-squelch-level = <3>;
 st,tune-hs-rx-offset = <2>;
 st,no-lsfs-sc;
};

&usbphyc_port1{
 phy-supply = <&vdd_usb>;
 st,tune-hs-dc-level = <2>;
 st,enable-fs-rftime-tuning;
 st,enable-hs-rftime-reduction;
 st,trim-hs-current = <15>;
 st,trim-hs-impedance = <1>;
 st,tune-squelch-level = <3>;
 st,tune-hs-rx-offset = <2>;
 st,no-lsfs-sc;
};
