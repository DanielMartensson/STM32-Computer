## Firmware/STM32-Computer-Firmware/CA7/optee-os-3.19.0-r2/optee-os-stm32mp-3.19.0-stm32mp-r2/documentation/devicetree/bindings/mailbox/st,stm32-ipcc.yaml
```yaml
# SPDX-License-Identifier: (GPL-2.0 OR BSD-2-Clause)
%YAML 1.2
---
$id: "http://devicetree.org/schemas/mailbox/st,stm32-ipcc.yaml#"
$schema: "http://devicetree.org/meta-schemas/core.yaml#"

title: STMicroelectronics STM32 IPC controller bindings

description:
  The IPCC block provides a non blocking signaling mechanism to post and
  retrieve messages in an atomic way between two processors.
  It provides the signaling for N bidirectionnal channels. The number of
  channels (N) can be read from a dedicated register.
  Depending on the DT channel parameter, the client can choice between be called under interrupt
  normal or context.

maintainers:
  - Fabien Dessenne <fabien.dessenne@foss.st.com>
  - Arnaud Pouliquen <arnaud.pouliquen@foss.st.com>

properties:
  compatible:
    enum:
      - st,stm32mp1-ipcc
      - st,stm32mp25-ipcc

  reg:
    maxItems: 1

  clocks:
    maxItems: 1

  interrupts:
    items:
      - description: rx channel occupied
      - description: tx channel free

  interrupt-names:
    items:
      - const: rx
      - const: tx

  wakeup-source: true

  "#mbox-cells":
    const: 1

  st,proc-id:
    description: Processor id using the mailbox (0 or 1)
    $ref: /schemas/types.yaml#/definitions/uint32
    enum: [0, 1]

  st,protreg:
    minItems: 1
    maxItems: 16
    $ref: "/schemas/types.yaml#/definitions/uint32-array"
    description:
      Describes the firewall hardware configuration to apply for a given
      channel.

      RIFPROT(ipcc_chan_id, sem_list, lock, sec, priv, scid, sem_en, cfen)

      When a field isn't effective, it should be filled with RIF_UNUSED.

        "ipcc_chan_id" The tamp channel number.

        "sem_list" This peripheral does not support semaphores.
                  This field must be set to RIF_UNUSED.

        "lock" This peripheral does not support configuration locking.
              This field must be set to RIF_UNUSED.

        "sec" Configures secure-only access to the channel.
          RIF_SEC, only secure access is granted to the channel
          RIF_NSEC, secure/non-secure access is granted to the
                    channel

        "priv" Configures the privilege level needed to access this
              channel.
          RIF_PRIV, only privileged access is granted to the channel
          RIF_NPRIV, privileged/Unprivileged access is granted to the
                    channel

        "scid" Configures the static CID that is allowed to access the
              channel. Note that the static CID configuration is
              ineffective if the semaphore mode is enabled. Mandates CID
              filtering enabled to be effective.
          RIF_CID1 allows CID 1 to access the channel
          RIF_CID2 allows CID 2 to access the channel ...

        "sem_en" This peripheral does not support semaphores.
                This field must be set to RIF_UNUSED.

        "cfen" Enable/disable the CID filtering for this channel.
          RIF_CFEN, enables the CID filtering
          RIF_CFDIS, disables the CID filtering

allOf:
  - if:
      not:
        properties:
          compatible:
            contains:
              const: st,stm32mp25-ipcc

    then:
      properties:
        st,protreg: false

required:
  - compatible
  - reg
  - st,proc-id
  - clocks
  - interrupt-names
  - "#mbox-cells"
  - interrupts

additionalProperties: false

examples:
  - |

    #include <dt-bindings/interrupt-controller/arm-gic.h>
    #include <dt-bindings/clock/stm32mp1-clks.h>
    ipcc: mailbox@4c001000 {
      compatible = "st,stm32mp1-ipcc";
      #mbox-cells = <1>;
      reg = <0x4c001000 0x400>;
      st,proc-id = <0>;
      interrupts-extended = <&exti 61 1>,
                            <&intc GIC_SPI 101 IRQ_TYPE_LEVEL_HIGH>;
      interrupt-names = "rx", "tx";
      clocks = <&rcc_clk IPCC>;
      wakeup-source;
    };

    /*The client 1 uses the mailbox channel 0 and 1 in normal context */
    mbox_clt1 {
      mboxes = <&ipcc 0x0>, <&ipcc 1>;
    };

    /*
     * The Client 2 uses mailbox channel 2 and 3 in interrupt context
     * (add 0x100 to the channel value).
     */

    mbox_clt2 {
      mboxes = <&ipcc 0x102>, <&ipcc 103>;
    };
```

## Firmware/STM32-Computer-Firmware/CA7/optee-os-3.19.0-r2/optee-os-stm32mp-3.19.0-stm32mp-r2/documentation/devicetree/bindings/mfd/st,stm32mp25-pwr.yaml
```yaml
# SPDX-License-Identifier: (GPL-2.0-only OR BSD-2-Clause)
%YAML 1.2
---
$id: http://devicetree.org/schemas/mfd/st,stm32mp25-pwr.yaml#
$schema: http://devicetree.org/meta-schemas/core.yaml#

title: STM32MP25 PWR

description: STMicroelectronics STM32MP25 PWR peripheral
  This hardware block provides some power supplies
  configuration and wake-up pin interrupts.

maintainers:
  - Pascal Paillet <p.paillet@st.com>

properties:
  compatible:
    const: st,stm32mp25-pwr

  reg:
    maxItems: 1

  interrupts:
    description: contains the PWR Wake-up pin interrupt line.
    maxItems: 1

  wakeup-parent: true

patternProperties:
  "^(vdd33ucpd|vdda18adc|vddgpu|vddio|vddio1|vddio2|vddio3|vddio4)$":
    type: object

    $ref: "regulator.yaml#"

    properties:
      compatible:
        const: st,stm32mp25-pwr-regu

      vdd-supply:
        description: Input supply phandle(s) for vdd and vddio input

    patternProperties:
      ".*-supply$":
        description: Input supply phandle(s) for this node

required:
  - compatible
  - reg

additionalProperties: false

examples:
  - |
    pwr: pwr@44210000 {
      compatible = "st,stm32mp25-pwr";
      reg = <0x44210000 0x400>;
      wakeup-parent = <&exti1>;
      interrupts = <GIC_SPI 226 IRQ_TYPE_LEVEL_HIGH>;

      vdd33ucpd: vdd33ucpd {
        compatible = "st,stm32mp25-pwr-regu";
        regulator-name = "vdd33ucpd";
        vdd33ucpd-supply = <&vdd3v3_usb>;
      };

      vdda18adc: vdda18adc {
        compatible = "st,stm32mp25-pwr-regu";
        regulator-name = "vdda18adc";
        vdda18adc-supply = <&v1v8>;
      };

      vddgpu: vddgpu {
        compatible = "st,stm32mp25-pwr-regu";
        regulator-name = "vddgpu";
        vddgpu-supply = <&vddgpu_pmic>;
      };

      vddio1: vddio1 {
        compatible = "st,stm32mp25-pwr-regu";
        regulator-name = "vddio1";
        vddio1-supply = <&vddio_sdcard>;
      };

      vddio: vddio {
        compatible = "st,stm32mp25-pwr-regu";
        regulator-name = "vddio";
        vdd-supply = <&vdd>;
      };
    };
...
```
