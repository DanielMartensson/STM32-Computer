## Firmware/STM32-Computer-Firmware/CA7/optee-os-3.19.0-r2/optee-os-stm32mp-3.19.0-stm32mp-r2/documentation/devicetree/bindings/mfd/st,stpmic2.yaml
```yaml
# SPDX-License-Identifier: (GPL-2.0-only OR BSD-2-Clause)
%YAML 1.2
---
$id: http://devicetree.org/schemas/mfd/st,stpmic2.yaml#
$schema: http://devicetree.org/meta-schemas/core.yaml#

title: STMicroelectonics STPMIC2 Power Management IC bindings

description: STMicroelectronics STPMIC2 Power Management IC

maintainers:
  - pascal Paillet <p.paillet@st.com>

properties:
  compatible:
    const: st,stpmic2

  reg:
    const: 0x33

  st,wakeup-pin-number:
    description: Pin used as wake-up source when for MP2
    $ref: /schemas/types.yaml#/definitions/uint32

  st,pmic-it-id:
    description: PMIC interruptions ids to forward to the non-secure world
      in the form of OPTEE notifications described by st,notif-it-id.
        PKEY_FA = 0
        PKEY_RI = 1
        WKP_FA = 2
        WKP_RI = 3
        VINLOW_FA = 4
        VINLOW_RI = 5
        VBUS_FA = 6
        VBUS_RI = 7
        THW_FA = 8
        THW_RI = 9
        BUCK1_OCP = 16
        BUCK2_OCP = 17
        BUCK3_OCP = 18
        BUCK4_OCP = 19
        BUCK5_OCP = 20
        BUCK6_OCP = 21
        BUCK7_OCP = 22
        REFDDR_OC = 23
        LDO1_OCP2 = 24
        LDO2_OCP2 = 25
        LDO3_OCP2 = 26
        LDO4_OCP2 = 27
        LDO5_OCP2 = 28
        LDO6_OCP2 = 29
        LDO7_OCP3 = 30
        LDO8_OCP3 = 31
    $ref: /schemas/types.yaml#/definitions/uint32-array
    minItems: 1
    maxItems: 32

  st,notif-it-id:
    description: OP-TEE notification IDs to forward to the non-secure world
      for each PMIC interruption listed by st,pmic-it-id.
    $ref: /schemas/types.yaml#/definitions/uint32-array
    minItems: 1
    maxItems: 32

  regulators:
    type: object

    description: |
      Available regulators in STPMIC2 device are:
        - buck1 for BUCK1
        - buck2 for BUCK2
        - buck3 for BUCK3
        - buck4 for BUCK4
        - buck5 for BUCK5
        - buck6 for BUCK6
        - buck7 for BUCK7
        - ldo1 for LDO1
        - ldo2 for LDO2
        - ldo3 for LDO3
        - ldo4 for LDO4
        - ldo5 for LDO5
        - ldo6 for LDO6
        - ldo7 for LDO7
        - ldo8 for LDO8
        - refddr for REFDDR

    properties:
      compatible:
        const: st,stpmic2-regulators

    patternProperties:
      "^(buck[1-7]|ldo[1-8]|refddr)$":
        type: object
        $ref: ../regulator/regulator.yaml

        properties:
          st,mask-reset:
            description: mask reset for this regulator, the regulator
              configuration is maintained during STPMIC2 reset cycle.
            $ref: /schemas/types.yaml#/definitions/flag

          st,regulator-bypass-microvolt:
            description: regulator output voltage when configured in bypass.
              Authorize automatic bypass mode selection depending on voltage.
              Available only for LDO2, LDO3, LDOs5-8.

          st,alternate-input-source:
            description: select VOUT4 as input source for LDO1.
            $ref: /schemas/types.yaml#/definitions/flag

          st,pwrctrl-enable:
            description: Enable the power control input line for the regulator.
            $ref: /schemas/types.yaml#/definitions/flag

          st,pwrctrl-sel:
            description: Power control input line number to use to drive
              the regulator low power state.
            $ref: /schemas/types.yaml#/definitions/uint32

          st,pwrctrl-reset:
            description: The regulator state is reset to it's NVMEM default
              value when exit from low power. It is disabled when the
              power control line is low.
            $ref: /schemas/types.yaml#/definitions/flag

        patternProperties:
          regulator-state-(default|lplv|standby|off):
            type: object
            description:
              sub-nodes for regulator low power states.
              default is applied for STOP1, LP-STOP1, STOP2, LP-STOP2
              lplv is applied for LPLV-STOP1, LPLV-STOP2
              standby is applied for STANDBY1-DDR-SR
              off is applied for STANDBY-DDR-OFF

            properties:
              regulator-on-in-suspend:
                description: regulator should be on in suspend state.
                type: boolean

              regulator-off-in-suspend:
                description: regulator should be off in suspend state.
                type: boolean

              regulator-suspend-microvolt:
                description: the voltage which regulator should be set in
                  suspend.

      "^(buck[1-7]|ldo[1-8]|refddr)-supply$":
        description: STPMIC2 voltage regulators supplies

    additionalProperties: false

additionalProperties: false

required:
  - compatible
  - reg

examples:
  - |
    #include <dt-bindings/mfd/st,stpmic2.h>
    i2c {
      #address-cells = <1>;
      #size-cells = <0>;
      pmic@33 {
        compatible = "st,stpmic2";
        reg = <0x33>;

        st,wakeup-pin-number = <1>;
        st,pmic-it-id = <IT_PKEY_FA IT_PKEY_RI>;
        st,notif-it-id = <0 1>;

        regulators {
          compatible = "st,stpmic2-regulators";

          ldo6-supply = <&v3v3>;

          buck1 {
            regulator-name = "vdd_core";
            st,pwrctrl-sel = <1>;
            st,pwrctrl-enable;
            regulator-min-microvolt = <1200000>;
            regulator-max-microvolt = <1200000>;
            default {
              regulator-on-in-suspend;
              regulator-suspend-microvolt = <1200000>;
            };
            lplv {
              regulator-on-in-suspend;
              regulator-suspend-microvolt = <700000>;
            };
            standby {
              regulator-off-in-suspend;
            };
            off {
              regulator-off-in-suspend;
            };
          };

          buck3 {
            regulator-name = "vdd";
            regulator-min-microvolt = <3300000>;
            regulator-max-microvolt = <3300000>;
            regulator-boot-on;
            regulator-pull-down;
            st,mask-reset;
          };

          buck4 {
            regulator-name = "v3v3";
            regulator-min-microvolt = <3300000>;
            regulator-max-microvolt = <3300000>;
            regulator-always-on;
            regulator-over-current-protection;
          };

          ldo6 {
            regulator-name = "v1v8";
            regulator-min-microvolt = <1800000>;
            regulator-max-microvolt = <1800000>;
          };

          ldo8 {
            regulator-name = "vddio_sdcard";
            regulator-min-microvolt = <1800000>;
            regulator-max-microvolt = <3300000>;
            regulator-always-on;
            st,regulator-bypass-microvolt = <3300000>;
          };
        };
      };
    };
...
```

## Firmware/STM32-Computer-Firmware/CA7/optee-os-3.19.0-r2/optee-os-stm32mp-3.19.0-stm32mp-r2/documentation/devicetree/bindings/nvmem/st,stm32-romem.yaml
```yaml
# SPDX-License-Identifier: (GPL-2.0-only OR BSD-2-Clause)
%YAML 1.2
---
$id: http://devicetree.org/schemas/nvmem/st,stm32-romem.yaml#
$schema: http://devicetree.org/meta-schemas/core.yaml#

title: STMicroelectronics STM32 Factory-programmed data bindings

description: |
  This represents STM32 Factory-programmed read only non-volatile area: locked
  flash, OTP, read-only HW regs... This contains various information such as:
  analog calibration data for temperature sensor (e.g. TS_CAL1, TS_CAL2),
  internal vref (VREFIN_CAL), unique device ID...

maintainers:
  - Fabrice Gasnier <fabrice.gasnier@st.com>

allOf:
  - $ref: "nvmem.yaml#"

properties:
  compatible:
    enum:
      - st,stm32f4-otp
      - st,stm32mp13-bsec
      - st,stm32mp15-bsec
      - st,stm32mp25-bsec

  clocks:
    maxItems: 1
    description: |
      - It's not present on stm32f4.
      - It's not present on stm32mp13.
      - It's optional on stm32mp15.
      - It's not present on stm32mp25.

patternProperties:
  "^.*@[0-9a-f]+$":
    type: object

    properties:
      st,non-secure-otp:
        description: |
          This property explicits a factory programmed area that both secure
          and non-secure worlds can access. It is needed when, by default, the
          related area can only be reached by the secure world.
          It requires to be 32 bits word aligned to allow non-secure sharing.
          Not supported by stm32mp25.
        type: boolean
      st,non-secure-otp-provisioning:
        description: |
          This property explicits a factory programmed area that allows a non-secure
          read and write until the first programmed value. Once the provisioning of
          the specified area is done, access from non-secure is forbidden.
          It is needed when, by default, the related area is empty and must be provisioned.
        type: boolean
      st,secure-otp:
        description: |
          This property explicits a factory programmed area that secure
          worlds of main processor can access.
          Only supported by stm32mp25.
        type: boolean

required:
  - "#address-cells"
  - "#size-cells"
  - compatible
  - reg

unevaluatedProperties: false

examples:
  - |
    efuse@1fff7800 {
      compatible = "st,stm32f4-otp";
      reg = <0x1fff7800 0x400>;
      #address-cells = <1>;
      #size-cells = <1>;

      calib@22c {
        reg = <0x22c 0x2>;
      };

      mac_addr@e4 {
        reg = <0xe4 0x8>;
        st,non-secure-otp;
      };

      oem_enc_key@170 {
        reg = <0x170 0x10>;
        st,non-secure-otp-provisioning;
      };
    };

...
```

## Firmware/STM32-Computer-Firmware/CA7/optee-os-3.19.0-r2/optee-os-stm32mp-3.19.0-stm32mp-r2/documentation/devicetree/bindings/regulator/st,stm32mp1-pwr-reg.yaml
```yaml
# SPDX-License-Identifier: (GPL-2.0-only OR BSD-2-Clause)
%YAML 1.2
---
$id: http://devicetree.org/schemas/regulator/st,stm32mp1-pwr-reg.yaml#
$schema: http://devicetree.org/meta-schemas/core.yaml#

title: STM32MP1 PWR voltage regulators

maintainers:
  - Pascal Paillet <p.paillet@st.com>

properties:
  compatible:
    const: st,stm32mp1,pwr-reg

  reg:
    maxItems: 1

  st,tzcr:
    description: |
      Phandle to the RCC node to control the RCC status
      secure or non secure with the register address and bit.
    minItems: 1
    $ref: "/schemas/types.yaml#/definitions/uint32-array"

  system_suspend_supported_soc_modes:
    description: |
      List of supported low power SOC modes for system suspend,
      from the least to the most deep state. The possible values are:
        STM32_PM_CSLEEP_RUN : wfi
        STM32_PM_CSTOP_ALLOW_STOP : cstop
        STM32_PM_CSTOP_ALLOW_LP_STOP : cstop allowing lp-stop
        STM32_PM_CSTOP_ALLOW_LPLV_STOP : cstop allowing lplv-stop
        STM32_PM_CSTOP_ALLOW_LPLV_STOP2 : cstop allowing lp-stop2 for STM32MP13
        STM32_PM_CSTOP_ALLOW_STANDBY_DDR_SR : cstop allowing standby with DDR in self-refresh
    $ref: "/schemas/types.yaml#/definitions/uint32"

  system_off_soc_mode:
    description: |
      Mode used for shutdown. The possible values are
        STM32_PM_CSTOP_ALLOW_STANDBY_DDR_OFF: standby with DDR off
        STM32_PM_SHUTDOWN: pmic swith off
    minItems: 1
    maxItems: 8
    $ref: "/schemas/types.yaml#/definitions/uint32"

  vdd-supply:
    description: Input supply phandle(s) for vdd input

  vdd_3v3_usbfs-supply:
    description: Input supply phandle(s) for vdd_3v3_usbfs input

patternProperties:
  "^(reg11|reg18|usb33)$":
    type: object

    $ref: "regulator.yaml#"

required:
  - compatible
  - reg
  - system_suspend_supported_soc_modes

additionalProperties: false

examples:
  - |
    //At SOC level:
    pwr_regulators: pwr@50001000 {
      compatible = "st,stm32mp1,pwr-reg";
      reg = <0x50001000 0x10>;
      st,tzcr = <&rcc 0x0 0x1>;

      reg11: reg11 {
        regulator-name = "reg11";
        regulator-min-microvolt = <1100000>;
        regulator-max-microvolt = <1100000>;
      };

      reg18: reg18 {
        regulator-name = "reg18";
        regulator-min-microvolt = <1800000>;
        regulator-max-microvolt = <1800000>;
      };

      usb33: usb33 {
        regulator-name = "usb33";
        regulator-min-microvolt = <3300000>;
        regulator-max-microvolt = <3300000>;
      };
    };

    //At board level:
    &pwr_regulators {
      system_suspend_supported_soc_modes = <
        STM32_PM_CSLEEP_RUN
        STM32_PM_CSTOP_ALLOW_LP_STOP
        STM32_PM_CSTOP_ALLOW_STANDBY_DDR_SR
      >;
      system_off_soc_mode = <STM32_PM_CSTOP_ALLOW_STANDBY_DDR_OFF>;
      vdd-supply = <&vdd>;
      vdd_3v3_usbfs-supply = <&vdd_usb>;
    };
...
```

## Firmware/STM32-Computer-Firmware/CA7/optee-os-3.19.0-r2/optee-os-stm32mp-3.19.0-stm32mp-r2/documentation/devicetree/bindings/soc/stm32/st,stm32-etzpc.yaml
```yaml
# SPDX-License-Identifier: (GPL-2.0-only OR BSD-2-Clause)
%YAML 1.2
---
$id: http://devicetree.org/schemas/soc/stm32/st,stm32-etzpc.yaml#
$schema: http://devicetree.org/meta-schemas/core.yaml#

title: STM32 Extended TrustZone protection controller bindings

maintainers:
  - Lionel Debieve <lionel.debieve@foss.st.com>

properties:
  compatible:
    const: "st,stm32-etzpc"

  "#address-cells":
    const: 1

  "#size-cells":
    const: 1

  reg:
    maxItems: 1

  clocks:
    maxItems: 1

  st,decprot:
    description: |
      - Define a list of peripherals with the associated configuration.
        It is defined by macros DECPROT(STM32MP1_ETZPC_XXX_ID, DECPROT_XX, DECPROT_LOCK)
        as defined by header file dt-bindings/soc/stm32mp13-etzpc.h.
      - A peripheral ID is required as in dt-bindings/soc/stm32mp13-etzpc.h for STM32MP13 and
        dt-bindings/soc/stm32mp15-etzpc.h for STM32MP15
      - Peripheral access which can be defined using following description
          DECPROT_S_RW: Secure Read/Write
          DECPROT_NS_R_S_W: Non-secure Read / Secure write
          DECPROT_MCU_ISOLATION: CoProcessor isolated
          DECPROT_NS_RW: Non-secure Read/Write
      - description: Configuration lock state (DECPROT_UNLOCK / DECPROT_LOCK)
    $ref: "/schemas/types.yaml#/definitions/uint32-array"

required:
  - compatible
  - "#address-cells"
  - "#size-cells"
  - reg
  - clocks

additionalProperties: false

examples:
  - |
    #include <dt-bindings/clock/stm32mp13-clks.h>
    #include <dt-bindings/reset/stm32mp13-resets.h>
    #include <dt-bindings/soc/stm32mp13-etzpc.h>
    etzpc: etzpc@5c007000 {
      compatible = "st,stm32-etzpc";
      reg = <0x5C007000 0x400>;
      clocks = <&rcc TZPC>;
      #address-cells = <1>;
      #size-cells = <1>;
      st,decprot = <
                DECPROT(STM32MP1_ETZPC_ADC1_ID, DECPROT_NS_RW, DECPROT_UNLOCK)
                DECPROT(STM32MP1_ETZPC_ADC2_ID, DECPROT_NS_RW, DECPROT_LOCK)
                DECPROT(STM32MP1_ETZPC_BKPSRAM_ID, DECPROT_S_RW, DECPROT_UNLOCK)
                DECPROT(STM32MP1_ETZPC_CRYP_ID, DECPROT_NS_RW, DECPROT_UNLOCK)
                DECPROT(STM32MP1_ETZPC_DCMIPP_ID, DECPROT_NS_RW, DECPROT_UNLOCK)
                DECPROT(STM32MP1_ETZPC_DDRCTRLPHY_ID, DECPROT_NS_R_S_W, DECPROT_UNLOCK)
                DECPROT(STM32MP1_ETZPC_ETH1_ID, DECPROT_NS_RW, DECPROT_UNLOCK)
                DECPROT(STM32MP1_ETZPC_ETH2_ID, DECPROT_NS_RW, DECPROT_UNLOCK)
                DECPROT(STM32MP1_ETZPC_FMC_ID, DECPROT_NS_RW, DECPROT_UNLOCK)
      >:
    };

...
```
