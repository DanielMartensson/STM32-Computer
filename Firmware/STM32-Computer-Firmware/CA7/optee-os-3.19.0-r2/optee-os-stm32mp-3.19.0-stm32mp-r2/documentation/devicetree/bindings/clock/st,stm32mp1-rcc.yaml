## Firmware/STM32-Computer-Firmware/CA7/optee-os-3.19.0-r2/optee-os-stm32mp-3.19.0-stm32mp-r2/documentation/devicetree/bindings/crypto/st,stm32-saes.yaml
```yaml
# SPDX-License-Identifier: (GPL-2.0-only OR BSD-2-Clause)
%YAML 1.2
---
$id: http://devicetree.org/schemas/crypto/st,stm32-saes.yaml#
$schema: http://devicetree.org/meta-schemas/core.yaml#

title: STMicroelectronics STM32 Secure AES bindings

maintainers:
  - Nicolas Toromanoff <nicolas.toromanoff@foss.st.com>

properties:
  compatible:
    enum:
      - st,stm32mp13-saes

  reg:
    maxItems: 1

  clocks:
    maxItems: 1

  interrupts:
    maxItems: 1

  resets:
    maxItems: 1

required:
  - compatible
  - reg
  - clocks

additionalProperties: false

examples:
  - |
    #include <dt-bindings/clock/stm32mp1-clks.h>
    #include <dt-bindings/reset/stm32mp1-resets.h>
    saes: saes@54005000 {
            compatible = "st,stm32mp13-saes";
            reg = <0x54005000 0x400>;
            clocks = <&rcc SAES_K>;
            resets = <&rcc SAES_R>;
    };
...
```

## Firmware/STM32-Computer-Firmware/CA7/optee-os-3.19.0-r2/optee-os-stm32mp-3.19.0-stm32mp-r2/documentation/devicetree/bindings/hwlock/st,stm32-hwspinlock.yaml
```yaml
# SPDX-License-Identifier: (GPL-2.0-only OR BSD-2-Clause)
%YAML 1.2
---
$id: http://devicetree.org/schemas/hwlock/st,stm32-hwspinlock.yaml#
$schema: http://devicetree.org/meta-schemas/core.yaml#

title: STMicroelectronics STM32 Hardware Spinlock bindings

maintainers:
  - Fabien Dessenne <fabien.dessenne@foss.st.com>

properties:
  "#hwlock-cells":
    const: 2

  compatible:
    enum:
      - st,stm32-hwspinlock
      - st,stm32mp25-hsem

  reg:
    maxItems: 1

  clocks:
    maxItems: 1

  clock-names:
    items:
      - const: hsem

  st,protreg:
    minItems: 1
    maxItems: 16
    $ref: "/schemas/types.yaml#/definitions/uint32-array"
    description:
      Describes the firewall hardware configuration to apply for a given
      resource.

      RIFPROT(hsem_res_id, sem_list, lock, sec, priv, scid, sem_en, cfen)

      When a field isn't effective, it should be filled with RIF_UNUSED.

        "hsem_res_id" The HSEM resource number.

        "sem_list" This peripheral does not support semaphores.
                   This field must be set to RIF_UNUSED.

        "lock" This peripheral does not support configuration locking.
               This field must be set to RIF_UNUSED.

        "sec" Configures secure-only access to the resource.
          RIF_SEC, only secure access is granted to the resource
          RIF_NSEC, secure/non-secure access is granted to the
                    resource

        "priv" Configures the privilege level needed to access this
               resource.
          RIF_PRIV, only privileged access is granted to the resource
          RIF_NPRIV, privileged/Unprivileged access is granted to the
                     resource

        "scid" Configures the static CID that is allowed to access the
               resource. Note that the static CID configuration is
               ineffective if the semaphore mode is enabled. Mandates CID
               filtering enabled to be effective.
          RIF_CID1 allows CID 1 to access the resource
          RIF_CID2 allows CID 2 to access the resource ...

        "sem_en" This peripheral does not support semaphores.
                 This field must be set to RIF_UNUSED.

        "cfen" Enable/disable the CID filtering for this resource.
          RIF_CFEN, enables the CID filtering
          RIF_CFDIS, disables the CID filtering

allOf:
  - if:
      not:
        properties:
          compatible:
            contains:
              const: st,stm32mp25-hsem

    then:
      properties:
        st,protreg: false

required:
  - "#hwlock-cells"
  - compatible
  - reg
  - clocks
  - clock-names

additionalProperties: false

examples:
  - |
    #include <dt-bindings/clock/stm32mp1-clks.h>
    hwspinlock@4c000000 {
        compatible = "st,stm32-hwspinlock";
        #hwlock-cells = <2>;
        reg = <0x4c000000 0x400>;
        clocks = <&rcc HSEM>;
        clock-names = "hsem";
    };

...
```

## Firmware/STM32-Computer-Firmware/CA7/optee-os-3.19.0-r2/optee-os-stm32mp-3.19.0-stm32mp-r2/documentation/devicetree/bindings/hwmon/st,stm32-hse-monitoring.yaml
```yaml
# SPDX-License-Identifier: (GPL-2.0-only OR BSD-2-Clause)
%YAML 1.2
---
$id: http://devicetree.org/schemas/hwmon/st,stm32-hse-monitoring.yaml#
$schema: http://devicetree.org/meta-schemas/core.yaml#

title: STMicroelectronics STM32 HSE frequency monitoring bindings

maintainers:
  - Lionel Debieve <lionel.debieve@foss.st.com>

description: |
  STMicroelectronics's STM32 MPUs are able to monitor High Speed External
  oscillator frequency. Based on a lptimer, it is possible to detect a
  overclock frequency which can corrupt the system. The frequency overclock
  detection is detected thanks to High Speed Internal oscillator reference
  (hsi).

properties:
  compatible:
    const: st,freq-monitor

  counter:
    description: Counter used to monitor the frequency.
      Refer to counter.yaml for more details.

  clocks:
    minItems: 2
    maxItems: 2

  clock-names:
    items:
      - const: hse
      - const: hsi

required:
  - compatible

additionalProperties: false

examples:
- |
  hse_monitor: hse-monitor {
    compatible = "st,freq-monitor";
    counter = <&lptimer3 1 1 0 0>;
    clocks = <&rcc CK_HSE>, <&rcc CK_HSI>;
    clock-names = "hse", "hsi";
  };

...
```

## Firmware/STM32-Computer-Firmware/CA7/optee-os-3.19.0-r2/optee-os-stm32mp-3.19.0-stm32mp-r2/documentation/devicetree/bindings/interrupt-controller/st,stm32-exti.yaml
```yaml
# SPDX-License-Identifier: (GPL-2.0-only OR BSD-2-Clause)
%YAML 1.2
---
$id: http://devicetree.org/schemas/interrupt-controller/st,stm32-exti.yaml#
$schema: http://devicetree.org/meta-schemas/core.yaml#

title: STM32 External Interrupt Controller Device Tree Bindings

maintainers:
  - Alexandre Torgue <alexandre.torgue@st.com>
  - Ludovic Barre <ludovic.barre@st.com>

properties:
  compatible:
    oneOf:
      - items:
          - enum:
              - st,stm32-exti
              - st,stm32h7-exti
      - items:
          - enum:
              - st,stm32mp1-exti
              - st,stm32mp13-exti
          - const: syscon

  "#interrupt-cells":
    const: 2

  reg:
    maxItems: 1

  interrupt-controller: true

  hwlocks:
    maxItems: 1
    description:
      Reference to a phandle of a hardware spinlock provider node.

  interrupts:
    minItems: 1
    maxItems: 96
    description:
      Interrupts references to primary interrupt controller

  wakeup-parent: true

  st,protreg:
    minItems: 1
    maxItems: 96
    $ref: "/schemas/types.yaml#/definitions/uint32-array"
    description:
      Describes the firewall hardware configuration to apply for a given
      interrupt. Applicable for platforms implementing the RIF.

      RIFPROT(exti_res_id, sem_list, lock, sec, priv, scid, sem_en, cfen)

      When a field isn't effective, it should be filled with RIF_UNUSED.

        "exti_res_id" The EXTI resource ID. Use (RIF_EXTI1_RESOURCE (x) with
                      x the EXTI id (same than exit line number). Note that
                      this macro is for EXTI instance 1. Use
                      RIF_EXTI2_RESOURCE (x) for EXTI instance 2.

        "sem_list" This peripheral does not support semaphores.
                    This field must be set to RIF_UNUSED.

        "lock" This peripheral does not support individual interrupt
                RIF configuration locking. Global lock can be set through the
                "st,glocked"property
                This field must be set to RIF_UNUSED.

        "sec" Configures secure-only access to the interrupt.
          RIF_SEC, only secure access is granted to the interrupt
          RIF_NSEC, secure/non-secure access is granted to the interrupt

        "priv" Configures the privilege level needed to access this
                interrupt.
          RIF_PRIV, only privileged access is granted to the interrupt
          RIF_NPRIV, privileged/Unprivileged access is granted to the
                      interrupt

        "scid" Configures the static CID that is allowed to access the
                interrupt. Note that the static CID configuration is
                ineffective if the semaphore mode is enabled. Mandates CID
                filtering enabled to be effective.
          RIF_CID1 allows CID 1 to access the interrupt
          RIF_CID2 allows CID 2 to access the interrupt ...

        "sem_en" This peripheral does not support semaphores.
                  This field must be set to RIF_UNUSED.

        "cfen" Enable/disable the CID filtering for this interrupt.
          RIF_CFEN, enables the CID filtering
          RIF_CFDIS, disables the CID filtering

  st,proccid:
    minItems: 1
    maxItems: 3
    $ref: "/schemas/types.yaml#/definitions/uint32-array"
    description:
      Applicable for platforms implementing the RIF. Used to affect the CID
      number to a particular CPU in EXTI. On STM32MP2x platforms CPU1 = A35,
      CPU2 = M33 and CPU3 = M0+. As EXTI does not know which is the CID for
      each CPU, is must be set.
      For EXTI 1, <1 RIF_CID1>, <2 RIF_CID2>;
      For EXTI 2, <1 RIF_CID1>, <2 RIF_CID2>, <3 RIF_CID3>;

  st,glocked:
    type: boolean
    description:
      Applicable for platforms implementing the RIF. Used to globally lock
      the EXTI RIF configuration. When set, Security, privilege, and CID
      configurations are locked and can't be modified until next reset.

patternProperties:
  '^exti-interrupt-map$':
    type: object
    properties:
      interrupt-map: true
      interrupt-map-mask: true
      "#interrupt-cells":
        const: 2
      "#address-cells":
        const: 0

    required:
      - interrupt-map
      - "#interrupt-cells"
      - "#address-cells"

required:
  - "#interrupt-cells"
  - compatible
  - reg
  - interrupt-controller

allOf:
  - $ref: /schemas/interrupt-controller.yaml#
  - if:
      properties:
        compatible:
          contains:
            enum:
              - st,stm32-exti
    then:
      properties:
        interrupts:
          minItems: 1
          maxItems: 32
      required:
        - interrupts
  - if:
      properties:
        compatible:
          contains:
            enum:
              - st,stm32h7-exti
    then:
      properties:
        interrupts:
          minItems: 1
          maxItems: 96
      required:
        - interrupts
  - if:
      not:
        properties:
          compatible:
            contains:
              const: st,stm32mp13-exti

    then:
      properties:
        st,protreg: false

additionalProperties: false

examples:
  - |
    //Example 1
    exti1: interrupt-controller@5000d000 {
        compatible = "st,stm32mp1-exti", "syscon";
        interrupt-controller;
        #interrupt-cells = <2>;
        reg = <0x5000d000 0x400>;
    };

    //Example 2
    exti2: interrupt-controller@5000d000 {
        compatible = "st,stm32mp1-exti", "syscon";
        interrupt-controller;
        #interrupt-cells = <2>;
        reg = <0x5000d000 0x400>;
        wakeup-parent = <&pwr_irq>;
        exti-interrupt-map {
            #address-cells = <0>;
            #interrupt-cells = <2>;
            interrupt-map-mask = <0xffffffff 0>;
            interrupt-map =
                <0 0 &intc GIC_SPI 6 IRQ_TYPE_LEVEL_HIGH>,
                <3 0 &intc GIC_SPI 9 IRQ_TYPE_LEVEL_HIGH>,
                <55 0 &pwr_irq 0 IRQ_TYPE_EDGE_FALLING 0>;
        };
    };

    //Example 3
    exti3: interrupt-controller@40013c00 {
        compatible = "st,stm32-exti";
        interrupt-controller;
        #interrupt-cells = <2>;
        reg = <0x40013C00 0x400>;
        interrupts = <1>, <2>, <3>, <6>, <7>, <8>, <9>, <10>, <23>, <40>, <41>, <42>, <62>, <76>;
    };

...
```
